/dts-v1/;

/ {
	compatible = "Samsung,F42 5G KOR SKT 00", "Mediatek,MT6833";
	dtbo-hw_rev = <0x0>;
	dtbo-hw_rev_end = <0x20>;

	__fixups__ {
		accdet = "/fragment@17:target:0";
		auxadc = "/fragment@5/__overlay__:io-channels:0", "/fragment@30:target:0", "/fragment@31/__overlay__:io-channels:0";
		bat_gm30 = "/fragment@5:target:0";
		camera_af_hw_node = "/fragment@29:target:0";
		charger = "/fragment@7:target:0";
		chosen = "/fragment@0:target:0";
		dispsys_config = "/fragment@11:target:0";
		dsi0 = "/fragment@12:target:0";
		dsi_te = "/fragment@54:target:0";
		gpio = "/fragment@44:target:0";
		gpio_usage_mapping = "/fragment@43:target:0";
		gps = "/fragment@21:target:0";
		i2c0 = "/fragment@33:target:0";
		i2c1 = "/fragment@34:target:0";
		i2c2 = "/fragment@28:target:0", "/fragment@35:target:0";
		i2c3 = "/fragment@36:target:0", "/fragment@61:target:0";
		i2c4 = "/fragment@27:target:0", "/fragment@37:target:0";
		i2c5 = "/fragment@38:target:0";
		i2c6 = "/fragment@13:target:0", "/fragment@39:target:0";
		i2c7 = "/fragment@40:target:0";
		i2c8 = "/fragment@26:target:0", "/fragment@41:target:0";
		i2c9 = "/fragment@22:target:0", "/fragment@42:target:0";
		kd_camera_hw1 = "/fragment@25:target:0", "/fragment@58:target:0";
		keypad = "/fragment@60:target:0";
		lk_charger = "/fragment@4:target:0";
		md1_sim1_hot_plug_eint = "/fragment@55:target:0";
		md_auxadc = "/fragment@31:target:0";
		mrdump_ext_rst = "/fragment@45:target:0";
		msdc1_ins = "/fragment@46:target:0";
		mt6360_ldo = "/fragment@18:target:0";
		mt6360_pmic = "/fragment@2:target:0";
		mt6360_pmu = "/fragment@1:target:0", "/fragment@6:target:0";
		mt6360_typec = "/fragment@3:target:0";
		mt_pmic_vcamio_ldo_reg = "/fragment@25/__overlay__:cam0_vcamio-supply:0", "/fragment@25/__overlay__:cam1_vcamio-supply:0", "/fragment@25/__overlay__:cam2_vcamio-supply:0", "/fragment@25/__overlay__:cam4_vcamio-supply:0", "/fragment@56:target:0", "/fragment@58/__overlay__:vcamio_main2-supply:0", "/fragment@58/__overlay__:vcamio_main3-supply:0";
		mt_pmic_vfp_ldo_reg = "/fragment@63:target:0";
		mt_pmic_vio28_ldo_reg = "/fragment@22/__overlay__/abov_sar@20:cap_vdd-supply:0";
		mt_pmic_vtp_ldo_reg = "/fragment@29/__overlay__:vldo28-supply:0", "/fragment@57:target:0", "/fragment@58/__overlay__:vcamaf-supply:0";
		mtkfb = "/fragment@10:target:0";
		odm = "/fragment@19:target:0";
		pio = "/fragment@1/__overlay__:mt6360,intr_gpio:0", "/fragment@3/__overlay__:mt6360pd,intr_gpio:0", "/fragment@7/__overlay__:afc_switch_gpio:0", "/fragment@7/__overlay__:afc_data_gpio:0", "/fragment@8:target:0", "/fragment@9:target:0", "/fragment@12/__overlay__/panel1@0:pm-enable-gpios:0", "/fragment@12/__overlay__/panel1@0:reset-gpios:0", "/fragment@12/__overlay__/panel1@0:bias-gpios:0", "/fragment@12/__overlay__/panel1@0:bias-gpios:12", "/fragment@12/__overlay__/panel2@0:pm-enable-gpios:0", "/fragment@12/__overlay__/panel2@0:reset-gpios:0", "/fragment@12/__overlay__/panel2@0:bias-gpios:0", "/fragment@12/__overlay__/panel2@0:bias-gpios:12", "/fragment@12/__overlay__/panel3@0:pm-enable-gpios:0", "/fragment@12/__overlay__/panel3@0:reset-gpios:0", "/fragment@12/__overlay__/panel3@0:bias-gpios:0", "/fragment@12/__overlay__/panel3@0:bias-gpios:12", "/fragment@12/__overlay__/panel4@0:pm-enable-gpios:0", "/fragment@12/__overlay__/panel4@0:reset-gpios:0", "/fragment@12/__overlay__/panel4@0:bias-gpios:0", "/fragment@12/__overlay__/panel4@0:bias-gpios:12", "/fragment@12/__overlay__/panel5@0:pm-enable-gpios:0", "/fragment@12/__overlay__/panel5@0:reset-gpios:0", "/fragment@12/__overlay__/panel5@0:bias-gpios:0", "/fragment@12/__overlay__/panel5@0:bias-gpios:12", "/fragment@12/__overlay__/panel6@0:pm-enable-gpios:0", "/fragment@12/__overlay__/panel6@0:reset-gpios:0", "/fragment@12/__overlay__/panel6@0:bias-gpios:0", "/fragment@12/__overlay__/panel6@0:bias-gpios:12", "/fragment@12/__overlay__/panel7@0:pm-enable-gpios:0", "/fragment@12/__overlay__/panel7@0:reset-gpios:0", "/fragment@12/__overlay__/panel7@0:bias-gpios:0", "/fragment@12/__overlay__/panel7@0:bias-gpios:12", "/fragment@14/__overlay__/novatek@0:novatek,reset-gpio:0", "/fragment@14/__overlay__/novatek@0:novatek,irq-gpio:0", "/fragment@16:target:0", "/fragment@20:target:0", "/fragment@22/__overlay__/abov_sar@20:interrupt-parent:0", "/fragment@22/__overlay__/abov_sar@20:abov,irq-gpio-std:0", "/fragment@23:target:0", "/fragment@24:target:0", "/fragment@43/__overlay__:GPIO_FDD_BAND_SUPPORT_DETECT_1ST_PIN:0", "/fragment@43/__overlay__:GPIO_FDD_BAND_SUPPORT_DETECT_2ND_PIN:0", "/fragment@43/__overlay__:GPIO_FDD_BAND_SUPPORT_DETECT_3RD_PIN:0", "/fragment@43/__overlay__:GPIO_FDD_BAND_SUPPORT_DETECT_4TH_PIN:0", "/fragment@43/__overlay__:GPIO_FDD_BAND_SUPPORT_DETECT_5TH_PIN:0", "/fragment@43/__overlay__:GPIO_SIM1_HOT_PLUG:0", "/fragment@43/__overlay__:GPIO_SIM2_HOT_PLUG:0", "/fragment@43/__overlay__:GPIO_SIM2_SCLK:0", "/fragment@43/__overlay__:GPIO_SIM2_SRST:0", "/fragment@43/__overlay__:GPIO_SIM2_SIO:0", "/fragment@43/__overlay__:GPIO_SIM1_SIO:0", "/fragment@43/__overlay__:GPIO_SIM1_SRST:0", "/fragment@43/__overlay__:GPIO_SIM1_SCLK:0", "/fragment@43/__overlay__:GPIO_RF_PWREN_RST_PIN:0", "/fragment@45/__overlay__:interrupt-parent:0", "/fragment@45/__overlay__:deb-gpios:0", "/fragment@46/__overlay__:interrupt-parent:0", "/fragment@47/__overlay__:interrupt-parent:0", "/fragment@48/__overlay__:interrupt-parent:0", "/fragment@48/__overlay__:deb-gpios:0", "/fragment@49/__overlay__:interrupt-parent:0", "/fragment@50/__overlay__:interrupt-parent:0", "/fragment@50/__overlay__:deb-gpios:0", "/fragment@51/__overlay__:interrupt-parent:0", "/fragment@51/__overlay__:deb-gpios:0", "/fragment@52/__overlay__:interrupt-parent:0", "/fragment@52/__overlay__:deb-gpios:0", "/fragment@53/__overlay__:interrupt-parent:0", "/fragment@53/__overlay__:deb-gpios:0", "/fragment@54/__overlay__:interrupt-parent:0", "/fragment@model/__overlay__/sec-mst:sec-mst,mst-data-gpio:0", "/fragment@model/__overlay__/sec-mst:sec-mst,mst-pwr-gpio:0", "/fragment@model/__overlay__/sec-mst:sec-mst,mst-en-gpio:0", "/fragment@model/__overlay__/sec-mst:sec-mst,mst-vcc-gpio:0", "/fragment@61/__overlay__/sec-nfc@27:sec-nfc,ven-gpio:0", "/fragment@61/__overlay__/sec-nfc@27:sec-nfc,firm-gpio:0", "/fragment@61/__overlay__/sec-nfc@27:sec-nfc,irq-gpio:0", "/fragment@61/__overlay__/sec-nfc@27:sec-nfc,clk_req-gpio:0", "/fragment@62:target:0", "/fragment@64/__overlay__/etspi-spi@1:etspi-sleepPin:0", "/fragment@64/__overlay__/etspi-spi@1:etspi-drdyPin:0";
		pmic_clock_buffer_ctrl = "/fragment@32:target:0";
		spi1 = "/fragment@14:target:0";
		spi5 = "/fragment@64:target:0";
		subpmic_pmu_eint = "/fragment@47:target:0";
		swtp = "/fragment@48:target:0";
		swtp_1 = "/fragment@50:target:0";
		swtp_2 = "/fragment@51:target:0";
		swtp_3 = "/fragment@52:target:0";
		swtp_4 = "/fragment@53:target:0";
		touch = "/fragment@15:target:0", "/fragment@49:target:0", "/fragment@59:target:0";
	};

	__local_fixups__ {

		fragment@10 {

			__overlay__ {
				pinctrl-0 = <0x0>;
				pinctrl-1 = <0x0>;
				pinctrl-2 = <0x0>;
				pinctrl-3 = <0x0>;
				pinctrl-4 = <0x0>;
				pinctrl-5 = <0x0>;
				pinctrl-6 = <0x0>;
			};
		};

		fragment@11 {

			__overlay__ {
				pinctrl-0 = <0x0>;
				pinctrl-1 = <0x0>;
				pinctrl-2 = <0x0>;
			};
		};

		fragment@12 {

			__overlay__ {

				panel1@0 {

					port {

						endpoint {
							remote-endpoint = <0x0>;
						};
					};
				};

				panel2@0 {

					port {

						endpoint {
							remote-endpoint = <0x0>;
						};
					};
				};

				panel3@0 {

					port {

						endpoint {
							remote-endpoint = <0x0>;
						};
					};
				};

				panel4@0 {

					port {

						endpoint {
							remote-endpoint = <0x0>;
						};
					};
				};

				panel5@0 {

					port {

						endpoint {
							remote-endpoint = <0x0>;
						};
					};
				};

				panel6@0 {

					port {

						endpoint {
							remote-endpoint = <0x0>;
						};
					};
				};

				panel7@0 {

					port {

						endpoint {
							remote-endpoint = <0x0>;
						};
					};
				};

				ports {

					port {

						endpoint {
							remote-endpoint = <0x0>;
						};
					};
				};
			};
		};

		fragment@15 {

			__overlay__ {
				pinctrl-0 = <0x0>;
				pinctrl-1 = <0x0>;
				pinctrl-2 = <0x0>;
				pinctrl-3 = <0x0>;
				pinctrl-4 = <0x0>;
				pinctrl-5 = <0x0>;
			};
		};

		fragment@21 {

			__overlay__ {
				pinctrl-0 = <0x0>;
				pinctrl-1 = <0x0>;
				pinctrl-2 = <0x0>;
				pinctrl-3 = <0x0>;
				pinctrl-4 = <0x0>;
				pinctrl-5 = <0x0>;
				pinctrl-6 = <0x0>;
			};
		};

		fragment@22 {

			__overlay__ {

				abov_sar@20 {
					pinctrl-0 = <0x0>;
				};
			};
		};

		fragment@25 {

			__overlay__ {
				pinctrl-0 = <0x0>;
				pinctrl-1 = <0x0>;
				pinctrl-10 = <0x0>;
				pinctrl-11 = <0x0>;
				pinctrl-12 = <0x0>;
				pinctrl-13 = <0x0>;
				pinctrl-14 = <0x0>;
				pinctrl-15 = <0x0>;
				pinctrl-16 = <0x0>;
				pinctrl-17 = <0x0>;
				pinctrl-18 = <0x0>;
				pinctrl-19 = <0x0>;
				pinctrl-2 = <0x0>;
				pinctrl-20 = <0x0>;
				pinctrl-21 = <0x0>;
				pinctrl-22 = <0x0>;
				pinctrl-23 = <0x0>;
				pinctrl-24 = <0x0>;
				pinctrl-25 = <0x0>;
				pinctrl-26 = <0x0>;
				pinctrl-27 = <0x0>;
				pinctrl-28 = <0x0>;
				pinctrl-29 = <0x0>;
				pinctrl-3 = <0x0>;
				pinctrl-30 = <0x0>;
				pinctrl-31 = <0x0>;
				pinctrl-32 = <0x0>;
				pinctrl-33 = <0x0>;
				pinctrl-34 = <0x0>;
				pinctrl-35 = <0x0>;
				pinctrl-36 = <0x0>;
				pinctrl-37 = <0x0>;
				pinctrl-38 = <0x0>;
				pinctrl-39 = <0x0>;
				pinctrl-4 = <0x0>;
				pinctrl-40 = <0x0>;
				pinctrl-41 = <0x0>;
				pinctrl-42 = <0x0>;
				pinctrl-43 = <0x0>;
				pinctrl-44 = <0x0>;
				pinctrl-45 = <0x0>;
				pinctrl-46 = <0x0>;
				pinctrl-47 = <0x0>;
				pinctrl-48 = <0x0>;
				pinctrl-49 = <0x0>;
				pinctrl-5 = <0x0>;
				pinctrl-50 = <0x0>;
				pinctrl-51 = <0x0>;
				pinctrl-52 = <0x0>;
				pinctrl-53 = <0x0>;
				pinctrl-54 = <0x0>;
				pinctrl-55 = <0x0>;
				pinctrl-56 = <0x0>;
				pinctrl-57 = <0x0>;
				pinctrl-58 = <0x0>;
				pinctrl-59 = <0x0>;
				pinctrl-6 = <0x0>;
				pinctrl-7 = <0x0>;
				pinctrl-8 = <0x0>;
				pinctrl-9 = <0x0>;
			};
		};

		fragment@64 {

			__overlay__ {

				etspi-spi@1 {
					pinctrl-0 = <0x0 0x4>;
					pinctrl-1 = <0x0 0x4 0x8 0xc>;
					pinctrl-2 = <0x0 0x4 0x8 0xc 0x10>;
					pinctrl-3 = <0x0>;
					pinctrl-4 = <0x0>;
				};
			};
		};

		fragment@7 {

			__overlay__ {
				pinctrl-0 = <0x0>;
				pinctrl-1 = <0x0>;
			};
		};
	};

	__symbols__ {
		abov_int_default = "/fragment@23/__overlay__/abov_int_pin/abov_int_default";
		afc_disable_pin = "/fragment@8/__overlay__/sleep";
		afc_enable_pin = "/fragment@8/__overlay__/active";
		btp_irq = "/fragment@62/__overlay__/btp-irq";
		btp_irq_sleep = "/fragment@62/__overlay__/btp-irq-sleep";
		btp_sleep = "/fragment@62/__overlay__/btp_sleep_enable";
		camera_main_af_mtk = "/fragment@41/__overlay__/camera_main_af@72";
		camera_main_eeprom_mtk = "/fragment@35/__overlay__/camera_main_eeprom@1a";
		camera_main_mtk = "/fragment@35/__overlay__/camera_main@1a";
		camera_main_three_af_mtk = "/fragment@35/__overlay__/camera_main_three_af@0c";
		camera_main_three_mtk = "/fragment@42/__overlay__/camera_main_three@10";
		camera_main_two_af_mtk = "/fragment@37/__overlay__/camera_main_two_af@0c";
		camera_main_two_mtk = "/fragment@41/__overlay__/camera_main_two@10";
		camera_pins_cam0_int_active = "/fragment@24/__overlay__/int_active";
		camera_pins_cam0_mclk_2ma = "/fragment@24/__overlay__/camera_pins_cam0_mclk_2ma";
		camera_pins_cam0_mclk_4ma = "/fragment@24/__overlay__/camera_pins_cam0_mclk_4ma";
		camera_pins_cam0_mclk_6ma = "/fragment@24/__overlay__/camera_pins_cam0_mclk_6ma";
		camera_pins_cam0_mclk_8ma = "/fragment@24/__overlay__/camera_pins_cam0_mclk_8ma";
		camera_pins_cam0_mclk_off = "/fragment@24/__overlay__/camera_pins_cam0_mclk_off";
		camera_pins_cam0_rst_0 = "/fragment@24/__overlay__/cam0@0";
		camera_pins_cam0_rst_1 = "/fragment@24/__overlay__/cam0@1";
		camera_pins_cam0_vcama_0 = "/fragment@24/__overlay__/cam0@vcam2";
		camera_pins_cam0_vcama_1 = "/fragment@24/__overlay__/cam0@vcam3";
		camera_pins_cam0_vcamd_0 = "/fragment@24/__overlay__/cam0@vcam0";
		camera_pins_cam0_vcamd_1 = "/fragment@24/__overlay__/cam0@vcam1";
		camera_pins_cam0_vcamd_1v1_0 = "/fragment@24/__overlay__/cam0@vcam4";
		camera_pins_cam0_vcamd_1v1_1 = "/fragment@24/__overlay__/cam0@vcam5";
		camera_pins_cam0_vcamd_1v2_0 = "/fragment@24/__overlay__/cam0@vcam6";
		camera_pins_cam0_vcamd_1v2_1 = "/fragment@24/__overlay__/cam0@vcam7";
		camera_pins_cam1_mclk_2ma = "/fragment@24/__overlay__/camera_pins_cam1_mclk_2ma";
		camera_pins_cam1_mclk_4ma = "/fragment@24/__overlay__/camera_pins_cam1_mclk_4ma";
		camera_pins_cam1_mclk_6ma = "/fragment@24/__overlay__/camera_pins_cam1_mclk_6ma";
		camera_pins_cam1_mclk_8ma = "/fragment@24/__overlay__/camera_pins_cam1_mclk_8ma";
		camera_pins_cam1_mclk_off = "/fragment@24/__overlay__/camera_pins_cam1_mclk_off";
		camera_pins_cam1_rst_0 = "/fragment@24/__overlay__/cam1@0";
		camera_pins_cam1_rst_1 = "/fragment@24/__overlay__/cam1@1";
		camera_pins_cam1_vcama_0 = "/fragment@24/__overlay__/cam1@vcam2";
		camera_pins_cam1_vcama_1 = "/fragment@24/__overlay__/cam1@vcam3";
		camera_pins_cam1_vcamd_0 = "/fragment@24/__overlay__/cam1@vcam0";
		camera_pins_cam1_vcamd_1 = "/fragment@24/__overlay__/cam1@vcam1";
		camera_pins_cam1_vcamd_1v1_0 = "/fragment@24/__overlay__/cam0@vcam8";
		camera_pins_cam1_vcamd_1v1_1 = "/fragment@24/__overlay__/cam0@vcam9";
		camera_pins_cam1_vcamd_1v2_0 = "/fragment@24/__overlay__/cam0@vcam10";
		camera_pins_cam1_vcamd_1v2_1 = "/fragment@24/__overlay__/cam0@vcam11";
		camera_pins_cam2_mclk_2ma = "/fragment@24/__overlay__/camera_pins_cam2_mclk_2ma";
		camera_pins_cam2_mclk_4ma = "/fragment@24/__overlay__/camera_pins_cam2_mclk_4ma";
		camera_pins_cam2_mclk_6ma = "/fragment@24/__overlay__/camera_pins_cam2_mclk_6ma";
		camera_pins_cam2_mclk_8ma = "/fragment@24/__overlay__/camera_pins_cam2_mclk_8ma";
		camera_pins_cam2_mclk_off = "/fragment@24/__overlay__/camera_pins_cam2_mclk_off";
		camera_pins_cam2_rst_0 = "/fragment@24/__overlay__/cam2@0";
		camera_pins_cam2_rst_1 = "/fragment@24/__overlay__/cam2@1";
		camera_pins_cam2_vcama_0 = "/fragment@24/__overlay__/cam2@vcam2";
		camera_pins_cam2_vcama_1 = "/fragment@24/__overlay__/cam2@vcam3";
		camera_pins_cam4_mclk_2ma = "/fragment@24/__overlay__/camera_pins_cam4_mclk_2ma";
		camera_pins_cam4_mclk_4ma = "/fragment@24/__overlay__/camera_pins_cam4_mclk_4ma";
		camera_pins_cam4_mclk_6ma = "/fragment@24/__overlay__/camera_pins_cam4_mclk_6ma";
		camera_pins_cam4_mclk_8ma = "/fragment@24/__overlay__/camera_pins_cam4_mclk_8ma";
		camera_pins_cam4_mclk_off = "/fragment@24/__overlay__/camera_pins_cam4_mclk_off";
		camera_pins_cam4_rst_0 = "/fragment@24/__overlay__/cam4@0";
		camera_pins_cam4_rst_1 = "/fragment@24/__overlay__/cam4@1";
		camera_pins_cam4_vcama_0 = "/fragment@24/__overlay__/cam4@vcam2";
		camera_pins_cam4_vcama_1 = "/fragment@24/__overlay__/cam4@vcam3";
		camera_pins_cam4_vcamd2_0 = "/fragment@24/__overlay__/cam0@vcam16";
		camera_pins_cam4_vcamd2_1 = "/fragment@24/__overlay__/cam0@vcam17";
		camera_pins_cam4_vcamd_0 = "/fragment@24/__overlay__/cam4@vcam0";
		camera_pins_cam4_vcamd_1 = "/fragment@24/__overlay__/cam4@vcam1";
		camera_pins_cam4_vcamd_1v1_0 = "/fragment@24/__overlay__/cam0@vcam12";
		camera_pins_cam4_vcamd_1v1_1 = "/fragment@24/__overlay__/cam0@vcam13";
		camera_pins_cam4_vcamd_1v2_0 = "/fragment@24/__overlay__/cam0@vcam14";
		camera_pins_cam4_vcamd_1v2_1 = "/fragment@24/__overlay__/cam0@vcam15";
		camera_pins_cam_mipi_switch_sel_0 = "/fragment@24/__overlay__/mipi_sel@0";
		camera_pins_cam_mipi_switch_sel_1 = "/fragment@24/__overlay__/mipi_sel@1";
		camera_pins_default = "/fragment@24/__overlay__/camdefault";
		camera_sub_eeprom_mtk = "/fragment@37/__overlay__/camera_sub_eeprom@a0";
		camera_sub_mtk = "/fragment@37/__overlay__/camera_sub@1a";
		ctp_pins_default = "/fragment@16/__overlay__/eint0default";
		ctp_pins_eint_as_int = "/fragment@16/__overlay__/eint@0";
		ctp_pins_eint_output0 = "/fragment@16/__overlay__/eintoutput0";
		ctp_pins_eint_output1 = "/fragment@16/__overlay__/eintoutput1";
		ctp_pins_rst_output0 = "/fragment@16/__overlay__/rstoutput0";
		ctp_pins_rst_output1 = "/fragment@16/__overlay__/rstoutput1";
		dsi_out = "/fragment@12/__overlay__/ports/port/endpoint";
		gps_l1_lna_pins_dsp_ctrl = "/fragment@20/__overlay__/gps_l1_lna@1";
		gps_l1_lna_pins_oh = "/fragment@20/__overlay__/gps_l1_lna@2";
		gps_l1_lna_pins_ol = "/fragment@20/__overlay__/gps_l1_lna@0";
		gps_l5_lna_pins_dsp_ctrl = "/fragment@20/__overlay__/gps_l5_lna@1";
		gps_l5_lna_pins_oh = "/fragment@20/__overlay__/gps_l5_lna@2";
		gps_l5_lna_pins_ol = "/fragment@20/__overlay__/gps_l5_lna@0";
		gps_pins_default = "/fragment@20/__overlay__/gps_default";
		i2c_lcd_bias_mtk = "/fragment@39/__overlay__/i2c_lcd_bias@73";
		lcm_bias = "/fragment@13/__overlay__/lcm_bias@3e";
		led0 = "/fragment@19/__overlay__/led@0";
		led1 = "/fragment@19/__overlay__/led@1";
		led2 = "/fragment@19/__overlay__/led@2";
		led3 = "/fragment@19/__overlay__/led@3";
		led4 = "/fragment@19/__overlay__/led@4";
		led5 = "/fragment@19/__overlay__/led@5";
		led6 = "/fragment@19/__overlay__/led@6";
		mtk_camera_eeprom0 = "/fragment@28/__overlay__/camera_eeprom0@50";
		mtk_camera_eeprom1 = "/fragment@27/__overlay__/camera_eeprom1@51";
		mtk_camera_eeprom2 = "/fragment@27/__overlay__/camera_eeprom2@50";
		mtk_camera_eeprom4 = "/fragment@26/__overlay__/camera_eeprom4@51";
		mtkfb_pins_lcd_bias_enn0 = "/fragment@9/__overlay__/lcd_bias_enn0_gpio";
		mtkfb_pins_lcd_bias_enn1 = "/fragment@9/__overlay__/lcd_bias_enn1_gpio";
		mtkfb_pins_lcd_bias_enp0 = "/fragment@9/__overlay__/lcd_bias_enp0_gpio";
		mtkfb_pins_lcd_bias_enp1 = "/fragment@9/__overlay__/lcd_bias_enp1_gpio";
		mtkfb_pins_lcm_dsi_te = "/fragment@9/__overlay__/lcm_dsi_te";
		mtkfb_pins_lcm_rst_out0_gpio = "/fragment@9/__overlay__/lcm_rst_out0_gpio";
		mtkfb_pins_lcm_rst_out1_gpio = "/fragment@9/__overlay__/lcm_rst_out1_gpio";
		panel_in1 = "/fragment@12/__overlay__/panel1@0/port/endpoint";
		panel_in2 = "/fragment@12/__overlay__/panel2@0/port/endpoint";
		panel_in3 = "/fragment@12/__overlay__/panel3@0/port/endpoint";
		panel_in4 = "/fragment@12/__overlay__/panel4@0/port/endpoint";
		panel_in5 = "/fragment@12/__overlay__/panel5@0/port/endpoint";
		panel_in6 = "/fragment@12/__overlay__/panel6@0/port/endpoint";
		panel_in7 = "/fragment@12/__overlay__/panel7@0/port/endpoint";
		spi5_clr_clk = "/fragment@62/__overlay__/clr_clk";
		spi5_clr_cs = "/fragment@62/__overlay__/clr_cs";
		spi5_clr_miso = "/fragment@62/__overlay__/clr_miso";
		spi5_clr_mosi = "/fragment@62/__overlay__/clr_mosi";
		spi5_set_clk = "/fragment@62/__overlay__/set_clk";
		spi5_set_cs = "/fragment@62/__overlay__/set_cs";
		spi5_set_miso = "/fragment@62/__overlay__/set_miso";
		spi5_set_mosi = "/fragment@62/__overlay__/set_mosi";
		subpmic_ldo_mtk = "/fragment@38/__overlay__/subpmic_ldo@64";
		subpmic_mtk = "/fragment@38/__overlay__/subpmic@34";
		subpmic_pmic_mtk = "/fragment@38/__overlay__/subpmic_pmic@1a";
		usb_type_c_mtk = "/fragment@38/__overlay__/usb_type_c@4e";
		vibrator0 = "/fragment@19/__overlay__/vibrator@0";
	};

	fragment@0 {
		target = <0xffffffff>;

		__overlay__ {
			atag,videolfb-fb_base_h = <0x0>;
			atag,videolfb-fb_base_l = "~`P";
			atag,videolfb-fps = <0x1770>;
			atag,videolfb-islcm_inited = <0x0>;
			atag,videolfb-islcmfound = <0x1>;
			atag,videolfb-lcmname = "nt35595_fhd_dsi_cmd_truly_nt50358_drv";
			atag,videolfb-vramSize = <0x1be0000>;
		};
	};

	fragment@1 {
		target = <0xffffffff>;

		__overlay__ {
			mt6360,intr_gpio = <0xffffffff 0xa 0x0>;
			mt6360,intr_gpio_num = <0xa>;
		};
	};

	fragment@10 {
		target = <0xffffffff>;

		__overlay__ {
			pinctrl-0 = <0x3>;
			pinctrl-1 = <0x4>;
			pinctrl-2 = <0x5>;
			pinctrl-3 = <0x6>;
			pinctrl-4 = <0x7>;
			pinctrl-5 = <0x8>;
			pinctrl-6 = <0x9>;
			pinctrl-names = "lcd_bias_enp1_gpio", "lcd_bias_enp0_gpio", "lcd_bias_enn1_gpio", "lcd_bias_enn0_gpio", "lcm_rst_out1_gpio", "lcm_rst_out0_gpio", "mode_te_te";
			status = "okay";
		};
	};

	fragment@11 {
		target = <0xffffffff>;

		__overlay__ {
			pinctrl-0 = <0x7>;
			pinctrl-1 = <0x8>;
			pinctrl-2 = <0x9>;
			pinctrl-names = "lcm_rst_out1_gpio", "lcm_rst_out0_gpio", "mode_te_te";
			status = "okay";
		};
	};

	fragment@12 {
		target = <0xffffffff>;

		__overlay__ {
			#address-cells = <0x1>;
			#size-cells = <0x0>;
			status = "okay";

			panel1@0 {
				bias-gpios = <0xffffffff 0x89 0x0 0xffffffff 0x8a 0x0>;
				compatible = "wt,nt36672c_fhdp_wt_dsi_vdo_cphy_90hz_tianma";
				pinctrl-names = "default";
				pm-enable-gpios = <0xffffffff 0x88 0x0>;
				reg = <0x0>;
				reset-gpios = <0xffffffff 0x56 0x0>;

				port {

					endpoint {
						phandle = <0xb>;
						remote-endpoint = <0xa>;
					};
				};
			};

			panel2@0 {
				bias-gpios = <0xffffffff 0x89 0x0 0xffffffff 0x8a 0x0>;
				compatible = "wt,ili7807s_fhdp_wt_dsi_vdo_cphy_90hz_txd";
				pinctrl-names = "default";
				pm-enable-gpios = <0xffffffff 0x88 0x0>;
				reg = <0x1>;
				reset-gpios = <0xffffffff 0x56 0x0>;

				port {

					endpoint {
						phandle = <0x61>;
						remote-endpoint = <0xa>;
					};
				};
			};

			panel3@0 {
				bias-gpios = <0xffffffff 0x89 0x0 0xffffffff 0x8a 0x0>;
				compatible = "wt,ft8722_fhdp_wt_dsi_vdo_cphy_90hz_truly";
				pinctrl-names = "default";
				pm-enable-gpios = <0xffffffff 0x88 0x0>;
				reg = <0x2>;
				reset-gpios = <0xffffffff 0x56 0x0>;

				port {

					endpoint {
						phandle = <0x62>;
						remote-endpoint = <0xa>;
					};
				};
			};

			panel4@0 {
				bias-gpios = <0xffffffff 0x89 0x0 0xffffffff 0x8a 0x0>;
				compatible = "wt,hx83112f_fhdp_wt_dsi_vdo_cphy_90hz_txd";
				pinctrl-names = "default";
				pm-enable-gpios = <0xffffffff 0x88 0x0>;
				reg = <0x3>;
				reset-gpios = <0xffffffff 0x56 0x0>;

				port {

					endpoint {
						phandle = <0x63>;
						remote-endpoint = <0xa>;
					};
				};
			};

			panel5@0 {
				bias-gpios = <0xffffffff 0x89 0x0 0xffffffff 0x8a 0x0>;
				compatible = "wt,nt36672c_fhdp_wt_dsi_vdo_cphy_90hz_djn";
				pinctrl-names = "default";
				pm-enable-gpios = <0xffffffff 0x88 0x0>;
				reg = <0x4>;
				reset-gpios = <0xffffffff 0x56 0x0>;

				port {

					endpoint {
						phandle = <0x64>;
						remote-endpoint = <0xa>;
					};
				};
			};

			panel6@0 {
				bias-gpios = <0xffffffff 0x89 0x0 0xffffffff 0x8a 0x0>;
				compatible = "wt,hx83112f_fhdp_wt_dsi_vdo_cphy_90hz_jdi";
				pinctrl-names = "default";
				pm-enable-gpios = <0xffffffff 0x88 0x0>;
				reg = <0x5>;
				reset-gpios = <0xffffffff 0x56 0x0>;

				port {

					endpoint {
						phandle = <0x65>;
						remote-endpoint = <0xa>;
					};
				};
			};

			panel7@0 {
				bias-gpios = <0xffffffff 0x89 0x0 0xffffffff 0x8a 0x0>;
				compatible = "wt,virtual_dsi_vdo_default";
				pinctrl-names = "default";
				pm-enable-gpios = <0xffffffff 0x88 0x0>;
				reg = <0x6>;
				reset-gpios = <0xffffffff 0x56 0x0>;

				port {

					endpoint {
						phandle = <0x66>;
						remote-endpoint = <0xa>;
					};
				};
			};

			ports {

				port {

					endpoint {
						phandle = <0xa>;
						remote-endpoint = <0xb>;
					};
				};
			};
		};
	};

	fragment@13 {
		target = <0xffffffff>;

		__overlay__ {

			lcm_bias@3e {
				compatible = "WT,I2C_LCD_BIAS";
				phandle = <0x67>;
				reg = <0x3e>;
				status = "okay";
			};
		};
	};

	fragment@14 {
		target = <0xffffffff>;

		__overlay__ {
			status = "ok";

			novatek@0 {
				compatible = "novatek,NVT-ts-spi", "mediatek,7807s_touch", "focaltech,ft8722", "himax,common";
				novatek,area-size = <0x38 0x70 0x3c>;
				novatek,enable_settings_aot;
				novatek,fw_name = "novatek_ts_fw.bin", "tsp_novatek/TM_0658_FHDp_Samsung-N22_Wingtech_PID7223_TP.bin";
				novatek,fw_name_mp = "novatek_ts_mp.bin", "tsp_novatek/TM_0658_FHDp_Samsung-N22_Wingtech_PID7223_MP.bin";
				novatek,irq-gpio = <0xffffffff 0xe 0x2001>;
				novatek,max_touch_num = <0xa>;
				novatek,mp-support-dt;
				novatek,reset-gpio = <0xffffffff 0xf 0x0>;
				novatek,resolution = <0x438 0x968>;
				novatek,spi-rd-fast-addr = <0x3f310>;
				novatek,swrst-n8-addr = <0x3f0fe>;
				reg = <0x0>;
				spi-max-frequency = <0x927c00>;
				status = "ok";

				novatek-mp-criteria-7223@0 {
					AIN_KEY = <0x0 0x1 0x2 0xff>;
					AIN_X = <0x0 0x1 0x2 0x3 0x4 0x5 0x6 0x7 0x8 0x9 0xa 0xb 0xc 0xd 0xe 0xf>;
					AIN_Y = <0x0 0x1 0x2 0x3 0x4 0x5 0x6 0x7 0x8 0x9 0xa 0xb 0xc 0xd 0xe 0xf 0x10 0x11 0x12 0x13 0x14 0x15 0x16 0x17 0x18 0x19 0x1a 0x1b 0x1c 0x1d 0x1e 0x1f 0x20 0x21 0x22 0x23>;
					FDM_X_Channel = <0x2>;
					IC_KEY_CFG_SIZE = <0x4>;
					IC_X_CFG_SIZE = <0x10>;
					IC_Y_CFG_SIZE = <0x24>;
					PS_Config_Diff_Test_Frame = <0x32>;
					PS_Config_FDM_Noise_Test_Frame = <0x32>;
					PS_Config_Lmt_FDM_Diff_N = <0xffffff4c 0xffffff4c 0xffffff4c 0xffffff4c 0xffffff4c 0xffffff4c 0xffffff4c 0xffffff4c 0xffffff4c 0xffffff4c 0xffffff4c 0xffffff4c 0xffffff4c 0xffffff4c 0xffffff4c 0xffffff4c 0xffffff4c 0xffffff4c 0xffffff4c 0xffffff4c 0xffffff4c 0xffffff4c 0xffffff4c 0xffffff4c 0xffffff4c 0xffffff4c 0xffffff4c 0xffffff4c 0xffffff4c 0xffffff4c 0xffffff4c 0xffffff4c 0xffffff4c 0xffffff4c 0xffffff4c 0xffffff4c 0xffffff4c 0xffffff4c 0xffffff4c 0xffffff4c 0xffffff4c 0xffffff4c 0xffffff4c 0xffffff4c 0xffffff4c 0xffffff4c 0xffffff4c 0xffffff4c 0xffffff4c 0xffffff4c 0xffffff4c 0xffffff4c 0xffffff4c 0xffffff4c 0xffffff4c 0xffffff4c 0xffffff4c 0xffffff4c 0xffffff4c 0xffffff4c 0xffffff4c 0xffffff4c 0xffffff4c 0xffffff4c 0xffffff4c 0xffffff4c 0xffffff4c 0xffffff4c 0xffffff4c 0xffffff4c 0xffffff4c 0xffffff4c 0xffffff4c 0xffffff4c 0xffffff4c 0xffffff4c 0xffffff4c 0xffffff4c 0xffffff4c 0xffffff4c>;
					PS_Config_Lmt_FDM_Diff_P = <0xb4 0xb4 0xb4 0xb4 0xb4 0xb4 0xb4 0xb4 0xb4 0xb4 0xb4 0xb4 0xb4 0xb4 0xb4 0xb4 0xb4 0xb4 0xb4 0xb4 0xb4 0xb4 0xb4 0xb4 0xb4 0xb4 0xb4 0xb4 0xb4 0xb4 0xb4 0xb4 0xb4 0xb4 0xb4 0xb4 0xb4 0xb4 0xb4 0xb4 0xb4 0xb4 0xb4 0xb4 0xb4 0xb4 0xb4 0xb4 0xb4 0xb4 0xb4 0xb4 0xb4 0xb4 0xb4 0xb4 0xb4 0xb4 0xb4 0xb4 0xb4 0xb4 0xb4 0xb4 0xb4 0xb4 0xb4 0xb4 0xb4 0xb4 0xb4 0xb4 0xb4 0xb4 0xb4 0xb4 0xb4 0xb4 0xb4 0xb4>;
					PS_Config_Lmt_FDM_Rawdata_N = <0x32 0x32 0x32 0x32 0x32 0x32 0x32 0x32 0x32 0x32 0x32 0x32 0x32 0x32 0x32 0x32 0x32 0x32 0x32 0x32 0x32 0x32 0x32 0x32 0x32 0x32 0x32 0x32 0x32 0x32 0x32 0x32 0x32 0x32 0x32 0x32 0x32 0x32 0x32 0x32 0x32 0x32 0x32 0x32 0x32 0x32 0x32 0x32 0x32 0x32 0x32 0x32 0x32 0x32 0x32 0x32 0x32 0x32 0x32 0x32 0x32 0x32 0x32 0x32 0x32 0x32 0x32 0x32 0x32 0x32 0x32 0x32 0x32 0x32 0x32 0x32 0x32 0x32 0x32 0x32>;
					PS_Config_Lmt_FDM_Rawdata_P = <0x384 0x384 0x384 0x384 0x384 0x384 0x384 0x384 0x384 0x384 0x384 0x384 0x384 0x384 0x384 0x384 0x384 0x384 0x384 0x384 0x384 0x384 0x384 0x384 0x384 0x384 0x384 0x384 0x384 0x384 0x384 0x384 0x384 0x384 0x384 0x384 0x384 0x384 0x384 0x384 0x384 0x384 0x384 0x384 0x384 0x384 0x384 0x384 0x384 0x384 0x384 0x384 0x384 0x384 0x384 0x384 0x384 0x384 0x384 0x384 0x384 0x384 0x384 0x384 0x384 0x384 0x384 0x384 0x384 0x384 0x384 0x384 0x384 0x384 0x384 0x384 0x384 0x384 0x384 0x384>;
					PS_Config_Lmt_FW_CC_N = <0x11 0x12 0x12 0x12 0x12 0x12 0x12 0xffff0001 0xffff0001 0x13 0x13 0x13 0x13 0x13 0x12 0x12 0x13 0x13 0x13 0x13 0x13 0x13 0x13 0x13 0x13 0x12 0x12 0x12 0x12 0x12 0x12 0x13 0x13 0x12 0x12 0x12 0x12 0x12 0x12 0x12 0x12 0x13 0x12 0x12 0x12 0x13 0x12 0x13 0x13 0x13 0x13 0x13 0x13 0x13 0x13 0x13 0x12 0x12 0x12 0x12 0x12 0x12 0x12 0x13 0x13 0x12 0x12 0x12 0x12 0x12 0x12 0x12 0x13 0x13 0x13 0x13 0x13 0x13 0x13 0x13 0x13 0x13 0x13 0x13 0x13 0x13 0x13 0x13 0x12 0x12 0x12 0x12 0x12 0x12 0x12 0x13 0x13 0x13 0x13 0x13 0x13 0x13 0x13 0x13 0x12 0x13 0x12 0x12 0x12 0x12 0x12 0x13 0x13 0x13 0x13 0x13 0x13 0x13 0x13 0x13 0x13 0x13 0x13 0x13 0x13 0x13 0x12 0x13 0x13 0x12 0x12 0x12 0x12 0x13 0x12 0x13 0x13 0x13 0x13 0x13 0x13 0x13 0x12 0x13 0x13 0x13 0x13 0x13 0x13 0x13 0x13 0x13 0x13 0x13 0x12 0x13 0x13 0x13 0x12 0x13 0x13 0x13 0x13 0x13 0x13 0x13 0x13 0x13 0x13 0x13 0x13 0x13 0x13 0x13 0x13 0x13 0x13 0x13 0x13 0x13 0x13 0x13 0x13 0x13 0x13 0x13 0x13 0x13 0x13 0x13 0x13 0x13 0x13 0x12 0x12 0x12 0x12 0x13 0x12 0x13 0x13 0x13 0x13 0x13 0x13 0x13 0x13 0x13 0x13 0x13 0x13 0x13 0x13 0x13 0x13 0x13 0x13 0x13 0x13 0x13 0x13 0x13 0x12 0x13 0x13 0x12 0x12 0x13 0x12 0x13 0x13 0x13 0x13 0x13 0x13 0x13 0x13 0x13 0x13 0x13 0x13 0x13 0x13 0x13 0x13 0x13 0x13 0x13 0x13 0x13 0x13 0x13 0x13 0x12 0x12 0x13 0x13 0x12 0x12 0x13 0x13 0x13 0x13 0x13 0x13 0x13 0x13 0x13 0x13 0x13 0x12 0x13 0x13 0x13 0x13 0x13 0x13 0x13 0x13 0x13 0x13 0x13 0x13 0x13 0x12 0x12 0x12 0x13 0x13 0x12 0x12 0x12 0x12 0x12 0x12 0x12 0x13 0x12 0x12 0x12 0x12 0x12 0x12 0x13 0x13 0x12 0x12 0x12 0x12 0x12 0x12 0x12 0x13 0x12 0x12 0x12 0x12 0x12 0x12 0x13 0x13 0x12 0x12 0x12 0x12 0x12 0x12 0x12 0x13 0x13 0x13 0x13 0x13 0x13 0x13 0x13 0x13 0x13 0x13 0x13 0x12 0x12 0x13 0x13 0x13 0x12 0x12 0x12 0x13 0x13 0x13 0x13 0x13 0x12 0x12 0x12 0x12 0x12 0x13 0x12 0x13 0x13 0x13 0x13 0x13 0x13 0x13 0x13 0x13 0x13 0x12 0x13 0x12 0x12 0x13 0x13 0x13 0x12 0x12 0x12 0x13 0x13 0x13 0x13 0x13 0x13 0x13 0x13 0x13 0x13 0x13 0x13 0x13 0x13 0x13 0x12 0x13 0x13 0x13 0x13 0x13 0x13 0x13 0x13 0x13 0x13 0x13 0x13 0x13 0x13 0x13 0x13 0x13 0x13 0x13 0x13 0x13 0x12 0x12 0x12 0x12 0x12 0x13 0x13 0x12 0x12 0x12 0x12 0x12 0x13 0x13 0x13 0x13 0x13 0x13 0x13 0x13 0x13 0x13 0x13 0x13 0x13 0x13 0x13 0x13 0x13 0x13 0x13 0x13 0x12 0x12 0x12 0x12 0x12 0x12 0x12 0x12 0x12 0x12 0x12 0x12 0x12 0x12 0x13 0x13 0x12 0x13 0x12 0x12 0x12 0x13 0x13 0x12 0x12 0x12 0x12 0x12 0x12 0x12 0x13 0x13 0x12 0x12 0x12 0x12 0x12 0x12 0x12 0x12 0x13 0x12 0x12 0x13 0x13 0x13 0x13 0x13 0x13 0x13 0x13 0x13 0x13 0x13 0x13 0x12 0x12 0x12 0x12 0x12 0x13 0x12 0x13 0x12 0x12 0x12 0x12 0x12 0x12 0x12 0x12 0x12 0x12 0x12 0x12 0x12 0x12 0x12 0x13 0x13 0x12 0x13 0x12 0x12 0x12 0x13 0x13 0x13 0x13 0x12 0x12 0x12 0x12 0x12 0x13 0x12 0x12 0x12 0x12 0x12 0x12 0x12 0x12 0x12 0x12 0x12 0x12 0x12 0x12 0x12 0x12 0x12 0x13 0x13 0x13 0x13 0x13 0x13 0x13 0x13 0x13 0x12 0x13 0x12 0x12 0x12 0x12 0x0 0x0 0x0>;
					PS_Config_Lmt_FW_CC_P = <0x28 0x29 0x29 0x29 0x29 0x29 0x29 0xffff 0xffff 0x2a 0x2a 0x2a 0x2a 0x2a 0x29 0x29 0x2a 0x2a 0x2a 0x2a 0x2a 0x2a 0x2a 0x2a 0x2a 0x29 0x29 0x29 0x29 0x29 0x29 0x2a 0x2a 0x29 0x29 0x29 0x29 0x29 0x29 0x29 0x29 0x2a 0x29 0x29 0x29 0x2a 0x29 0x2a 0x2a 0x2a 0x2a 0x2a 0x2a 0x2a 0x2a 0x2a 0x29 0x29 0x29 0x29 0x29 0x29 0x29 0x2a 0x2a 0x29 0x29 0x29 0x29 0x29 0x29 0x29 0x2a 0x2a 0x2a 0x2a 0x2a 0x2a 0x2a 0x2a 0x2c 0x2a 0x2a 0x2a 0x2a 0x2a 0x2a 0x2a 0x29 0x29 0x29 0x29 0x29 0x29 0x29 0x2a 0x2a 0x2a 0x2a 0x2a 0x2a 0x2a 0x2a 0x2a 0x29 0x2a 0x29 0x29 0x29 0x29 0x29 0x2a 0x2a 0x2a 0x2a 0x2a 0x2a 0x2a 0x2a 0x2a 0x2a 0x2a 0x2a 0x2a 0x2a 0x2a 0x29 0x2a 0x2a 0x29 0x29 0x29 0x29 0x2a 0x29 0x2a 0x2a 0x2a 0x2a 0x2a 0x2a 0x2a 0x29 0x2a 0x2a 0x2a 0x2a 0x2a 0x2a 0x2a 0x2a 0x2a 0x2a 0x2a 0x29 0x2a 0x2a 0x2a 0x29 0x2a 0x2a 0x2a 0x2a 0x2a 0x2a 0x2a 0x2a 0x2a 0x2a 0x2a 0x2a 0x2a 0x2a 0x2a 0x2a 0x2a 0x2a 0x2a 0x2a 0x2a 0x2a 0x2a 0x2a 0x2c 0x2a 0x2a 0x2a 0x2a 0x2a 0x2a 0x2a 0x2c 0x2a 0x29 0x29 0x29 0x29 0x2a 0x29 0x2a 0x2a 0x2a 0x2a 0x2a 0x2a 0x2a 0x2a 0x2a 0x2a 0x2a 0x2a 0x2a 0x2a 0x2a 0x2a 0x2c 0x2a 0x2a 0x2a 0x2a 0x2a 0x2a 0x29 0x2a 0x2a 0x29 0x29 0x2a 0x29 0x2a 0x2a 0x2a 0x2a 0x2a 0x2a 0x2a 0x2a 0x2a 0x2a 0x2a 0x2c 0x2a 0x2a 0x2a 0x2a 0x2c 0x2c 0x2c 0x2a 0x2a 0x2a 0x2a 0x2a 0x29 0x29 0x2a 0x2a 0x29 0x29 0x2a 0x2a 0x2a 0x2a 0x2a 0x2a 0x2a 0x2a 0x2a 0x2a 0x2a 0x29 0x2a 0x2a 0x2a 0x2a 0x2a 0x2a 0x2a 0x2a 0x2c 0x2a 0x2a 0x2a 0x2a 0x29 0x29 0x29 0x2a 0x2a 0x29 0x29 0x29 0x29 0x29 0x29 0x29 0x2a 0x29 0x29 0x29 0x29 0x29 0x29 0x2a 0x2a 0x29 0x29 0x29 0x29 0x29 0x29 0x29 0x2a 0x29 0x29 0x29 0x29 0x29 0x29 0x2a 0x2a 0x29 0x29 0x29 0x29 0x29 0x29 0x29 0x2a 0x2a 0x2a 0x2a 0x2a 0x2a 0x2a 0x2a 0x2c 0x2a 0x2a 0x2a 0x29 0x29 0x2a 0x2a 0x2a 0x29 0x29 0x29 0x2a 0x2a 0x2a 0x2a 0x2a 0x29 0x29 0x29 0x29 0x29 0x2a 0x29 0x2a 0x2a 0x2a 0x2a 0x2a 0x2a 0x2a 0x2a 0x2a 0x2a 0x29 0x2a 0x29 0x29 0x2a 0x2a 0x2a 0x29 0x29 0x29 0x2a 0x2a 0x2a 0x2a 0x2a 0x2a 0x2a 0x2a 0x2a 0x2a 0x2a 0x2a 0x2a 0x2a 0x2a 0x29 0x2a 0x2a 0x2a 0x2a 0x2c 0x2a 0x2a 0x2a 0x2a 0x2a 0x2a 0x2a 0x2a 0x2a 0x2a 0x2a 0x2a 0x2a 0x2a 0x2a 0x2a 0x29 0x29 0x29 0x29 0x29 0x2a 0x2a 0x29 0x29 0x29 0x29 0x29 0x2a 0x2a 0x2a 0x2c 0x2a 0x2a 0x2a 0x2a 0x2a 0x2a 0x2a 0x2a 0x2a 0x2a 0x2a 0x2a 0x2a 0x2a 0x2a 0x2a 0x29 0x29 0x29 0x29 0x29 0x29 0x29 0x29 0x29 0x29 0x29 0x29 0x29 0x29 0x2a 0x2a 0x29 0x2a 0x29 0x29 0x29 0x2a 0x2a 0x29 0x29 0x29 0x29 0x29 0x29 0x29 0x2a 0x2a 0x29 0x29 0x29 0x29 0x29 0x29 0x29 0x29 0x2a 0x29 0x29 0x2a 0x2a 0x2a 0x2a 0x2a 0x2a 0x2a 0x2a 0x2a 0x2a 0x2a 0x2a 0x29 0x29 0x29 0x29 0x29 0x2a 0x29 0x2a 0x29 0x29 0x29 0x29 0x29 0x29 0x29 0x29 0x29 0x29 0x29 0x29 0x29 0x29 0x29 0x2a 0x2a 0x29 0x2a 0x29 0x29 0x29 0x2a 0x2a 0x2a 0x2a 0x29 0x29 0x29 0x29 0x29 0x2a 0x29 0x29 0x29 0x29 0x29 0x29 0x29 0x29 0x29 0x29 0x29 0x29 0x29 0x29 0x29 0x29 0x29 0x2a 0x2a 0x2a 0x2a 0x2a 0x2a 0x2a 0x2a 0x2a 0x29 0x2a 0x29 0x29 0x29 0x29 0x13a 0x13a 0x13a>;
					PS_Config_Lmt_FW_Diff_N = <0xffffffce 0xffffffce 0xffffffce 0xffffffce 0xffffffce 0xffffffce 0xffffffce 0xffff0001 0xffff0001 0xffffffce 0xffffffce 0xffffffce 0xffffffce 0xffffffce 0xffffffce 0xffffffce 0xffffffce 0xffffffce 0xffffffce 0xffffffce 0xffffffce 0xffffffce 0xffffffce 0xffffffce 0xffffffce 0xffffffce 0xffffffce 0xffffffce 0xffffffce 0xffffffce 0xffffffce 0xffffffce 0xffffffce 0xffffffce 0xffffffce 0xffffffce 0xffffffce 0xffffffce 0xffffffce 0xffffffce 0xffffffce 0xffffffce 0xffffffce 0xffffffce 0xffffffce 0xffffffce 0xffffffce 0xffffffce 0xffffffce 0xffffffce 0xffffffce 0xffffffce 0xffffffce 0xffffffce 0xffffffce 0xffffffce 0xffffffce 0xffffffce 0xffffffce 0xffffffce 0xffffffce 0xffffffce 0xffffffce 0xffffffce 0xffffffce 0xffffffce 0xffffffce 0xffffffce 0xffffffce 0xffffffce 0xffffffce 0xffffffce 0xffffffce 0xffffffce 0xffffffce 0xffffffce 0xffffffce 0xffffffce 0xffffffce 0xffffffce 0xffffffce 0xffffffce 0xffffffce 0xffffffce 0xffffffce 0xffffffce 0xffffffce 0xffffffce 0xffffffce 0xffffffce 0xffffffce 0xffffffce 0xffffffce 0xffffffce 0xffffffce 0xffffffce 0xffffffce 0xffffffce 0xffffffce 0xffffffce 0xffffffce 0xffffffce 0xffffffce 0xffffffce 0xffffffce 0xffffffce 0xffffffce 0xffffffce 0xffffffce 0xffffffce 0xffffffce 0xffffffce 0xffffffce 0xffffffce 0xffffffce 0xffffffce 0xffffffce 0xffffffce 0xffffffce 0xffffffce 0xffffffce 0xffffffce 0xffffffce 0xffffffce 0xffffffce 0xffffffce 0xffffffce 0xffffffce 0xffffffce 0xffffffce 0xffffffce 0xffffffce 0xffffffce 0xffffffce 0xffffffce 0xffffffce 0xffffffce 0xffffffce 0xffffffce 0xffffffce 0xffffffce 0xffffffce 0xffffffce 0xffffffce 0xffffffce 0xffffffce 0xffffffce 0xffffffce 0xffffffce 0xffffffce 0xffffffce 0xffffffce 0xffffffce 0xffffffce 0xffffffce 0xffffffce 0xffffffce 0xffffffce 0xffffffce 0xffffffce 0xffffffce 0xffffffce 0xffffffce 0xffffffce 0xffffffce 0xffffffce 0xffffffce 0xffffffce 0xffffffce 0xffffffce 0xffffffce 0xffffffce 0xffffffce 0xffffffce 0xffffffce 0xffffffce 0xffffffce 0xffffffce 0xffffffce 0xffffffce 0xffffffce 0xffffffce 0xffffffce 0xffffffce 0xffffffce 0xffffffce 0xffffffce 0xffffffce 0xffffffce 0xffffffce 0xffffffce 0xffffffce 0xffffffce 0xffffffce 0xffffffce 0xffffffce 0xffffffce 0xffffffce 0xffffffce 0xffffffce 0xffffffce 0xffffffce 0xffffffce 0xffffffce 0xffffffce 0xffffffce 0xffffffce 0xffffffce 0xffffffce 0xffffffce 0xffffffce 0xffffffce 0xffffffce 0xffffffce 0xffffffce 0xffffffce 0xffffffce 0xffffffce 0xffffffce 0xffffffce 0xffffffce 0xffffffce 0xffffffce 0xffffffce 0xffffffce 0xffffffce 0xffffffce 0xffffffce 0xffffffce 0xffffffce 0xffffffce 0xffffffce 0xffffffce 0xffffffce 0xffffffce 0xffffffce 0xffffffce 0xffffffce 0xffffffce 0xffffffce 0xffffffce 0xffffffce 0xffffffce 0xffffffce 0xffffffce 0xffffffce 0xffffffce 0xffffffce 0xffffffce 0xffffffce 0xffffffce 0xffffffce 0xffffffce 0xffffffce 0xffffffce 0xffffffce 0xffffffce 0xffffffce 0xffffffce 0xffffffce 0xffffffce 0xffffffce 0xffffffce 0xffffffce 0xffffffce 0xffffffce 0xffffffce 0xffffffce 0xffffffce 0xffffffce 0xffffffce 0xffffffce 0xffffffce 0xffffffce 0xffffffce 0xffffffce 0xffffffce 0xffffffce 0xffffffce 0xffffffce 0xffffffce 0xffffffce 0xffffffce 0xffffffce 0xffffffce 0xffffffce 0xffffffce 0xffffffce 0xffffffce 0xffffffce 0xffffffce 0xffffffce 0xffffffce 0xffffffce 0xffffffce 0xffffffce 0xffffffce 0xffffffce 0xffffffce 0xffffffce 0xffffffce 0xffffffce 0xffffffce 0xffffffce 0xffffffce 0xffffffce 0xffffffce 0xffffffce 0xffffffce 0xffffffce 0xffffffce 0xffffffce 0xffffffce 0xffffffce 0xffffffce 0xffffffce 0xffffffce 0xffffffce 0xffffffce 0xffffffce 0xffffffce 0xffffffce 0xffffffce 0xffffffce 0xffffffce 0xffffffce 0xffffffce 0xffffffce 0xffffffce 0xffffffce 0xffffffce 0xffffffce 0xffffffce 0xffffffce 0xffffffce 0xffffffce 0xffffffce 0xffffffce 0xffffffce 0xffffffce 0xffffffce 0xffffffce 0xffffffce 0xffffffce 0xffffffce 0xffffffce 0xffffffce 0xffffffce 0xffffffce 0xffffffce 0xffffffce 0xffffffce 0xffffffce 0xffffffce 0xffffffce 0xffffffce 0xffffffce 0xffffffce 0xffffffce 0xffffffce 0xffffffce 0xffffffce 0xffffffce 0xffffffce 0xffffffce 0xffffffce 0xffffffce 0xffffffce 0xffffffce 0xffffffce 0xffffffce 0xffffffce 0xffffffce 0xffffffce 0xffffffce 0xffffffce 0xffffffce 0xffffffce 0xffffffce 0xffffffce 0xffffffce 0xffffffce 0xffffffce 0xffffffce 0xffffffce 0xffffffce 0xffffffce 0xffffffce 0xffffffce 0xffffffce 0xffffffce 0xffffffce 0xffffffce 0xffffffce 0xffffffce 0xffffffce 0xffffffce 0xffffffce 0xffffffce 0xffffffce 0xffffffce 0xffffffce 0xffffffce 0xffffffce 0xffffffce 0xffffffce 0xffffffce 0xffffffce 0xffffffce 0xffffffce 0xffffffce 0xffffffce 0xffffffce 0xffffffce 0xffffffce 0xffffffce 0xffffffce 0xffffffce 0xffffffce 0xffffffce 0xffffffce 0xffffffce 0xffffffce 0xffffffce 0xffffffce 0xffffffce 0xffffffce 0xffffffce 0xffffffce 0xffffffce 0xffffffce 0xffffffce 0xffffffce 0xffffffce 0xffffffce 0xffffffce 0xffffffce 0xffffffce 0xffffffce 0xffffffce 0xffffffce 0xffffffce 0xffffffce 0xffffffce 0xffffffce 0xffffffce 0xffffffce 0xffffffce 0xffffffce 0xffffffce 0xffffffce 0xffffffce 0xffffffce 0xffffffce 0xffffffce 0xffffffce 0xffffffce 0xffffffce 0xffffffce 0xffffffce 0xffffffce 0xffffffce 0xffffffce 0xffffffce 0xffffffce 0xffffffce 0xffffffce 0xffffffce 0xffffffce 0xffffffce 0xffffffce 0xffffffce 0xffffffce 0xffffffce 0xffffffce 0xffffffce 0xffffffce 0xffffffce 0xffffffce 0xffffffce 0xffffffce 0xffffffce 0xffffffce 0xffffffce 0xffffffce 0xffffffce 0xffffffce 0xffffffce 0xffffffce 0xffffffce 0xffffffce 0xffffffce 0xffffffce 0xffffffce 0xffffffce 0xffffffce 0xffffffce 0xffffffce 0xffffffce 0xffffffce 0xffffffce 0xffffffce 0xffffffce 0xffffffce 0xffffffce 0xffffffce 0xffffffce 0xffffffce 0xffffffce 0xffffffce 0xffffffce 0xffffffce 0xffffffce 0xffffffce 0xffffffce 0xffffffce 0xffffffce 0xffffffce 0xffffffce 0xffffffce 0xffffffce 0xffffffce 0xffffffce 0xffffffce 0xffffffce 0xffffffce 0xffffffce 0xffffffce 0xffffffce 0xffffffce 0xffffffce 0xffffffce 0xffffffce 0xffffffce 0xffffffce 0xffffffce 0xffffffce 0xffffffce 0xffffffce 0xffffffce 0xffffffce 0xffffffce 0xffffffce 0xffffffce 0xffffffce 0xffffffce 0xffffffce 0xffffffce 0xffffffce 0xffffffce 0xffffffce 0xffffffce 0xffffffce 0xffffffce 0xffffffce 0xffffffce 0xffffffce 0xffffffce 0xffffffce 0xffffffce 0xffffffce 0xffffffce 0xffffffce 0xffffffce 0xffffffce 0xffffffce 0xffffffce 0xffffffce 0xffffffce 0xffffffce 0xffffffce 0xffffffce 0xffffffce 0xffffffce 0xffffffce 0xffffffce 0xffffffb5 0xffffffb5 0xffffffb5>;
					PS_Config_Lmt_FW_Diff_P = <0x32 0x32 0x32 0x32 0x32 0x32 0x32 0xffff 0xffff 0x32 0x32 0x32 0x32 0x32 0x32 0x32 0x32 0x32 0x32 0x32 0x32 0x32 0x32 0x32 0x32 0x32 0x32 0x32 0x32 0x32 0x32 0x32 0x32 0x32 0x32 0x32 0x32 0x32 0x32 0x32 0x32 0x32 0x32 0x32 0x32 0x32 0x32 0x32 0x32 0x32 0x32 0x32 0x32 0x32 0x32 0x32 0x32 0x32 0x32 0x32 0x32 0x32 0x32 0x32 0x32 0x32 0x32 0x32 0x32 0x32 0x32 0x32 0x32 0x32 0x32 0x32 0x32 0x32 0x32 0x32 0x32 0x32 0x32 0x32 0x32 0x32 0x32 0x32 0x32 0x32 0x32 0x32 0x32 0x32 0x32 0x32 0x32 0x32 0x32 0x32 0x32 0x32 0x32 0x32 0x32 0x32 0x32 0x32 0x32 0x32 0x32 0x32 0x32 0x32 0x32 0x32 0x32 0x32 0x32 0x32 0x32 0x32 0x32 0x32 0x32 0x32 0x32 0x32 0x32 0x32 0x32 0x32 0x32 0x32 0x32 0x32 0x32 0x32 0x32 0x32 0x32 0x32 0x32 0x32 0x32 0x32 0x32 0x32 0x32 0x32 0x32 0x32 0x32 0x32 0x32 0x32 0x32 0x32 0x32 0x32 0x32 0x32 0x32 0x32 0x32 0x32 0x32 0x32 0x32 0x32 0x32 0x32 0x32 0x32 0x32 0x32 0x32 0x32 0x32 0x32 0x32 0x32 0x32 0x32 0x32 0x32 0x32 0x32 0x32 0x32 0x32 0x32 0x32 0x32 0x32 0x32 0x32 0x32 0x32 0x32 0x32 0x32 0x32 0x32 0x32 0x32 0x32 0x32 0x32 0x32 0x32 0x32 0x32 0x32 0x32 0x32 0x32 0x32 0x32 0x32 0x32 0x32 0x32 0x32 0x32 0x32 0x32 0x32 0x32 0x32 0x32 0x32 0x32 0x32 0x32 0x32 0x32 0x32 0x32 0x32 0x32 0x32 0x32 0x32 0x32 0x32 0x32 0x32 0x32 0x32 0x32 0x32 0x32 0x32 0x32 0x32 0x32 0x32 0x32 0x32 0x32 0x32 0x32 0x32 0x32 0x32 0x32 0x32 0x32 0x32 0x32 0x32 0x32 0x32 0x32 0x32 0x32 0x32 0x32 0x32 0x32 0x32 0x32 0x32 0x32 0x32 0x32 0x32 0x32 0x32 0x32 0x32 0x32 0x32 0x32 0x32 0x32 0x32 0x32 0x32 0x32 0x32 0x32 0x32 0x32 0x32 0x32 0x32 0x32 0x32 0x32 0x32 0x32 0x32 0x32 0x32 0x32 0x32 0x32 0x32 0x32 0x32 0x32 0x32 0x32 0x32 0x32 0x32 0x32 0x32 0x32 0x32 0x32 0x32 0x32 0x32 0x32 0x32 0x32 0x32 0x32 0x32 0x32 0x32 0x32 0x32 0x32 0x32 0x32 0x32 0x32 0x32 0x32 0x32 0x32 0x32 0x32 0x32 0x32 0x32 0x32 0x32 0x32 0x32 0x32 0x32 0x32 0x32 0x32 0x32 0x32 0x32 0x32 0x32 0x32 0x32 0x32 0x32 0x32 0x32 0x32 0x32 0x32 0x32 0x32 0x32 0x32 0x32 0x32 0x32 0x32 0x32 0x32 0x32 0x32 0x32 0x32 0x32 0x32 0x32 0x32 0x32 0x32 0x32 0x32 0x32 0x32 0x32 0x32 0x32 0x32 0x32 0x32 0x32 0x32 0x32 0x32 0x32 0x32 0x32 0x32 0x32 0x32 0x32 0x32 0x32 0x32 0x32 0x32 0x32 0x32 0x32 0x32 0x32 0x32 0x32 0x32 0x32 0x32 0x32 0x32 0x32 0x32 0x32 0x32 0x32 0x32 0x32 0x32 0x32 0x32 0x32 0x32 0x32 0x32 0x32 0x32 0x32 0x32 0x32 0x32 0x32 0x32 0x32 0x32 0x32 0x32 0x32 0x32 0x32 0x32 0x32 0x32 0x32 0x32 0x32 0x32 0x32 0x32 0x32 0x32 0x32 0x32 0x32 0x32 0x32 0x32 0x32 0x32 0x32 0x32 0x32 0x32 0x32 0x32 0x32 0x32 0x32 0x32 0x32 0x32 0x32 0x32 0x32 0x32 0x32 0x32 0x32 0x32 0x32 0x32 0x32 0x32 0x32 0x32 0x32 0x32 0x32 0x32 0x32 0x32 0x32 0x32 0x32 0x32 0x32 0x32 0x32 0x32 0x32 0x32 0x32 0x32 0x32 0x32 0x32 0x32 0x32 0x32 0x32 0x32 0x32 0x32 0x32 0x32 0x32 0x32 0x32 0x32 0x32 0x32 0x32 0x32 0x32 0x32 0x32 0x32 0x32 0x32 0x32 0x32 0x32 0x32 0x32 0x32 0x32 0x32 0x32 0x32 0x32 0x32 0x32 0x32 0x32 0x32 0x32 0x4b 0x4b 0x4b>;
					PS_Config_Lmt_FW_Rawdata_N = <0x1ed 0x1cf 0x1db 0x1df 0x1da 0x1e6 0x1e4 0xffff0001 0xffff0001 0x1de 0x1dd 0x1dd 0x1db 0x1dc 0x1d4 0x1dc 0x1dd 0x1e1 0x1e3 0x1e3 0x1dc 0x1e2 0x1e5 0x1de 0x1e0 0x1de 0x1e2 0x1dd 0x1dd 0x1e1 0x1e1 0x1e2 0x1ea 0x1da 0x1de 0x1e2 0x1d8 0x1dc 0x1dd 0x1e0 0x1de 0x1dd 0x1db 0x1da 0x1d9 0x1dd 0x1e0 0x1e3 0x1e7 0x1d5 0x1de 0x1de 0x1d8 0x1db 0x1dc 0x1e4 0x1e3 0x1e4 0x1e3 0x1e5 0x1e6 0x1e7 0x1e3 0x1d6 0x1d5 0x1ee 0x1e6 0x1db 0x1e9 0x1da 0x1da 0x1da 0x1dc 0x1dd 0x1d7 0x1e1 0x1d8 0x1da 0x1dd 0x1dd 0x1e4 0x1da 0x1de 0x1dc 0x1dd 0x1da 0x1dd 0x1de 0x1dd 0x1e1 0x1e9 0x1e7 0x1ec 0x1e4 0x1e4 0x1d3 0x1df 0x1da 0x1de 0x1dc 0x1db 0x1d9 0x1d8 0x1d9 0x1db 0x1de 0x1de 0x1df 0x1df 0x1dd 0x1d8 0x1e2 0x1e5 0x1d5 0x1da 0x1db 0x1d6 0x1da 0x1d8 0x1dd 0x1db 0x1dc 0x1d9 0x1d8 0x1d8 0x1d4 0x1da 0x1de 0x1db 0x1e0 0x1de 0x1e2 0x1de 0x1e4 0x1e2 0x1e3 0x1da 0x1d9 0x1d6 0x1d5 0x1d4 0x1d5 0x1d9 0x1de 0x1dd 0x1e0 0x1e3 0x1e6 0x1e8 0x1e9 0x1e8 0x1db 0x1d8 0x1d9 0x1db 0x1da 0x1d8 0x1d7 0x1e3 0x1dd 0x1dd 0x1db 0x1d7 0x1d8 0x1dd 0x1d9 0x1d5 0x1dd 0x1dc 0x1db 0x1d9 0x1d8 0x1d8 0x1da 0x1d6 0x1de 0x1e0 0x1d4 0x1d7 0x1da 0x1d9 0x1dc 0x1db 0x1e3 0x1db 0x1da 0x1df 0x1e0 0x1e0 0x1dc 0x1d7 0x1e1 0x1e4 0x1db 0x1e0 0x1e2 0x1e0 0x1e0 0x1de 0x1e4 0x1d9 0x1da 0x1d4 0x1d4 0x1d4 0x1d4 0x1d4 0x1e3 0x1e1 0x1dd 0x1de 0x1de 0x1dd 0x1e4 0x1e0 0x1e0 0x1da 0x1e0 0x1d8 0x1d7 0x1d8 0x1d4 0x1d7 0x1e7 0x1d7 0x1e4 0x1e3 0x1dd 0x1e2 0x1da 0x1d8 0x1dd 0x1dd 0x1e3 0x1d0 0x1d6 0x1d5 0x1d3 0x1d2 0x1e3 0x1dd 0x1df 0x1e0 0x1e1 0x1e5 0x1de 0x1dd 0x1e1 0x1d8 0x1da 0x1d7 0x1d8 0x1d4 0x1d8 0x1d5 0x1e0 0x1df 0x1de 0x1e2 0x1db 0x1da 0x1de 0x1de 0x1dd 0x1e1 0x1e5 0x1e4 0x1e5 0x1e4 0x1e1 0x1e6 0x1e0 0x1dd 0x1de 0x1e1 0x1d7 0x1da 0x1e1 0x1e0 0x1d7 0x1dd 0x1e5 0x1e6 0x1db 0x1dd 0x1de 0x1da 0x1db 0x1df 0x1db 0x1db 0x1d8 0x1d4 0x1de 0x1db 0x1d7 0x1d8 0x1de 0x1dc 0x1df 0x1de 0x1df 0x1e1 0x1e1 0x1df 0x1e1 0x1e0 0x1de 0x1de 0x1e3 0x1e4 0x1e2 0x1e1 0x1dd 0x1e1 0x1df 0x1e1 0x1e1 0x1db 0x1de 0x1e0 0x1db 0x1da 0x1da 0x1de 0x1d8 0x1d7 0x1d5 0x1e0 0x1dd 0x1da 0x1d5 0x1dc 0x1dd 0x1d8 0x1e4 0x1db 0x1e3 0x1dd 0x1de 0x1d9 0x1d7 0x1e2 0x1dc 0x1df 0x1de 0x1e0 0x1dd 0x1df 0x1df 0x1da 0x1e7 0x1e1 0x1d7 0x1db 0x1d7 0x1e1 0x1e1 0x1d6 0x1d8 0x1db 0x1de 0x1de 0x1dd 0x1df 0x1e0 0x1e4 0x1e0 0x1e3 0x1db 0x1e5 0x1e0 0x1e4 0x1e3 0x1d9 0x1d8 0x1d9 0x1db 0x1db 0x1dc 0x1d5 0x1d7 0x1da 0x1e3 0x1e7 0x1de 0x1da 0x1dd 0x1d7 0x1e0 0x1d9 0x1d8 0x1de 0x1de 0x1dd 0x1de 0x1e1 0x1df 0x1de 0x1d8 0x1df 0x1e3 0x1e2 0x1de 0x1de 0x1df 0x1dd 0x1dd 0x1e1 0x1de 0x1de 0x1dd 0x1e0 0x1e3 0x1e2 0x1e1 0x1e1 0x1da 0x1d7 0x1d4 0x1d1 0x1d0 0x1cf 0x1d1 0x1e1 0x1e1 0x1e1 0x1df 0x1e3 0x1e3 0x1e3 0x1d7 0x1d6 0x1da 0x1da 0x1db 0x1d8 0x1db 0x1db 0x1de 0x1da 0x1d7 0x1d7 0x1d6 0x1da 0x1db 0x1dd 0x1e6 0x1dd 0x1d5 0x1d9 0x1e9 0x1ea 0x1ee 0x1e2 0x1e9 0x1e1 0x1dd 0x1e0 0x1e1 0x1db 0x1d9 0x1da 0x1e6 0x1e3 0x1de 0x1de 0x1e0 0x1df 0x1de 0x1d9 0x1db 0x1db 0x1dd 0x1dc 0x1df 0x1da 0x1dc 0x1db 0x1dd 0x1e1 0x1e0 0x1e0 0x1da 0x1db 0x1da 0x1e0 0x1df 0x1db 0x1de 0x1db 0x1d9 0x1db 0x1de 0x1da 0x1e4 0x1e4 0x1d1 0x1da 0x1d7 0x1d0 0x1d8 0x1d8 0x1ce 0x1e8 0x1e4 0x1d8 0x1e0 0x1d8 0x1df 0x1d8 0x1e6 0x1dd 0x1db 0x1da 0x1dd 0x1de 0x1da 0x1d8 0x1da 0x1e1 0x1e4 0x1e0 0x1e0 0x1de 0x1e4 0x1dd 0x1dd 0x1d9 0x1e1 0x1e3 0x1e0 0x1e2 0x1e3 0x1e1 0x1e3 0x1e0 0x1db 0x1da 0x1db 0x1dc 0x1dd 0x1df 0x1db 0x1e0 0x1db 0x1e0 0x1de 0x1e1 0x1e0 0x1e0 0x1df 0x1e4 0x1e3 0x1de 0x1de 0x1de 0x1e1 0x1e4 0x1db 0x1e0 0x1db 0x1db 0x1da 0x1e0 0x1df 0x1e1 0x1dd 0x1dd 0x1e4 0x1e5 0x1e3 0x1dd 0x1db 0x1db 0x1d4 0xf0 0xf0 0xf0>;
					PS_Config_Lmt_FW_Rawdata_P = <0x47e 0x438 0x454 0x45e 0x453 0x46f 0x469 0xffff 0xffff 0x45b 0x45a 0x459 0x454 0x457 0x444 0x457 0x459 0x462 0x467 0x468 0x457 0x465 0x46c 0x45d 0x461 0x45d 0x465 0x459 0x45a 0x462 0x464 0x465 0x479 0x453 0x45d 0x465 0x44d 0x457 0x45a 0x460 0x45d 0x45a 0x454 0x452 0x450 0x45a 0x460 0x468 0x472 0x446 0x45b 0x45b 0x44f 0x456 0x457 0x46b 0x468 0x469 0x468 0x46c 0x46f 0x470 0x468 0x449 0x448 0x481 0x46f 0x456 0x475 0x453 0x453 0x452 0x457 0x45a 0x44b 0x464 0x44f 0x453 0x45a 0x45a 0x469 0x453 0x45d 0x457 0x45a 0x452 0x459 0x45b 0x45a 0x462 0x476 0x470 0x47d 0x46b 0x46b 0x442 0x45e 0x453 0x45b 0x457 0x454 0x450 0x44f 0x450 0x456 0x45b 0x45b 0x45e 0x45e 0x45a 0x44f 0x465 0x46c 0x448 0x452 0x454 0x449 0x452 0x44d 0x459 0x456 0x457 0x450 0x44d 0x44d 0x444 0x453 0x45d 0x456 0x461 0x45d 0x465 0x45d 0x46b 0x465 0x468 0x453 0x450 0x449 0x448 0x445 0x446 0x450 0x45d 0x45a 0x460 0x467 0x46e 0x473 0x475 0x473 0x454 0x44d 0x450 0x456 0x453 0x44f 0x44c 0x468 0x459 0x459 0x456 0x44c 0x44d 0x45a 0x450 0x448 0x459 0x457 0x456 0x450 0x44d 0x44d 0x452 0x449 0x45b 0x461 0x444 0x44c 0x453 0x450 0x457 0x456 0x467 0x456 0x453 0x45e 0x460 0x460 0x457 0x44c 0x464 0x469 0x454 0x460 0x465 0x460 0x461 0x45b 0x46b 0x450 0x453 0x445 0x445 0x445 0x444 0x444 0x467 0x464 0x45a 0x45d 0x45b 0x459 0x46b 0x461 0x461 0x452 0x461 0x44f 0x44b 0x44f 0x444 0x44b 0x470 0x44b 0x469 0x468 0x459 0x465 0x452 0x44d 0x45a 0x459 0x468 0x43b 0x449 0x448 0x442 0x441 0x467 0x459 0x45e 0x461 0x462 0x46c 0x45d 0x45a 0x462 0x44f 0x453 0x44b 0x44f 0x445 0x44f 0x446 0x460 0x45e 0x45b 0x465 0x456 0x452 0x45b 0x45d 0x459 0x462 0x46c 0x46b 0x46c 0x469 0x464 0x46f 0x460 0x45a 0x45b 0x464 0x44b 0x453 0x464 0x461 0x44c 0x459 0x46c 0x46f 0x456 0x45a 0x45b 0x452 0x454 0x45e 0x456 0x456 0x44f 0x445 0x45b 0x456 0x44c 0x44d 0x45d 0x457 0x45e 0x45b 0x45e 0x462 0x462 0x45e 0x464 0x461 0x45b 0x45d 0x467 0x46b 0x465 0x464 0x45a 0x462 0x45e 0x464 0x462 0x456 0x45d 0x460 0x454 0x453 0x453 0x45b 0x44d 0x44c 0x448 0x460 0x459 0x453 0x446 0x457 0x459 0x44f 0x46b 0x454 0x467 0x45a 0x45d 0x450 0x44b 0x465 0x457 0x45e 0x45b 0x460 0x459 0x45e 0x45e 0x452 0x472 0x462 0x44c 0x456 0x44b 0x462 0x464 0x449 0x44d 0x454 0x45b 0x45d 0x459 0x45e 0x461 0x469 0x460 0x468 0x456 0x46c 0x460 0x46b 0x467 0x450 0x44f 0x450 0x454 0x454 0x457 0x446 0x44b 0x452 0x467 0x472 0x45d 0x453 0x459 0x44b 0x460 0x450 0x44f 0x45d 0x45d 0x45a 0x45b 0x462 0x45e 0x45d 0x44d 0x45e 0x468 0x465 0x45d 0x45b 0x45e 0x459 0x459 0x464 0x45d 0x45b 0x45a 0x460 0x467 0x465 0x464 0x462 0x452 0x44c 0x444 0x43d 0x43b 0x43a 0x43d 0x464 0x462 0x462 0x45e 0x468 0x468 0x468 0x44b 0x449 0x452 0x452 0x454 0x44f 0x454 0x454 0x45d 0x453 0x44c 0x44b 0x449 0x452 0x456 0x45a 0x46e 0x45a 0x446 0x450 0x475 0x477 0x481 0x465 0x476 0x462 0x459 0x460 0x462 0x454 0x450 0x453 0x46e 0x468 0x45d 0x45d 0x461 0x45e 0x45d 0x450 0x456 0x456 0x459 0x457 0x45e 0x453 0x457 0x456 0x459 0x462 0x460 0x461 0x453 0x454 0x453 0x460 0x45e 0x456 0x45d 0x454 0x450 0x454 0x45b 0x453 0x469 0x46b 0x43e 0x452 0x44b 0x43b 0x44f 0x44d 0x436 0x473 0x46b 0x44f 0x461 0x44d 0x45e 0x44d 0x46e 0x459 0x456 0x453 0x45a 0x45b 0x453 0x44f 0x453 0x464 0x469 0x460 0x460 0x45b 0x469 0x459 0x45a 0x450 0x462 0x468 0x460 0x465 0x468 0x464 0x468 0x461 0x454 0x452 0x454 0x457 0x459 0x45e 0x456 0x460 0x456 0x460 0x45d 0x462 0x460 0x460 0x45e 0x469 0x467 0x45d 0x45b 0x45d 0x464 0x469 0x454 0x461 0x454 0x454 0x453 0x461 0x45e 0x464 0x45a 0x459 0x469 0x46c 0x468 0x45a 0x454 0x456 0x445 0xf00 0xf00 0xf00>;
					PS_Config_Lmt_LPWG_Diff_N = <0xffffffb5 0xffffffb5 0xffffffb5 0xffffffb5 0xffffffb5 0xffffffb5 0xffffffb5 0xffffffb5 0xffffffb5 0xffffffb5 0xffffffb5 0xffffffb5 0xffffffb5 0xffffffb5 0xffffffb5 0xffffffb5 0xffffffb5 0xffffffb5 0xffffffb5 0xffffffb5 0xffffffb5 0xffffffb5 0xffffffb5 0xffffffb5 0xffffffb5 0xffffffb5 0xffffffb5 0xffffffb5 0xffffffb5 0xffffffb5 0xffffffb5 0xffffffb5 0xffffffb5 0xffffffb5 0xffffffb5 0xffffffb5 0xffffffb5 0xffffffb5 0xffffffb5 0xffffffb5 0xffffffb5 0xffffffb5 0xffffffb5 0xffffffb5 0xffffffb5 0xffffffb5 0xffffffb5 0xffffffb5 0xffffffb5 0xffffffb5 0xffffffb5 0xffffffb5 0xffffffb5 0xffffffb5 0xffffffb5 0xffffffb5 0xffffffb5 0xffffffb5 0xffffffb5 0xffffffb5 0xffffffb5 0xffffffb5 0xffffffb5 0xffffffb5 0xffffffb5 0xffffffb5 0xffffffb5 0xffffffb5 0xffffffb5 0xffffffb5 0xffffffb5 0xffffffb5 0xffffffb5 0xffffffb5 0xffffffb5 0xffffffb5 0xffffffb5 0xffffffb5 0xffffffb5 0xffffffb5 0xffffffb5 0xffffffb5 0xffffffb5 0xffffffb5 0xffffffb5 0xffffffb5 0xffffffb5 0xffffffb5 0xffffffb5 0xffffffb5 0xffffffb5 0xffffffb5 0xffffffb5 0xffffffb5 0xffffffb5 0xffffffb5 0xffffffb5 0xffffffb5 0xffffffb5 0xffffffb5 0xffffffb5 0xffffffb5 0xffffffb5 0xffffffb5 0xffffffb5 0xffffffb5 0xffffffb5 0xffffffb5 0xffffffb5 0xffffffb5 0xffffffb5 0xffffffb5 0xffffffb5 0xffffffb5 0xffffffb5 0xffffffb5 0xffffffb5 0xffffffb5 0xffffffb5 0xffffffb5 0xffffffb5 0xffffffb5 0xffffffb5 0xffffffb5 0xffffffb5 0xffffffb5 0xffffffb5 0xffffffb5 0xffffffb5 0xffffffb5 0xffffffb5 0xffffffb5 0xffffffb5 0xffffffb5 0xffffffb5 0xffffffb5 0xffffffb5 0xffffffb5 0xffffffb5 0xffffffb5 0xffffffb5 0xffffffb5 0xffffffb5 0xffffffb5 0xffffffb5 0xffffffb5 0xffffffb5 0xffffffb5 0xffffffb5 0xffffffb5 0xffffffb5 0xffffffb5 0xffffffb5 0xffffffb5 0xffffffb5 0xffffffb5 0xffffffb5 0xffffffb5 0xffffffb5 0xffffffb5 0xffffffb5 0xffffffb5 0xffffffb5 0xffffffb5 0xffffffb5 0xffffffb5 0xffffffb5 0xffffffb5 0xffffffb5 0xffffffb5 0xffffffb5 0xffffffb5 0xffffffb5 0xffffffb5 0xffffffb5 0xffffffb5 0xffffffb5 0xffffffb5 0xffffffb5 0xffffffb5 0xffffffb5 0xffffffb5 0xffffffb5 0xffffffb5 0xffffffb5 0xffffffb5 0xffffffb5 0xffffffb5 0xffffffb5 0xffffffb5 0xffffffb5 0xffffffb5 0xffffffb5 0xffffffb5 0xffffffb5 0xffffffb5 0xffffffb5 0xffffffb5 0xffffffb5 0xffffffb5 0xffffffb5 0xffffffb5 0xffffffb5 0xffffffb5 0xffffffb5 0xffffffb5 0xffffffb5 0xffffffb5 0xffffffb5 0xffffffb5 0xffffffb5 0xffffffb5 0xffffffb5 0xffffffb5 0xffffffb5 0xffffffb5 0xffffffb5 0xffffffb5 0xffffffb5 0xffffffb5 0xffffffb5 0xffffffb5 0xffffffb5 0xffffffb5 0xffffffb5 0xffffffb5 0xffffffb5 0xffffffb5 0xffffffb5 0xffffffb5 0xffffffb5 0xffffffb5 0xffffffb5 0xffffffb5 0xffffffb5 0xffffffb5 0xffffffb5 0xffffffb5 0xffffffb5 0xffffffb5 0xffffffb5 0xffffffb5 0xffffffb5 0xffffffb5 0xffffffb5 0xffffffb5 0xffffffb5 0xffffffb5 0xffffffb5 0xffffffb5 0xffffffb5 0xffffffb5 0xffffffb5 0xffffffb5 0xffffffb5 0xffffffb5 0xffffffb5 0xffffffb5 0xffffffb5 0xffffffb5 0xffffffb5 0xffffffb5 0xffffffb5 0xffffffb5 0xffffffb5 0xffffffb5 0xffffffb5 0xffffffb5 0xffffffb5 0xffffffb5 0xffffffb5 0xffffffb5 0xffffffb5 0xffffffb5 0xffffffb5 0xffffffb5 0xffffffb5 0xffffffb5 0xffffffb5 0xffffffb5 0xffffffb5 0xffffffb5 0xffffffb5 0xffffffb5 0xffffffb5 0xffffffb5 0xffffffb5 0xffffffb5 0xffffffb5 0xffffffb5 0xffffffb5 0xffffffb5 0xffffffb5 0xffffffb5 0xffffffb5 0xffffffb5 0xffffffb5 0xffffffb5 0xffffffb5 0xffffffb5 0xffffffb5 0xffffffb5 0xffffffb5 0xffffffb5 0xffffffb5 0xffffffb5 0xffffffb5 0xffffffb5 0xffffffb5 0xffffffb5 0xffffffb5 0xffffffb5 0xffffffb5 0xffffffb5 0xffffffb5 0xffffffb5 0xffffffb5 0xffffffb5 0xffffffb5 0xffffffb5 0xffffffb5 0xffffffb5 0xffffffb5 0xffffffb5 0xffffffb5 0xffffffb5 0xffffffb5 0xffffffb5 0xffffffb5 0xffffffb5 0xffffffb5 0xffffffb5 0xffffffb5 0xffffffb5 0xffffffb5 0xffffffb5 0xffffffb5 0xffffffb5 0xffffffb5 0xffffffb5 0xffffffb5 0xffffffb5 0xffffffb5 0xffffffb5 0xffffffb5 0xffffffb5 0xffffffb5 0xffffffb5 0xffffffb5 0xffffffb5 0xffffffb5 0xffffffb5 0xffffffb5 0xffffffb5 0xffffffb5 0xffffffb5 0xffffffb5 0xffffffb5 0xffffffb5 0xffffffb5 0xffffffb5 0xffffffb5 0xffffffb5 0xffffffb5 0xffffffb5 0xffffffb5 0xffffffb5 0xffffffb5 0xffffffb5 0xffffffb5 0xffffffb5 0xffffffb5 0xffffffb5 0xffffffb5 0xffffffb5 0xffffffb5 0xffffffb5 0xffffffb5 0xffffffb5 0xffffffb5 0xffffffb5 0xffffffb5 0xffffffb5 0xffffffb5 0xffffffb5 0xffffffb5 0xffffffb5 0xffffffb5 0xffffffb5 0xffffffb5 0xffffffb5 0xffffffb5 0xffffffb5 0xffffffb5 0xffffffb5 0xffffffb5 0xffffffb5 0xffffffb5 0xffffffb5 0xffffffb5 0xffffffb5 0xffffffb5 0xffffffb5 0xffffffb5 0xffffffb5 0xffffffb5 0xffffffb5 0xffffffb5 0xffffffb5 0xffffffb5 0xffffffb5 0xffffffb5 0xffffffb5 0xffffffb5 0xffffffb5 0xffffffb5 0xffffffb5 0xffffffb5 0xffffffb5 0xffffffb5 0xffffffb5 0xffffffb5 0xffffffb5 0xffffffb5 0xffffffb5 0xffffffb5 0xffffffb5 0xffffffb5 0xffffffb5 0xffffffb5 0xffffffb5 0xffffffb5 0xffffffb5 0xffffffb5 0xffffffb5 0xffffffb5 0xffffffb5 0xffffffb5 0xffffffb5 0xffffffb5 0xffffffb5 0xffffffb5 0xffffffb5 0xffffffb5 0xffffffb5 0xffffffb5 0xffffffb5 0xffffffb5 0xffffffb5 0xffffffb5 0xffffffb5 0xffffffb5 0xffffffb5 0xffffffb5 0xffffffb5 0xffffffb5 0xffffffb5 0xffffffb5 0xffffffb5 0xffffffb5 0xffffffb5 0xffffffb5 0xffffffb5 0xffffffb5 0xffffffb5 0xffffffb5 0xffffffb5 0xffffffb5 0xffffffb5 0xffffffb5 0xffffffb5 0xffffffb5 0xffffffb5 0xffffffb5 0xffffffb5 0xffffffb5 0xffffffb5 0xffffffb5 0xffffffb5 0xffffffb5 0xffffffb5 0xffffffb5 0xffffffb5 0xffffffb5 0xffffffb5 0xffffffb5 0xffffffb5 0xffffffb5 0xffffffb5 0xffffffb5 0xffffffb5 0xffffffb5 0xffffffb5 0xffffffb5 0xffffffb5 0xffffffb5 0xffffffb5 0xffffffb5 0xffffffb5 0xffffffb5 0xffffffb5 0xffffffb5 0xffffffb5 0xffffffb5 0xffffffb5 0xffffffb5 0xffffffb5 0xffffffb5 0xffffffb5 0xffffffb5 0xffffffb5 0xffffffb5 0xffffffb5 0xffffffb5 0xffffffb5 0xffffffb5 0xffffffb5 0xffffffb5 0xffffffb5 0xffffffb5 0xffffffb5 0xffffffb5 0xffffffb5 0xffffffb5 0xffffffb5 0xffffffb5 0xffffffb5 0xffffffb5 0xffffffb5 0xffffffb5 0xffffffb5 0xffffffb5 0xffffffb5 0xffffffb5 0xffffffb5 0xffffffb5 0xffffffb5 0xffffffb5 0xffffffb5 0xffffffb5 0xffffffb5 0xffffffb5 0xffffffb5 0xffffffb5 0xffffffb5 0xffffffb5 0xffffffb5 0xffffffb5 0xffffffb5 0xffffffb5 0xffffffb5 0xffffffb5 0xffffffb5 0xffffffb5 0xffffffb5 0xffffffb5 0xffffffb5 0xffffffb5 0xffffffb5 0xffffffb5 0xffffffb5 0xffffffb5 0xffffffb5 0xffffffb5 0xffffffb5 0xffffffb5 0xffffffb5 0xffffffb5 0xffffffb5 0xffffffb5 0xffffffb5 0xffffffb5 0xffffffb5 0xffffffb5 0xffffffb5 0xffffffb5 0xffffffb5 0xffffffb5 0xffffffb5>;
					PS_Config_Lmt_LPWG_Diff_P = <0x4b 0x4b 0x4b 0x4b 0x4b 0x4b 0x4b 0x4b 0x4b 0x4b 0x4b 0x4b 0x4b 0x4b 0x4b 0x4b 0x4b 0x4b 0x4b 0x4b 0x4b 0x4b 0x4b 0x4b 0x4b 0x4b 0x4b 0x4b 0x4b 0x4b 0x4b 0x4b 0x4b 0x4b 0x4b 0x4b 0x4b 0x4b 0x4b 0x4b 0x4b 0x4b 0x4b 0x4b 0x4b 0x4b 0x4b 0x4b 0x4b 0x4b 0x4b 0x4b 0x4b 0x4b 0x4b 0x4b 0x4b 0x4b 0x4b 0x4b 0x4b 0x4b 0x4b 0x4b 0x4b 0x4b 0x4b 0x4b 0x4b 0x4b 0x4b 0x4b 0x4b 0x4b 0x4b 0x4b 0x4b 0x4b 0x4b 0x4b 0x4b 0x4b 0x4b 0x4b 0x4b 0x4b 0x4b 0x4b 0x4b 0x4b 0x4b 0x4b 0x4b 0x4b 0x4b 0x4b 0x4b 0x4b 0x4b 0x4b 0x4b 0x4b 0x4b 0x4b 0x4b 0x4b 0x4b 0x4b 0x4b 0x4b 0x4b 0x4b 0x4b 0x4b 0x4b 0x4b 0x4b 0x4b 0x4b 0x4b 0x4b 0x4b 0x4b 0x4b 0x4b 0x4b 0x4b 0x4b 0x4b 0x4b 0x4b 0x4b 0x4b 0x4b 0x4b 0x4b 0x4b 0x4b 0x4b 0x4b 0x4b 0x4b 0x4b 0x4b 0x4b 0x4b 0x4b 0x4b 0x4b 0x4b 0x4b 0x4b 0x4b 0x4b 0x4b 0x4b 0x4b 0x4b 0x4b 0x4b 0x4b 0x4b 0x4b 0x4b 0x4b 0x4b 0x4b 0x4b 0x4b 0x4b 0x4b 0x4b 0x4b 0x4b 0x4b 0x4b 0x4b 0x4b 0x4b 0x4b 0x4b 0x4b 0x4b 0x4b 0x4b 0x4b 0x4b 0x4b 0x4b 0x4b 0x4b 0x4b 0x4b 0x4b 0x4b 0x4b 0x4b 0x4b 0x4b 0x4b 0x4b 0x4b 0x4b 0x4b 0x4b 0x4b 0x4b 0x4b 0x4b 0x4b 0x4b 0x4b 0x4b 0x4b 0x4b 0x4b 0x4b 0x4b 0x4b 0x4b 0x4b 0x4b 0x4b 0x4b 0x4b 0x4b 0x4b 0x4b 0x4b 0x4b 0x4b 0x4b 0x4b 0x4b 0x4b 0x4b 0x4b 0x4b 0x4b 0x4b 0x4b 0x4b 0x4b 0x4b 0x4b 0x4b 0x4b 0x4b 0x4b 0x4b 0x4b 0x4b 0x4b 0x4b 0x4b 0x4b 0x4b 0x4b 0x4b 0x4b 0x4b 0x4b 0x4b 0x4b 0x4b 0x4b 0x4b 0x4b 0x4b 0x4b 0x4b 0x4b 0x4b 0x4b 0x4b 0x4b 0x4b 0x4b 0x4b 0x4b 0x4b 0x4b 0x4b 0x4b 0x4b 0x4b 0x4b 0x4b 0x4b 0x4b 0x4b 0x4b 0x4b 0x4b 0x4b 0x4b 0x4b 0x4b 0x4b 0x4b 0x4b 0x4b 0x4b 0x4b 0x4b 0x4b 0x4b 0x4b 0x4b 0x4b 0x4b 0x4b 0x4b 0x4b 0x4b 0x4b 0x4b 0x4b 0x4b 0x4b 0x4b 0x4b 0x4b 0x4b 0x4b 0x4b 0x4b 0x4b 0x4b 0x4b 0x4b 0x4b 0x4b 0x4b 0x4b 0x4b 0x4b 0x4b 0x4b 0x4b 0x4b 0x4b 0x4b 0x4b 0x4b 0x4b 0x4b 0x4b 0x4b 0x4b 0x4b 0x4b 0x4b 0x4b 0x4b 0x4b 0x4b 0x4b 0x4b 0x4b 0x4b 0x4b 0x4b 0x4b 0x4b 0x4b 0x4b 0x4b 0x4b 0x4b 0x4b 0x4b 0x4b 0x4b 0x4b 0x4b 0x4b 0x4b 0x4b 0x4b 0x4b 0x4b 0x4b 0x4b 0x4b 0x4b 0x4b 0x4b 0x4b 0x4b 0x4b 0x4b 0x4b 0x4b 0x4b 0x4b 0x4b 0x4b 0x4b 0x4b 0x4b 0x4b 0x4b 0x4b 0x4b 0x4b 0x4b 0x4b 0x4b 0x4b 0x4b 0x4b 0x4b 0x4b 0x4b 0x4b 0x4b 0x4b 0x4b 0x4b 0x4b 0x4b 0x4b 0x4b 0x4b 0x4b 0x4b 0x4b 0x4b 0x4b 0x4b 0x4b 0x4b 0x4b 0x4b 0x4b 0x4b 0x4b 0x4b 0x4b 0x4b 0x4b 0x4b 0x4b 0x4b 0x4b 0x4b 0x4b 0x4b 0x4b 0x4b 0x4b 0x4b 0x4b 0x4b 0x4b 0x4b 0x4b 0x4b 0x4b 0x4b 0x4b 0x4b 0x4b 0x4b 0x4b 0x4b 0x4b 0x4b 0x4b 0x4b 0x4b 0x4b 0x4b 0x4b 0x4b 0x4b 0x4b 0x4b 0x4b 0x4b 0x4b 0x4b 0x4b 0x4b 0x4b 0x4b 0x4b 0x4b 0x4b 0x4b 0x4b 0x4b 0x4b 0x4b 0x4b 0x4b 0x4b 0x4b 0x4b 0x4b 0x4b 0x4b 0x4b 0x4b 0x4b 0x4b 0x4b 0x4b 0x4b 0x4b 0x4b 0x4b 0x4b 0x4b 0x4b 0x4b 0x4b 0x4b 0x4b 0x4b 0x4b 0x4b 0x4b 0x4b 0x4b 0x4b 0x4b 0x4b 0x4b 0x4b 0x4b 0x4b 0x4b 0x4b 0x4b 0x4b 0x4b 0x4b 0x4b 0x4b 0x4b 0x4b 0x4b 0x4b 0x4b 0x4b 0x4b 0x4b 0x4b 0x4b 0x4b 0x4b 0x4b 0x4b 0x4b 0x4b 0x4b 0x4b 0x4b 0x4b 0x4b 0x4b 0x4b 0x4b 0x4b 0x4b 0x4b 0x4b 0x4b 0x4b 0x4b 0x4b 0x4b 0x4b 0x4b 0x4b 0x4b 0x4b>;
					PS_Config_Lmt_LPWG_Rawdata_N = <0xf0 0xf0 0xf0 0xf0 0xf0 0xf0 0xf0 0xf0 0xf0 0xf0 0xf0 0xf0 0xf0 0xf0 0xf0 0xf0 0xf0 0xf0 0xf0 0xf0 0xf0 0xf0 0xf0 0xf0 0xf0 0xf0 0xf0 0xf0 0xf0 0xf0 0xf0 0xf0 0xf0 0xf0 0xf0 0xf0 0xf0 0xf0 0xf0 0xf0 0xf0 0xf0 0xf0 0xf0 0xf0 0xf0 0xf0 0xf0 0xf0 0xf0 0xf0 0xf0 0xf0 0xf0 0xf0 0xf0 0xf0 0xf0 0xf0 0xf0 0xf0 0xf0 0xf0 0xf0 0xf0 0xf0 0xf0 0xf0 0xf0 0xf0 0xf0 0xf0 0xf0 0xf0 0xf0 0xf0 0xf0 0xf0 0xf0 0xf0 0xf0 0xf0 0xf0 0xf0 0xf0 0xf0 0xf0 0xf0 0xf0 0xf0 0xf0 0xf0 0xf0 0xf0 0xf0 0xf0 0xf0 0xf0 0xf0 0xf0 0xf0 0xf0 0xf0 0xf0 0xf0 0xf0 0xf0 0xf0 0xf0 0xf0 0xf0 0xf0 0xf0 0xf0 0xf0 0xf0 0xf0 0xf0 0xf0 0xf0 0xf0 0xf0 0xf0 0xf0 0xf0 0xf0 0xf0 0xf0 0xf0 0xf0 0xf0 0xf0 0xf0 0xf0 0xf0 0xf0 0xf0 0xf0 0xf0 0xf0 0xf0 0xf0 0xf0 0xf0 0xf0 0xf0 0xf0 0xf0 0xf0 0xf0 0xf0 0xf0 0xf0 0xf0 0xf0 0xf0 0xf0 0xf0 0xf0 0xf0 0xf0 0xf0 0xf0 0xf0 0xf0 0xf0 0xf0 0xf0 0xf0 0xf0 0xf0 0xf0 0xf0 0xf0 0xf0 0xf0 0xf0 0xf0 0xf0 0xf0 0xf0 0xf0 0xf0 0xf0 0xf0 0xf0 0xf0 0xf0 0xf0 0xf0 0xf0 0xf0 0xf0 0xf0 0xf0 0xf0 0xf0 0xf0 0xf0 0xf0 0xf0 0xf0 0xf0 0xf0 0xf0 0xf0 0xf0 0xf0 0xf0 0xf0 0xf0 0xf0 0xf0 0xf0 0xf0 0xf0 0xf0 0xf0 0xf0 0xf0 0xf0 0xf0 0xf0 0xf0 0xf0 0xf0 0xf0 0xf0 0xf0 0xf0 0xf0 0xf0 0xf0 0xf0 0xf0 0xf0 0xf0 0xf0 0xf0 0xf0 0xf0 0xf0 0xf0 0xf0 0xf0 0xf0 0xf0 0xf0 0xf0 0xf0 0xf0 0xf0 0xf0 0xf0 0xf0 0xf0 0xf0 0xf0 0xf0 0xf0 0xf0 0xf0 0xf0 0xf0 0xf0 0xf0 0xf0 0xf0 0xf0 0xf0 0xf0 0xf0 0xf0 0xf0 0xf0 0xf0 0xf0 0xf0 0xf0 0xf0 0xf0 0xf0 0xf0 0xf0 0xf0 0xf0 0xf0 0xf0 0xf0 0xf0 0xf0 0xf0 0xf0 0xf0 0xf0 0xf0 0xf0 0xf0 0xf0 0xf0 0xf0 0xf0 0xf0 0xf0 0xf0 0xf0 0xf0 0xf0 0xf0 0xf0 0xf0 0xf0 0xf0 0xf0 0xf0 0xf0 0xf0 0xf0 0xf0 0xf0 0xf0 0xf0 0xf0 0xf0 0xf0 0xf0 0xf0 0xf0 0xf0 0xf0 0xf0 0xf0 0xf0 0xf0 0xf0 0xf0 0xf0 0xf0 0xf0 0xf0 0xf0 0xf0 0xf0 0xf0 0xf0 0xf0 0xf0 0xf0 0xf0 0xf0 0xf0 0xf0 0xf0 0xf0 0xf0 0xf0 0xf0 0xf0 0xf0 0xf0 0xf0 0xf0 0xf0 0xf0 0xf0 0xf0 0xf0 0xf0 0xf0 0xf0 0xf0 0xf0 0xf0 0xf0 0xf0 0xf0 0xf0 0xf0 0xf0 0xf0 0xf0 0xf0 0xf0 0xf0 0xf0 0xf0 0xf0 0xf0 0xf0 0xf0 0xf0 0xf0 0xf0 0xf0 0xf0 0xf0 0xf0 0xf0 0xf0 0xf0 0xf0 0xf0 0xf0 0xf0 0xf0 0xf0 0xf0 0xf0 0xf0 0xf0 0xf0 0xf0 0xf0 0xf0 0xf0 0xf0 0xf0 0xf0 0xf0 0xf0 0xf0 0xf0 0xf0 0xf0 0xf0 0xf0 0xf0 0xf0 0xf0 0xf0 0xf0 0xf0 0xf0 0xf0 0xf0 0xf0 0xf0 0xf0 0xf0 0xf0 0xf0 0xf0 0xf0 0xf0 0xf0 0xf0 0xf0 0xf0 0xf0 0xf0 0xf0 0xf0 0xf0 0xf0 0xf0 0xf0 0xf0 0xf0 0xf0 0xf0 0xf0 0xf0 0xf0 0xf0 0xf0 0xf0 0xf0 0xf0 0xf0 0xf0 0xf0 0xf0 0xf0 0xf0 0xf0 0xf0 0xf0 0xf0 0xf0 0xf0 0xf0 0xf0 0xf0 0xf0 0xf0 0xf0 0xf0 0xf0 0xf0 0xf0 0xf0 0xf0 0xf0 0xf0 0xf0 0xf0 0xf0 0xf0 0xf0 0xf0 0xf0 0xf0 0xf0 0xf0 0xf0 0xf0 0xf0 0xf0 0xf0 0xf0 0xf0 0xf0 0xf0 0xf0 0xf0 0xf0 0xf0 0xf0 0xf0 0xf0 0xf0 0xf0 0xf0 0xf0 0xf0 0xf0 0xf0 0xf0 0xf0 0xf0 0xf0 0xf0 0xf0 0xf0 0xf0 0xf0 0xf0 0xf0 0xf0 0xf0 0xf0 0xf0 0xf0 0xf0 0xf0 0xf0 0xf0 0xf0 0xf0 0xf0 0xf0 0xf0 0xf0 0xf0 0xf0 0xf0 0xf0 0xf0 0xf0 0xf0 0xf0 0xf0 0xf0 0xf0 0xf0 0xf0 0xf0 0xf0 0xf0 0xf0 0xf0 0xf0 0xf0 0xf0 0xf0 0xf0 0xf0 0xf0 0xf0>;
					PS_Config_Lmt_LPWG_Rawdata_P = <0xbb8 0xbb8 0xbb8 0xbb8 0xbb8 0xbb8 0xbb8 0xbb8 0xbb8 0xbb8 0xbb8 0xbb8 0xbb8 0xbb8 0xbb8 0xbb8 0xbb8 0xbb8 0xbb8 0xbb8 0xbb8 0xbb8 0xbb8 0xbb8 0xbb8 0xbb8 0xbb8 0xbb8 0xbb8 0xbb8 0xbb8 0xbb8 0xbb8 0xbb8 0xbb8 0xbb8 0xbb8 0xbb8 0xbb8 0xbb8 0xbb8 0xbb8 0xbb8 0xbb8 0xbb8 0xbb8 0xbb8 0xbb8 0xbb8 0xbb8 0xbb8 0xbb8 0xbb8 0xbb8 0xbb8 0xbb8 0xbb8 0xbb8 0xbb8 0xbb8 0xbb8 0xbb8 0xbb8 0xbb8 0xbb8 0xbb8 0xbb8 0xbb8 0xbb8 0xbb8 0xbb8 0xbb8 0xbb8 0xbb8 0xbb8 0xbb8 0xbb8 0xbb8 0xbb8 0xbb8 0xbb8 0xbb8 0xbb8 0xbb8 0xbb8 0xbb8 0xbb8 0xbb8 0xbb8 0xbb8 0xbb8 0xbb8 0xbb8 0xbb8 0xbb8 0xbb8 0xbb8 0xbb8 0xbb8 0xbb8 0xbb8 0xbb8 0xbb8 0xbb8 0xbb8 0xbb8 0xbb8 0xbb8 0xbb8 0xbb8 0xbb8 0xbb8 0xbb8 0xbb8 0xbb8 0xbb8 0xbb8 0xbb8 0xbb8 0xbb8 0xbb8 0xbb8 0xbb8 0xbb8 0xbb8 0xbb8 0xbb8 0xbb8 0xbb8 0xbb8 0xbb8 0xbb8 0xbb8 0xbb8 0xbb8 0xbb8 0xbb8 0xbb8 0xbb8 0xbb8 0xbb8 0xbb8 0xbb8 0xbb8 0xbb8 0xbb8 0xbb8 0xbb8 0xbb8 0xbb8 0xbb8 0xbb8 0xbb8 0xbb8 0xbb8 0xbb8 0xbb8 0xbb8 0xbb8 0xbb8 0xbb8 0xbb8 0xbb8 0xbb8 0xbb8 0xbb8 0xbb8 0xbb8 0xbb8 0xbb8 0xbb8 0xbb8 0xbb8 0xbb8 0xbb8 0xbb8 0xbb8 0xbb8 0xbb8 0xbb8 0xbb8 0xbb8 0xbb8 0xbb8 0xbb8 0xbb8 0xbb8 0xbb8 0xbb8 0xbb8 0xbb8 0xbb8 0xbb8 0xbb8 0xbb8 0xbb8 0xbb8 0xbb8 0xbb8 0xbb8 0xbb8 0xbb8 0xbb8 0xbb8 0xbb8 0xbb8 0xbb8 0xbb8 0xbb8 0xbb8 0xbb8 0xbb8 0xbb8 0xbb8 0xbb8 0xbb8 0xbb8 0xbb8 0xbb8 0xbb8 0xbb8 0xbb8 0xbb8 0xbb8 0xbb8 0xbb8 0xbb8 0xbb8 0xbb8 0xbb8 0xbb8 0xbb8 0xbb8 0xbb8 0xbb8 0xbb8 0xbb8 0xbb8 0xbb8 0xbb8 0xbb8 0xbb8 0xbb8 0xbb8 0xbb8 0xbb8 0xbb8 0xbb8 0xbb8 0xbb8 0xbb8 0xbb8 0xbb8 0xbb8 0xbb8 0xbb8 0xbb8 0xbb8 0xbb8 0xbb8 0xbb8 0xbb8 0xbb8 0xbb8 0xbb8 0xbb8 0xbb8 0xbb8 0xbb8 0xbb8 0xbb8 0xbb8 0xbb8 0xbb8 0xbb8 0xbb8 0xbb8 0xbb8 0xbb8 0xbb8 0xbb8 0xbb8 0xbb8 0xbb8 0xbb8 0xbb8 0xbb8 0xbb8 0xbb8 0xbb8 0xbb8 0xbb8 0xbb8 0xbb8 0xbb8 0xbb8 0xbb8 0xbb8 0xbb8 0xbb8 0xbb8 0xbb8 0xbb8 0xbb8 0xbb8 0xbb8 0xbb8 0xbb8 0xbb8 0xbb8 0xbb8 0xbb8 0xbb8 0xbb8 0xbb8 0xbb8 0xbb8 0xbb8 0xbb8 0xbb8 0xbb8 0xbb8 0xbb8 0xbb8 0xbb8 0xbb8 0xbb8 0xbb8 0xbb8 0xbb8 0xbb8 0xbb8 0xbb8 0xbb8 0xbb8 0xbb8 0xbb8 0xbb8 0xbb8 0xbb8 0xbb8 0xbb8 0xbb8 0xbb8 0xbb8 0xbb8 0xbb8 0xbb8 0xbb8 0xbb8 0xbb8 0xbb8 0xbb8 0xbb8 0xbb8 0xbb8 0xbb8 0xbb8 0xbb8 0xbb8 0xbb8 0xbb8 0xbb8 0xbb8 0xbb8 0xbb8 0xbb8 0xbb8 0xbb8 0xbb8 0xbb8 0xbb8 0xbb8 0xbb8 0xbb8 0xbb8 0xbb8 0xbb8 0xbb8 0xbb8 0xbb8 0xbb8 0xbb8 0xbb8 0xbb8 0xbb8 0xbb8 0xbb8 0xbb8 0xbb8 0xbb8 0xbb8 0xbb8 0xbb8 0xbb8 0xbb8 0xbb8 0xbb8 0xbb8 0xbb8 0xbb8 0xbb8 0xbb8 0xbb8 0xbb8 0xbb8 0xbb8 0xbb8 0xbb8 0xbb8 0xbb8 0xbb8 0xbb8 0xbb8 0xbb8 0xbb8 0xbb8 0xbb8 0xbb8 0xbb8 0xbb8 0xbb8 0xbb8 0xbb8 0xbb8 0xbb8 0xbb8 0xbb8 0xbb8 0xbb8 0xbb8 0xbb8 0xbb8 0xbb8 0xbb8 0xbb8 0xbb8 0xbb8 0xbb8 0xbb8 0xbb8 0xbb8 0xbb8 0xbb8 0xbb8 0xbb8 0xbb8 0xbb8 0xbb8 0xbb8 0xbb8 0xbb8 0xbb8 0xbb8 0xbb8 0xbb8 0xbb8 0xbb8 0xbb8 0xbb8 0xbb8 0xbb8 0xbb8 0xbb8 0xbb8 0xbb8 0xbb8 0xbb8 0xbb8 0xbb8 0xbb8 0xbb8 0xbb8 0xbb8 0xbb8 0xbb8 0xbb8 0xbb8 0xbb8 0xbb8 0xbb8 0xbb8 0xbb8 0xbb8 0xbb8 0xbb8 0xbb8 0xbb8 0xbb8 0xbb8 0xbb8 0xbb8 0xbb8 0xbb8 0xbb8 0xbb8 0xbb8 0xbb8 0xbb8 0xbb8 0xbb8 0xbb8 0xbb8 0xbb8 0xbb8 0xbb8 0xbb8 0xbb8 0xbb8 0xbb8 0xbb8 0xbb8 0xbb8 0xbb8 0xbb8 0xbb8 0xbb8 0xbb8 0xbb8 0xbb8 0xbb8 0xbb8 0xbb8 0xbb8 0xbb8 0xbb8 0xbb8 0xbb8 0xbb8 0xbb8 0xbb8 0xbb8 0xbb8 0xbb8 0xbb8 0xbb8 0xbb8 0xbb8 0xbb8 0xbb8 0xbb8 0xbb8 0xbb8 0xbb8 0xbb8 0xbb8 0xbb8 0xbb8 0xbb8 0xbb8 0xbb8 0xbb8 0xbb8 0xbb8 0xbb8 0xbb8 0xbb8 0xbb8 0xbb8 0xbb8 0xbb8 0xbb8 0xbb8 0xbb8 0xbb8 0xbb8 0xbb8 0xbb8 0xbb8 0xbb8 0xbb8 0xbb8 0xbb8 0xbb8 0xbb8 0xbb8 0xbb8 0xbb8 0xbb8>;
					PS_Config_Lmt_Open_Rawdata_N = <0x5e9 0x615 0x642 0x66a 0x630 0x639 0x62f 0xffff0001 0xffff0001 0x64c 0x637 0x648 0x661 0x64b 0x5f4 0x5e9 0x644 0x66a 0x670 0x688 0x667 0x66e 0x65b 0x67f 0x674 0x66c 0x657 0x667 0x668 0x667 0x642 0x631 0x650 0x667 0x66d 0x690 0x670 0x671 0x660 0x658 0x663 0x681 0x66f 0x680 0x685 0x676 0x657 0x649 0x661 0x676 0x681 0x6a3 0x682 0x681 0x66f 0x65c 0x674 0x693 0x680 0x690 0x691 0x682 0x660 0x649 0x673 0x68d 0x68f 0x6b7 0x699 0x69a 0x682 0x67f 0x67f 0x6a3 0x68a 0x69e 0x698 0x688 0x666 0x65e 0x66f 0x686 0x68a 0x6b5 0x699 0x69d 0x680 0x680 0x679 0x69e 0x683 0x699 0x690 0x681 0x65f 0x65a 0x67b 0x691 0x69b 0x6c0 0x6a8 0x6af 0x691 0x68f 0x67e 0x6a2 0x68b 0x69b 0x68e 0x684 0x65c 0x65a 0x676 0x68f 0x69c 0x6bc 0x6ad 0x6b4 0x68a 0x693 0x693 0x6b2 0x69e 0x6af 0x69d 0x691 0x663 0x66a 0x677 0x68c 0x695 0x6b7 0x6ae 0x6b1 0x698 0x691 0x6a8 0x6c3 0x6af 0x6c3 0x6a9 0x69c 0x67c 0x672 0x685 0x699 0x6a0 0x6c6 0x6bd 0x6be 0x6a6 0x69c 0x69a 0x6b6 0x69f 0x6b4 0x696 0x68b 0x66a 0x662 0x681 0x69c 0x6a1 0x6ca 0x6c4 0x6bf 0x6ad 0x6ac 0x6a3 0x6c6 0x6ad 0x6c6 0x69c 0x68b 0x673 0x66e 0x691 0x6ab 0x6ac 0x6d6 0x6d0 0x6db 0x6bb 0x6b7 0x6a5 0x6c7 0x6b0 0x6ca 0x6a1 0x69b 0x678 0x672 0x68a 0x6a0 0x6a6 0x6cb 0x6d1 0x6dc 0x6bb 0x6b1 0x6c2 0x6e1 0x6d0 0x6e2 0x6b7 0x6b5 0x690 0x686 0x68d 0x6a5 0x6ad 0x6cd 0x6d6 0x6e4 0x6c3 0x6b6 0x6b4 0x6d4 0x6c1 0x6d6 0x6a0 0x6a0 0x67c 0x673 0x68d 0x6a5 0x6a8 0x6c9 0x6c9 0x6e4 0x6c7 0x6b6 0x6d8 0x6f2 0x6d8 0x6f2 0x6b4 0x6b7 0x69a 0x68b 0x6a4 0x6be 0x6c1 0x6de 0x6f1 0x6fd 0x6e5 0x6d4 0x6d6 0x6ec 0x6d6 0x6ef 0x6b7 0x6b1 0x68f 0x681 0x69f 0x6bb 0x6b5 0x6d7 0x6eb 0x6ff 0x6e5 0x6d5 0x6df 0x6f8 0x6df 0x6f9 0x6be 0x6b7 0x690 0x689 0x6a0 0x6bc 0x6b1 0x6ca 0x6ec 0x6fe 0x6eb 0x6d9 0x6c6 0x6df 0x6c9 0x6d3 0x6a5 0x69d 0x672 0x66a 0x685 0x67c 0x663 0x664 0x640 0x64a 0x63e 0x648 0x619 0x64c 0x63d 0x649 0x650 0x678 0x67c 0x6ab 0x68d 0x686 0x667 0x669 0x647 0x651 0x643 0x650 0x612 0x642 0x639 0x646 0x64e 0x673 0x678 0x6a4 0x691 0x693 0x674 0x673 0x654 0x65b 0x650 0x657 0x61c 0x646 0x645 0x655 0x658 0x681 0x681 0x6a0 0x688 0x68a 0x664 0x669 0x649 0x650 0x648 0x64b 0x619 0x648 0x63d 0x657 0x65a 0x67f 0x67c 0x69c 0x687 0x68e 0x66c 0x66a 0x651 0x655 0x64b 0x64d 0x624 0x64e 0x64a 0x665 0x664 0x685 0x682 0x69e 0x681 0x68d 0x66a 0x66d 0x64c 0x651 0x648 0x649 0x627 0x64b 0x64a 0x663 0x662 0x67f 0x67b 0x696 0x682 0x693 0x674 0x674 0x655 0x65e 0x650 0x652 0x61b 0x643 0x640 0x658 0x65c 0x67e 0x678 0x68f 0x684 0x692 0x679 0x67b 0x65d 0x669 0x658 0x65c 0x632 0x64d 0x652 0x66c 0x66d 0x68e 0x688 0x697 0x679 0x690 0x674 0x674 0x657 0x65c 0x654 0x655 0x62b 0x64c 0x64e 0x662 0x666 0x682 0x681 0x687 0x67e 0x696 0x67c 0x679 0x65d 0x664 0x65c 0x65b 0x62e 0x64e 0x64d 0x664 0x663 0x683 0x67d 0x684 0x669 0x690 0x670 0x676 0x653 0x65b 0x652 0x652 0x62b 0x655 0x64f 0x66b 0x66a 0x689 0x684 0x685 0x66e 0x68b 0x66d 0x675 0x652 0x65a 0x654 0x652 0x630 0x652 0x64a 0x664 0x666 0x683 0x67c 0x67e 0x666 0x687 0x670 0x675 0x653 0x65e 0x654 0x651 0x632 0x658 0x655 0x667 0x669 0x68d 0x67c 0x67d 0x5fd 0x68e 0x601 0x67d 0x5ea 0x66a 0x5e7 0x65a 0x5ce 0x662 0x5e8 0x672 0x5fd 0x696 0x60a 0x683 0x5b9 0x60f 0x604 0x609 0x5ed 0x5f7 0x5ec 0x5e9 0x5cb 0x5ea 0x5e2 0x5f7 0x5f6 0x612 0x601 0x5c2 0x5ba 0x612 0x607 0x60d 0x5ef 0x5fa 0x5ef 0x5ed 0x5ce 0x5ed 0x5e2 0x5f7 0x5f4 0x610 0x5fd 0x5bc 0x5a1 0x5fe 0x5f5 0x5fd 0x5e0 0x5ec 0x5e0 0x5e1 0x5bf 0x5e3 0x5d2 0x5eb 0x5e6 0x603 0x5ec 0x5aa 0x53e 0x5f5 0x5fa 0x604 0x5e6 0x5f1 0x5e5 0x5e8 0x5c5 0x5e9 0x5d9 0x5ee 0x5ec 0x607 0x5e0 0x546 0xfffffe01 0xfffffe01 0xfffffe01>;
					PS_Config_Lmt_Open_Rawdata_P = <0xdca 0xe31 0xe9a 0xef7 0xe71 0xe85 0xe6e 0xffff 0xffff 0xeb3 0xe80 0xea8 0xee2 0xeb0 0xde5 0xdcc 0xe9f 0xef9 0xf05 0xf3f 0xef0 0xf01 0xed4 0xf2a 0xf0f 0xefc 0xecc 0xef2 0xef3 0xef0 0xe9a 0xe72 0xebb 0xef0 0xf00 0xf51 0xf07 0xf08 0xee0 0xecd 0xee8 0xf2e 0xf04 0xf2b 0xf38 0xf13 0xecb 0xeaa 0xee2 0xf15 0xf2d 0xf7e 0xf31 0xf2e 0xf04 0xed7 0xf0f 0xf58 0xf2b 0xf50 0xf54 0xf31 0xee0 0xeac 0xf0e 0xf4a 0xf4e 0xfac 0xf65 0xf69 0xf31 0xf2a 0xf28 0xf7c 0xf42 0xf71 0xf63 0xf3f 0xeee 0xedd 0xf03 0xf39 0xf43 0xfa8 0xf66 0xf70 0xf2b 0xf2b 0xf1c 0xf71 0xf32 0xf66 0xf51 0xf2d 0xede 0xed2 0xf1f 0xf52 0xf6a 0xfc0 0xf89 0xf98 0xf52 0xf4e 0xf27 0xf7a 0xf46 0xf6a 0xf4b 0xf34 0xed7 0xed3 0xf13 0xf4e 0xf6c 0xfb7 0xf94 0xfa5 0xf42 0xf57 0xf57 0xf9f 0xf71 0xf98 0xf6e 0xf54 0xee7 0xef9 0xf16 0xf47 0xf5c 0xfac 0xf97 0xf9d 0xf63 0xf54 0xf88 0xfc8 0xf98 0xfc7 0xf8a 0xf6c 0xf21 0xf0a 0xf38 0xf66 0xf77 0xfcf 0xfba 0xfbd 0xf83 0xf6d 0xf69 0xfa9 0xf73 0xfa5 0xf5f 0xf46 0xef9 0xee5 0xf2d 0xf6d 0xf78 0xfd9 0xfc9 0xfbe 0xf94 0xf91 0xf7c 0xfcf 0xf94 0xfcf 0xf6d 0xf44 0xf0c 0xf01 0xf52 0xf90 0xf91 0xff5 0xfe7 0xfff 0xfb4 0xfab 0xf82 0xfd2 0xf9b 0xfd9 0xf78 0xf6a 0xf18 0xf0a 0xf42 0xf75 0xf85 0xfda 0xfe8 0x1001 0xfb6 0xf9e 0xfc5 0x100e 0xfe7 0x1011 0xfac 0xfa6 0xf50 0xf39 0xf4a 0xf81 0xf94 0xfe0 0xff3 0x1015 0xfc7 0xfa9 0xfa5 0xfef 0xfc2 0xff3 0xf77 0xf75 0xf21 0xf0c 0xf49 0xf81 0xf89 0xfd6 0xfd6 0x1014 0xfd2 0xfa9 0xff8 0x1035 0xff9 0x1035 0xfa5 0xfac 0xf67 0xf46 0xf7f 0xfbb 0xfc2 0x1007 0x1032 0x104e 0x1016 0xfef 0xff5 0x1027 0xff5 0x102e 0xfac 0xf9d 0xf4e 0xf2d 0xf73 0xfb4 0xfa6 0xff6 0x1024 0x1053 0x1018 0xff1 0x100a 0x1043 0x1008 0x1046 0xfbd 0xfac 0xf51 0xf40 0xf75 0xfb7 0xf9e 0xfd9 0x1027 0x1051 0x1026 0xffa 0xfcf 0x1008 0xfd5 0xfec 0xf81 0xf70 0xf0a 0xef9 0xf38 0xf21 0xee8 0xeeb 0xe97 0xead 0xe91 0xea9 0xe3a 0xeb3 0xe90 0xeaa 0xebb 0xf18 0xf21 0xf90 0xf49 0xf39 0xef2 0xef5 0xea6 0xebe 0xe9e 0xebb 0xe2b 0xe9b 0xe85 0xea3 0xeb6 0xf0e 0xf19 0xf7f 0xf52 0xf57 0xf0f 0xf0c 0xec5 0xed6 0xebb 0xecc 0xe43 0xea5 0xea2 0xec8 0xecf 0xf2d 0xf2d 0xf75 0xf3d 0xf42 0xee9 0xef6 0xeaa 0xebb 0xea8 0xeaf 0xe3c 0xea8 0xe90 0xecc 0xed3 0xf2a 0xf23 0xf6d 0xf3c 0xf4d 0xefd 0xef9 0xebd 0xec6 0xeb0 0xeb4 0xe55 0xeb6 0xead 0xeec 0xee9 0xf36 0xf31 0xf71 0xf2d 0xf4a 0xef9 0xf00 0xeb1 0xebe 0xea8 0xeac 0xe5b 0xeb0 0xead 0xee8 0xee5 0xf2a 0xf20 0xf5f 0xf31 0xf57 0xf0f 0xf0f 0xec8 0xedb 0xebb 0xec1 0xe3f 0xe9e 0xe97 0xecf 0xed7 0xf26 0xf18 0xf4e 0xf35 0xf55 0xf1c 0xf1f 0xed9 0xef5 0xecf 0xed7 0xe75 0xeb4 0xec1 0xefc 0xefe 0xf4b 0xf3f 0xf62 0xf1c 0xf51 0xf0f 0xf0f 0xecb 0xed7 0xec5 0xec6 0xe64 0xeb3 0xeb6 0xee5 0xeee 0xf31 0xf2d 0xf3c 0xf27 0xf5f 0xf21 0xf1a 0xeda 0xee9 0xed7 0xed4 0xe6b 0xeb7 0xeb4 0xee9 0xee7 0xf32 0xf24 0xf34 0xef5 0xf50 0xf05 0xf13 0xec2 0xed6 0xec1 0xec1 0xe64 0xec8 0xeba 0xefa 0xef7 0xf40 0xf34 0xf36 0xf01 0xf44 0xefe 0xf12 0xec1 0xed2 0xec4 0xebf 0xe70 0xebf 0xead 0xee9 0xeee 0xf32 0xf23 0xf26 0xeee 0xf3b 0xf05 0xf11 0xec2 0xedb 0xec5 0xebe 0xe75 0xecd 0xec6 0xef0 0xef5 0xf49 0xf21 0xf24 0xdf9 0xf4d 0xe04 0xf24 0xdcd 0xef9 0xdc6 0xed2 0xd8b 0xee5 0xdc8 0xf0b 0xdf9 0xf5e 0xe19 0xf32 0xd5a 0xe24 0xe09 0xe15 0xdd4 0xdec 0xdd1 0xdcc 0xd84 0xdcd 0xdbb 0xdeb 0xde9 0xe2a 0xe04 0xd71 0xd5d 0xe2a 0xe10 0xe1e 0xdda 0xdf3 0xdda 0xdd4 0xd8b 0xdd4 0xdba 0xdec 0xde5 0xe25 0xdfa 0xd63 0xd22 0xdfd 0xde6 0xdf9 0xdb7 0xdd1 0xdb5 0xdb8 0xd6a 0xdbc 0xd95 0xdd0 0xdc5 0xe07 0xdd1 0xd37 0xc3b 0xde8 0xdf2 0xe0b 0xdc5 0xdde 0xdc1 0xdc9 0xd78 0xdcc 0xda5 0xdd6 0xdd3 0xe10 0xdb5 0xc4f 0x1400 0x1400 0x1400>;
					PS_Config_Lmt_Short_Rawdata_N = <0x2774 0x2774 0x2774 0x2774 0x2774 0x2774 0x2774 0x2774 0x2774 0x2774 0x2774 0x2774 0x2774 0x2774 0x2774 0x2774 0x2774 0x2774 0x2774 0x2774 0x2774 0x2774 0x2774 0x2774 0x2774 0x2774 0x2774 0x2774 0x2774 0x2774 0x2774 0x2774 0x2774 0x2774 0x2774 0x2774 0x2774 0x2774 0x2774 0x2774 0x2774 0x2774 0x2774 0x2774 0x2774 0x2774 0x2774 0x2774 0x2774 0x2774 0x2774 0x2774 0x2774 0x2774 0x2774 0x2774 0x2774 0x2774 0x2774 0x2774 0x2774 0x2774 0x2774 0x2774 0x2774 0x2774 0x2774 0x2774 0x2774 0x2774 0x2774 0x2774 0x2774 0x2774 0x2774 0x2774 0x2774 0x2774 0x2774 0x2774 0x2774 0x2774 0x2774 0x2774 0x2774 0x2774 0x2774 0x2774 0x2774 0x2774 0x2774 0x2774 0x2774 0x2774 0x2774 0x2774 0x2774 0x2774 0x2774 0x2774 0x2774 0x2774 0x2774 0x2774 0x2774 0x2774 0x2774 0x2774 0x2774 0x2774 0x2774 0x2774 0x2774 0x2774 0x2774 0x2774 0x2774 0x2774 0x2774 0x2774 0x2774 0x2774 0x2774 0x2774 0x2774 0x2774 0x2774 0x2774 0x2774 0x2774 0x2774 0x2774 0x2774 0x2774 0x2774 0x2774 0x2774 0x2774 0x2774 0x2774 0x2774 0x2774 0x2774 0x2774 0x2774 0x2774 0x2774 0x2774 0x2774 0x2774 0x2774 0x2774 0x2774 0x2774 0x2774 0x2774 0x2774 0x2774 0x2774 0x2774 0x2774 0x2774 0x2774 0x2774 0x2774 0x2774 0x2774 0x2774 0x2774 0x2774 0x2774 0x2774 0x2774 0x2774 0x2774 0x2774 0x2774 0x2774 0x2774 0x2774 0x2774 0x2774 0x2774 0x2774 0x2774 0x2774 0x2774 0x2774 0x2774 0x2774 0x2774 0x2774 0x2774 0x2774 0x2774 0x2774 0x2774 0x2774 0x2774 0x2774 0x2774 0x2774 0x2774 0x2774 0x2774 0x2774 0x2774 0x2774 0x2774 0x2774 0x2774 0x2774 0x2774 0x2774 0x2774 0x2774 0x2774 0x2774 0x2774 0x2774 0x2774 0x2774 0x2774 0x2774 0x2774 0x2774 0x2774 0x2774 0x2774 0x2774 0x2774 0x2774 0x2774 0x2774 0x2774 0x2774 0x2774 0x2774 0x2774 0x2774 0x2774 0x2774 0x2774 0x2774 0x2774 0x2774 0x2774 0x2774 0x2774 0x2774 0x2774 0x2774 0x2774 0x2774 0x2774 0x2774 0x2774 0x2774 0x2774 0x2774 0x2774 0x2774 0x2774 0x2774 0x2774 0x2774 0x2774 0x2774 0x2774 0x2774 0x2774 0x2774 0x2774 0x2774 0x2774 0x2774 0x2774 0x2774 0x2774 0x2774 0x2774 0x2774 0x2774 0x2774 0x2774 0x2774 0x2774 0x2774 0x2774 0x2774 0x2774 0x2774 0x2774 0x2774 0x2774 0x2774 0x2774 0x2774 0x2774 0x2774 0x2774 0x2774 0x2774 0x2774 0x2774 0x2774 0x2774 0x2774 0x2774 0x2774 0x2774 0x2774 0x2774 0x2774 0x2774 0x2774 0x2774 0x2774 0x2774 0x2774 0x2774 0x2774 0x2774 0x2774 0x2774 0x2774 0x2774 0x2774 0x2774 0x2774 0x2774 0x2774 0x2774 0x2774 0x2774 0x2774 0x2774 0x2774 0x2774 0x2774 0x2774 0x2774 0x2774 0x2774 0x2774 0x2774 0x2774 0x2774 0x2774 0x2774 0x2774 0x2774 0x2774 0x2774 0x2774 0x2774 0x2774 0x2774 0x2774 0x2774 0x2774 0x2774 0x2774 0x2774 0x2774 0x2774 0x2774 0x2774 0x2774 0x2774 0x2774 0x2774 0x2774 0x2774 0x2774 0x2774 0x2774 0x2774 0x2774 0x2774 0x2774 0x2774 0x2774 0x2774 0x2774 0x2774 0x2774 0x2774 0x2774 0x2774 0x2774 0x2774 0x2774 0x2774 0x2774 0x2774 0x2774 0x2774 0x2774 0x2774 0x2774 0x2774 0x2774 0x2774 0x2774 0x2774 0x2774 0x2774 0x2774 0x2774 0x2774 0x2774 0x2774 0x2774 0x2774 0x2774 0x2774 0x2774 0x2774 0x2774 0x2774 0x2774 0x2774 0x2774 0x2774 0x2774 0x2774 0x2774 0x2774 0x2774 0x2774 0x2774 0x2774 0x2774 0x2774 0x2774 0x2774 0x2774 0x2774 0x2774 0x2774 0x2774 0x2774 0x2774 0x2774 0x2774 0x2774 0x2774 0x2774 0x2774 0x2774 0x2774 0x2774 0x2774 0x2774 0x2774 0x2774 0x2774 0x2774 0x2774 0x2774 0x2774 0x2774 0x2774 0x2774 0x2774 0x2774 0x2774 0x2774 0x2774 0x2774 0x2774 0x2774 0x2774 0x2774 0x2774 0x2774 0x2774 0x2774 0x2774 0x2774 0x2774 0x2774 0x2774 0x2774 0x2774 0x2774 0x2774 0x2774 0x2774 0x2774 0x2774 0x2774 0x2774 0x2774 0x2774 0x2774 0x2774 0x2774 0x2774 0x2774 0x2774 0x2774 0x2774 0x2774 0x2774 0x2774 0x2774 0x2774 0x2774 0x2774 0x2774 0x2774 0x2774 0x2774 0x2774 0x2774 0x2774 0x2774 0x2774 0x2774 0x2774 0x2774 0x2774 0x2774 0x2774 0x2774 0x2774 0x2774 0x2774 0x2774 0x2774 0x2774 0x2774 0x2774 0x2774 0x2774 0x2774 0x2774 0x2774 0x2774 0x2774 0x2774 0x2774 0x2774 0x2774 0x2774 0x2774 0x2774 0x2774 0x2774 0x2774 0x2774 0x2774 0x2774 0x2774 0x2774 0x2774 0x2774 0x2774 0x2774 0x2774 0x2774 0x2774 0x2774 0x2774 0x2774 0x2774 0x2774 0x2774 0x2774 0x2774 0x2774 0x2774 0x2774 0x2774 0x2710 0x2710 0x2710>;
					PS_Config_Lmt_Short_Rawdata_P = <0x36b8 0x36b8 0x36b8 0x36b8 0x36b8 0x36b8 0x36b8 0x36b8 0x36b8 0x36b8 0x36b8 0x36b8 0x36b8 0x36b8 0x36b8 0x36b8 0x36b8 0x36b8 0x36b8 0x36b8 0x36b8 0x36b8 0x36b8 0x36b8 0x36b8 0x36b8 0x36b8 0x36b8 0x36b8 0x36b8 0x36b8 0x36b8 0x36b8 0x36b8 0x36b8 0x36b8 0x36b8 0x36b8 0x36b8 0x36b8 0x36b8 0x36b8 0x36b8 0x36b8 0x36b8 0x36b8 0x36b8 0x36b8 0x36b8 0x36b8 0x36b8 0x36b8 0x36b8 0x36b8 0x36b8 0x36b8 0x36b8 0x36b8 0x36b8 0x36b8 0x36b8 0x36b8 0x36b8 0x36b8 0x36b8 0x36b8 0x36b8 0x36b8 0x36b8 0x36b8 0x36b8 0x36b8 0x36b8 0x36b8 0x36b8 0x36b8 0x36b8 0x36b8 0x36b8 0x36b8 0x36b8 0x36b8 0x36b8 0x36b8 0x36b8 0x36b8 0x36b8 0x36b8 0x36b8 0x36b8 0x36b8 0x36b8 0x36b8 0x36b8 0x36b8 0x36b8 0x36b8 0x36b8 0x36b8 0x36b8 0x36b8 0x36b8 0x36b8 0x36b8 0x36b8 0x36b8 0x36b8 0x36b8 0x36b8 0x36b8 0x36b8 0x36b8 0x36b8 0x36b8 0x36b8 0x36b8 0x36b8 0x36b8 0x36b8 0x36b8 0x36b8 0x36b8 0x36b8 0x36b8 0x36b8 0x36b8 0x36b8 0x36b8 0x36b8 0x36b8 0x36b8 0x36b8 0x36b8 0x36b8 0x36b8 0x36b8 0x36b8 0x36b8 0x36b8 0x36b8 0x36b8 0x36b8 0x36b8 0x36b8 0x36b8 0x36b8 0x36b8 0x36b8 0x36b8 0x36b8 0x36b8 0x36b8 0x36b8 0x36b8 0x36b8 0x36b8 0x36b8 0x36b8 0x36b8 0x36b8 0x36b8 0x36b8 0x36b8 0x36b8 0x36b8 0x36b8 0x36b8 0x36b8 0x36b8 0x36b8 0x36b8 0x36b8 0x36b8 0x36b8 0x36b8 0x36b8 0x36b8 0x36b8 0x36b8 0x36b8 0x36b8 0x36b8 0x36b8 0x36b8 0x36b8 0x36b8 0x36b8 0x36b8 0x36b8 0x36b8 0x36b8 0x36b8 0x36b8 0x36b8 0x36b8 0x36b8 0x36b8 0x36b8 0x36b8 0x36b8 0x36b8 0x36b8 0x36b8 0x36b8 0x36b8 0x36b8 0x36b8 0x36b8 0x36b8 0x36b8 0x36b8 0x36b8 0x36b8 0x36b8 0x36b8 0x36b8 0x36b8 0x36b8 0x36b8 0x36b8 0x36b8 0x36b8 0x36b8 0x36b8 0x36b8 0x36b8 0x36b8 0x36b8 0x36b8 0x36b8 0x36b8 0x36b8 0x36b8 0x36b8 0x36b8 0x36b8 0x36b8 0x36b8 0x36b8 0x36b8 0x36b8 0x36b8 0x36b8 0x36b8 0x36b8 0x36b8 0x36b8 0x36b8 0x36b8 0x36b8 0x36b8 0x36b8 0x36b8 0x36b8 0x36b8 0x36b8 0x36b8 0x36b8 0x36b8 0x36b8 0x36b8 0x36b8 0x36b8 0x36b8 0x36b8 0x36b8 0x36b8 0x36b8 0x36b8 0x36b8 0x36b8 0x36b8 0x36b8 0x36b8 0x36b8 0x36b8 0x36b8 0x36b8 0x36b8 0x36b8 0x36b8 0x36b8 0x36b8 0x36b8 0x36b8 0x36b8 0x36b8 0x36b8 0x36b8 0x36b8 0x36b8 0x36b8 0x36b8 0x36b8 0x36b8 0x36b8 0x36b8 0x36b8 0x36b8 0x36b8 0x36b8 0x36b8 0x36b8 0x36b8 0x36b8 0x36b8 0x36b8 0x36b8 0x36b8 0x36b8 0x36b8 0x36b8 0x36b8 0x36b8 0x36b8 0x36b8 0x36b8 0x36b8 0x36b8 0x36b8 0x36b8 0x36b8 0x36b8 0x36b8 0x36b8 0x36b8 0x36b8 0x36b8 0x36b8 0x36b8 0x36b8 0x36b8 0x36b8 0x36b8 0x36b8 0x36b8 0x36b8 0x36b8 0x36b8 0x36b8 0x36b8 0x36b8 0x36b8 0x36b8 0x36b8 0x36b8 0x36b8 0x36b8 0x36b8 0x36b8 0x36b8 0x36b8 0x36b8 0x36b8 0x36b8 0x36b8 0x36b8 0x36b8 0x36b8 0x36b8 0x36b8 0x36b8 0x36b8 0x36b8 0x36b8 0x36b8 0x36b8 0x36b8 0x36b8 0x36b8 0x36b8 0x36b8 0x36b8 0x36b8 0x36b8 0x36b8 0x36b8 0x36b8 0x36b8 0x36b8 0x36b8 0x36b8 0x36b8 0x36b8 0x36b8 0x36b8 0x36b8 0x36b8 0x36b8 0x36b8 0x36b8 0x36b8 0x36b8 0x36b8 0x36b8 0x36b8 0x36b8 0x36b8 0x36b8 0x36b8 0x36b8 0x36b8 0x36b8 0x36b8 0x36b8 0x36b8 0x36b8 0x36b8 0x36b8 0x36b8 0x36b8 0x36b8 0x36b8 0x36b8 0x36b8 0x36b8 0x36b8 0x36b8 0x36b8 0x36b8 0x36b8 0x36b8 0x36b8 0x36b8 0x36b8 0x36b8 0x36b8 0x36b8 0x36b8 0x36b8 0x36b8 0x36b8 0x36b8 0x36b8 0x36b8 0x36b8 0x36b8 0x36b8 0x36b8 0x36b8 0x36b8 0x36b8 0x36b8 0x36b8 0x36b8 0x36b8 0x36b8 0x36b8 0x36b8 0x36b8 0x36b8 0x36b8 0x36b8 0x36b8 0x36b8 0x36b8 0x36b8 0x36b8 0x36b8 0x36b8 0x36b8 0x36b8 0x36b8 0x36b8 0x36b8 0x36b8 0x36b8 0x36b8 0x36b8 0x36b8 0x36b8 0x36b8 0x36b8 0x36b8 0x36b8 0x36b8 0x36b8 0x36b8 0x36b8 0x36b8 0x36b8 0x36b8 0x36b8 0x36b8 0x36b8 0x36b8 0x36b8 0x36b8 0x36b8 0x36b8 0x36b8 0x36b8 0x36b8 0x36b8 0x36b8 0x36b8 0x36b8 0x36b8 0x36b8 0x36b8 0x36b8 0x36b8 0x36b8 0x36b8 0x36b8 0x36b8 0x36b8 0x36b8 0x36b8 0x36b8 0x36b8 0x36b8 0x36b8 0x36b8 0x36b8 0x36b8 0x36b8 0x36b8 0x36b8 0x36b8 0x36b8 0x36b8 0x36b8 0x36b8 0x36b8 0x36b8 0x36b8 0x36b8 0x36b8 0x36b8 0x36b8 0x36b8 0x36b8 0x36b8 0x36b8 0x36b8 0x36b8 0x36b8 0x36b8 0x36b8 0x36b8 0x36b8 0x36b8 0x36b8 0x36b8 0x36b8 0x36b8 0x36b8 0x36b8 0x36b8 0x36b8 0x36b8 0x36b8 0x36b8 0x36b8 0x36b8 0x36b8 0x36b8 0x36b8 0x36b8 0x36b8 0x36b8 0x36b8 0x36b8 0x36b8 0x36b8 0x36b8 0x36b8 0x36b8 0x36b8 0x36b8 0x36b8 0x36b8 0x36b8 0x36b8 0x36b8 0x36b8 0x36b8 0x36b8>;
					X_Channel = <0x10>;
					Y_Channel = <0x24>;
					compatible = "novatek-mp-criteria-7223";
					diff_test_frame = <0x32>;
					fdm_diff_test_frame = <0x32>;
					fdm_x_num = <0x2>;
					open_test_spec = <0xfffffe01 0x1400>;
					short_test_spec = <0x2710 0x36b8>;
				};
			};
		};
	};

	fragment@15 {
		target = <0xffffffff>;

		__overlay__ {
			pinctrl-0 = <0xc>;
			pinctrl-1 = <0xd>;
			pinctrl-2 = <0xe>;
			pinctrl-3 = <0xf>;
			pinctrl-4 = <0x10>;
			pinctrl-5 = <0x11>;
			pinctrl-names = "default", "state_eint_as_int", "state_eint_output0", "state_eint_output1", "state_rst_output0", "state_rst_output1";
			status = "okay";
			tpd-filter-custom-prameters = <0x0 0x0 0x0 0x0 0x0 0x0 0x0 0x0 0x0 0x0 0x0 0x0>;
			tpd-filter-custom-speed = <0x0 0x0 0x0>;
			tpd-filter-enable = <0x0>;
			tpd-filter-pixel-density = <0xc0>;
			tpd-key-dim-local = <0xc8 0x7d0 0x64 0x28 0x203 0x7d0 0x64 0x28 0x320 0x7d0 0x64 0x28 0x0 0x0 0x0 0x0>;
			tpd-key-local = <0x8b 0xac 0x9e 0x0>;
			tpd-key-num = <0x3>;
			tpd-max-touch-num = <0xa>;
			tpd-resolution = <0x438 0x960>;
			use-tpd-button = <0x0>;
		};
	};

	fragment@16 {
		target = <0xffffffff>;

		__overlay__ {

			eint0default {
				phandle = <0xc>;
			};

			eint@0 {
				phandle = <0xd>;

				pins_cmd_dat {
					bias-disable;
					pinmux = <0xe00>;
					slew-rate = <0x0>;
				};
			};

			eintoutput0 {
				phandle = <0xe>;

				pins_cmd_dat {
					output-low;
					pinmux = <0xe00>;
					slew-rate = <0x1>;
				};
			};

			eintoutput1 {
				phandle = <0xf>;

				pins_cmd_dat {
					output-high;
					pinmux = <0xe00>;
					slew-rate = <0x1>;
				};
			};

			rstoutput0 {
				phandle = <0x10>;

				pins_cmd_dat {
					output-low;
					pinmux = <0xf00>;
					slew-rate = <0x1>;
				};
			};

			rstoutput1 {
				phandle = <0x11>;

				pins_cmd_dat {
					output-high;
					pinmux = <0xf00>;
					slew-rate = <0x1>;
				};
			};
		};
	};

	fragment@17 {
		target = <0xffffffff>;

		__overlay__ {
			accdet-mic-mode = <0x2>;
			accdet-mic-vol = <0x8>;
			accdet-plugout-debounce = <0x1>;
			eint_use_ext_res = <0x0>;
			headset-four-key-threshold = <0x0 0x3a 0x79 0xc0 0x190>;
			headset-mode-setting = <0x500 0x500 0x1 0x1f0 0x800 0x800 0x20 0x44 0x4 0x1 0x5 0x3 0x3 0x5 0xe>;
			headset-three-key-threshold = <0x0 0x50 0xdc 0x190>;
			headset-three-key-threshold-CDD = <0x0 0x79 0xc0 0x258>;
			headset-vol-threshold = <0x0 0x24e 0x24f 0x7d0 0xa28>;
			status = "okay";
		};
	};

	fragment@18 {
		target = <0xffffffff>;

		__overlay__ {
			sdcard_det_en = <0x1>;
			sdcard_hlact = <0x0>;
		};
	};

	fragment@19 {
		target = <0xffffffff>;

		__overlay__ {

			led@0 {
				compatible = "mediatek,red";
				data = <0x1>;
				led_mode = <0x0>;
				phandle = <0x68>;
				pwm_config = <0x0 0x0 0x0 0x0 0x0>;
			};

			led@1 {
				compatible = "mediatek,green";
				data = <0x1>;
				led_mode = <0x0>;
				phandle = <0x69>;
				pwm_config = <0x0 0x0 0x0 0x0 0x0>;
			};

			led@2 {
				compatible = "mediatek,blue";
				data = <0x1>;
				led_mode = <0x0>;
				phandle = <0x6a>;
				pwm_config = <0x0 0x0 0x0 0x0 0x0>;
			};

			led@3 {
				compatible = "mediatek,jogball-backlight";
				data = <0x1>;
				led_mode = <0x0>;
				phandle = <0x6b>;
				pwm_config = <0x0 0x0 0x0 0x0 0x0>;
			};

			led@4 {
				compatible = "mediatek,keyboard-backlight";
				data = <0x1>;
				led_mode = <0x0>;
				phandle = <0x6c>;
				pwm_config = <0x0 0x0 0x0 0x0 0x0>;
			};

			led@5 {
				compatible = "mediatek,button-backlight";
				data = <0x1>;
				led_mode = <0x0>;
				phandle = <0x6d>;
				pwm_config = <0x0 0x0 0x0 0x0 0x0>;
			};

			led@6 {
				compatible = "mediatek,lcd-backlight";
				data = <0x1>;
				led_mode = <0x4>;
				phandle = <0x6e>;
				pwm_config = <0x0 0x1 0x0 0x0 0x0>;
			};

			vibrator@0 {
				compatible = "mediatek,vibrator";
				phandle = <0x6f>;
				vib_limit = <0x9>;
				vib_timer = <0x19>;
				vib_vol = <0xb>;
			};
		};
	};

	fragment@2 {
		target = <0xffffffff>;

		__overlay__ {
			pwr_off_seq = <0x4000002>;
		};
	};

	fragment@20 {
		target = <0xffffffff>;

		__overlay__ {

			gps_default {
				phandle = <0x12>;
			};

			gps_l1_lna@0 {
				phandle = <0x13>;

				pins_cmd_dat {
					output-low;
					pinmux = <0x6f00>;
				};
			};

			gps_l1_lna@1 {
				phandle = <0x14>;

				pins_cmd_dat {
					pinmux = <0x6f03>;
				};
			};

			gps_l1_lna@2 {
				phandle = <0x15>;

				pins_cmd_dat {
					output-high;
					pinmux = <0x6f00>;
				};
			};

			gps_l5_lna@0 {
				phandle = <0x16>;

				pins_cmd_dat {
					output-low;
					pinmux = <0x5b00>;
				};
			};

			gps_l5_lna@1 {
				phandle = <0x17>;

				pins_cmd_dat {
					pinmux = <0x5b04>;
				};
			};

			gps_l5_lna@2 {
				phandle = <0x18>;

				pins_cmd_dat {
					output-high;
					pinmux = <0x5b00>;
				};
			};
		};
	};

	fragment@21 {
		target = <0xffffffff>;

		__overlay__ {
			pinctrl-0 = <0x12>;
			pinctrl-1 = <0x13>;
			pinctrl-2 = <0x14>;
			pinctrl-3 = <0x15>;
			pinctrl-4 = <0x16>;
			pinctrl-5 = <0x17>;
			pinctrl-6 = <0x18>;
			pinctrl-names = "default", "gps_l1_lna_disable", "gps_l1_lna_dsp_ctrl", "gps_l1_lna_enable", "gps_l5_lna_disable", "gps_l5_lna_dsp_ctrl", "gps_l5_lna_enable";
			status = "okay";
		};
	};

	fragment@22 {
		target = <0xffffffff>;

		__overlay__ {
			status = "ok";

			abov_sar@20 {
				abov,irq-gpio-std = <0xffffffff 0xc 0x0>;
				cap,use_channel_ch0 = <0x0>;
				cap,use_channel_ch1 = <0x1>;
				cap,use_channel_ch2 = <0x2>;
				cap_vdd-supply = <0xffffffff>;
				ch0_name = "grip_sensor";
				ch1_name = "grip_sensor_wifi";
				ch2_name = "grip_sensor_sub";
				compatible = "abov,abov_sar_mmi_overlay";
				interrupt-parent = <0xffffffff>;
				interrupts = <0xc 0x2 0xc 0x0>;
				label = "AbovCapSense";
				label_la = "AbovCapSenseLA";
				pinctrl-0 = <0x19>;
				pinctrl-names = "abov_int_default";
				reg = <0x20>;
				reg_array_len = <0x3>;
				reg_array_val = <0x7 0x0 0x8 0x3f 0xfb 0x1>;
				status = "ok";
			};
		};
	};

	fragment@23 {
		target = <0xffffffff>;

		__overlay__ {

			abov_int_pin {

				abov_int_default {
					bias-pull-up;
					phandle = <0x19>;
					pinmux = <0xc00>;
					slew-rate = <0x2>;
				};
			};
		};
	};

	fragment@24 {
		target = <0xffffffff>;

		__overlay__ {

			cam0@0 {
				phandle = <0x1b>;

				pins_cmd_dat {
					output-low;
					pinmux = <0x3600>;
					slew-rate = <0x1>;
				};
			};

			cam0@1 {
				phandle = <0x1c>;

				pins_cmd_dat {
					output-high;
					pinmux = <0x3600>;
					slew-rate = <0x1>;
				};
			};

			cam0@vcam0 {
				phandle = <0x23>;

				pins_cmd_dat {
					output-low;
					pinmux = <0x5e00>;
					slew-rate = <0x1>;
				};
			};

			cam0@vcam1 {
				phandle = <0x24>;

				pins_cmd_dat {
					output-high;
					pinmux = <0x5e00>;
					slew-rate = <0x1>;
				};
			};

			cam0@vcam10 {
				phandle = <0x4d>;

				pins_cmd_dat {
					output-low;
					pinmux = <0x5d00>;
					slew-rate = <0x1>;
				};
			};

			cam0@vcam11 {
				phandle = <0x4e>;

				pins_cmd_dat {
					output-high;
					pinmux = <0x5d00>;
					slew-rate = <0x1>;
				};
			};

			cam0@vcam12 {
				phandle = <0x4f>;

				pins_cmd_dat {
					output-low;
					pinmux = <0x8300>;
					slew-rate = <0x1>;
				};
			};

			cam0@vcam13 {
				phandle = <0x50>;

				pins_cmd_dat {
					output-high;
					pinmux = <0x8300>;
					slew-rate = <0x1>;
				};
			};

			cam0@vcam14 {
				phandle = <0x51>;

				pins_cmd_dat {
					output-low;
					pinmux = <0x5d00>;
					slew-rate = <0x1>;
				};
			};

			cam0@vcam15 {
				phandle = <0x52>;

				pins_cmd_dat {
					output-high;
					pinmux = <0x5d00>;
					slew-rate = <0x1>;
				};
			};

			cam0@vcam16 {
				phandle = <0x53>;

				pins_cmd_dat {
					output-low;
					pinmux = <0x5c00>;
					slew-rate = <0x1>;
				};
			};

			cam0@vcam17 {
				phandle = <0x54>;

				pins_cmd_dat {
					output-high;
					pinmux = <0x5c00>;
					slew-rate = <0x1>;
				};
			};

			cam0@vcam2 {
				phandle = <0x25>;

				pins_cmd_dat {
					output-low;
					pinmux = <0xb600>;
					slew-rate = <0x1>;
				};
			};

			cam0@vcam3 {
				phandle = <0x26>;

				pins_cmd_dat {
					output-high;
					pinmux = <0xb600>;
					slew-rate = <0x1>;
				};
			};

			cam0@vcam4 {
				phandle = <0x47>;

				pins_cmd_dat {
					output-low;
					pinmux = <0x8300>;
					slew-rate = <0x1>;
				};
			};

			cam0@vcam5 {
				phandle = <0x48>;

				pins_cmd_dat {
					output-high;
					pinmux = <0x8300>;
					slew-rate = <0x1>;
				};
			};

			cam0@vcam6 {
				phandle = <0x49>;

				pins_cmd_dat {
					output-low;
					pinmux = <0x5d00>;
					slew-rate = <0x1>;
				};
			};

			cam0@vcam7 {
				phandle = <0x4a>;

				pins_cmd_dat {
					output-high;
					pinmux = <0x5d00>;
					slew-rate = <0x1>;
				};
			};

			cam0@vcam8 {
				phandle = <0x4b>;

				pins_cmd_dat {
					output-low;
					pinmux = <0x8300>;
					slew-rate = <0x1>;
				};
			};

			cam0@vcam9 {
				phandle = <0x4c>;

				pins_cmd_dat {
					output-high;
					pinmux = <0x8300>;
					slew-rate = <0x1>;
				};
			};

			cam1@0 {
				phandle = <0x1d>;

				pins_cmd_dat {
					output-low;
					pinmux = <0x3500>;
					slew-rate = <0x1>;
				};
			};

			cam1@1 {
				phandle = <0x1e>;

				pins_cmd_dat {
					output-high;
					pinmux = <0x3500>;
					slew-rate = <0x1>;
				};
			};

			cam1@vcam0 {
				phandle = <0x27>;

				pins_cmd_dat {
					output-low;
					pinmux = <0x5e00>;
					slew-rate = <0x1>;
				};
			};

			cam1@vcam1 {
				phandle = <0x28>;

				pins_cmd_dat {
					output-high;
					pinmux = <0x5e00>;
					slew-rate = <0x1>;
				};
			};

			cam1@vcam2 {
				phandle = <0x29>;

				pins_cmd_dat {
					output-low;
					pinmux = <0xb600>;
					slew-rate = <0x1>;
				};
			};

			cam1@vcam3 {
				phandle = <0x2a>;

				pins_cmd_dat {
					output-high;
					pinmux = <0xb600>;
					slew-rate = <0x1>;
				};
			};

			cam2@0 {
				phandle = <0x1f>;

				pins_cmd_dat {
					output-low;
					pinmux = <0x3c00>;
					slew-rate = <0x1>;
				};
			};

			cam2@1 {
				phandle = <0x20>;

				pins_cmd_dat {
					output-high;
					pinmux = <0x3c00>;
					slew-rate = <0x1>;
				};
			};

			cam2@vcam2 {
				phandle = <0x2b>;

				pins_cmd_dat {
					output-low;
					pinmux = <0xb600>;
					slew-rate = <0x1>;
				};
			};

			cam2@vcam3 {
				phandle = <0x2c>;

				pins_cmd_dat {
					output-high;
					pinmux = <0xb600>;
					slew-rate = <0x1>;
				};
			};

			cam4@0 {
				phandle = <0x21>;

				pins_cmd_dat {
					output-low;
					pinmux = <0x3b00>;
					slew-rate = <0x1>;
				};
			};

			cam4@1 {
				phandle = <0x22>;

				pins_cmd_dat {
					output-high;
					pinmux = <0x3b00>;
					slew-rate = <0x1>;
				};
			};

			cam4@vcam0 {
				phandle = <0x2d>;

				pins_cmd_dat {
					output-low;
					pinmux = <0x5e00>;
					slew-rate = <0x1>;
				};
			};

			cam4@vcam1 {
				phandle = <0x2e>;

				pins_cmd_dat {
					output-high;
					pinmux = <0x5e00>;
					slew-rate = <0x1>;
				};
			};

			cam4@vcam2 {
				phandle = <0x2f>;

				pins_cmd_dat {
					output-low;
					pinmux = <0xb600>;
					slew-rate = <0x1>;
				};
			};

			cam4@vcam3 {
				phandle = <0x30>;

				pins_cmd_dat {
					output-high;
					pinmux = <0xb600>;
					slew-rate = <0x1>;
				};
			};

			camdefault {
				phandle = <0x1a>;
			};

			camera_pins_cam0_mclk_2ma {
				phandle = <0x32>;

				pins_cmd_dat {
					drive-strength = <0x0>;
					pinmux = <0x3101>;
				};
			};

			camera_pins_cam0_mclk_4ma {
				phandle = <0x33>;

				pins_cmd_dat {
					drive-strength = <0x1>;
					pinmux = <0x3101>;
				};
			};

			camera_pins_cam0_mclk_6ma {
				phandle = <0x34>;

				pins_cmd_dat {
					drive-strength = <0x2>;
					pinmux = <0x3101>;
				};
			};

			camera_pins_cam0_mclk_8ma {
				phandle = <0x35>;

				pins_cmd_dat {
					drive-strength = <0x3>;
					pinmux = <0x3101>;
				};
			};

			camera_pins_cam0_mclk_off {
				phandle = <0x31>;

				pins_cmd_dat {
					drive-strength = <0x1>;
					pinmux = <0x3100>;
				};
			};

			camera_pins_cam1_mclk_2ma {
				phandle = <0x37>;

				pins_cmd_dat {
					drive-strength = <0x0>;
					pinmux = <0x3401>;
				};
			};

			camera_pins_cam1_mclk_4ma {
				phandle = <0x38>;

				pins_cmd_dat {
					drive-strength = <0x1>;
					pinmux = <0x3401>;
				};
			};

			camera_pins_cam1_mclk_6ma {
				phandle = <0x39>;

				pins_cmd_dat {
					drive-strength = <0x2>;
					pinmux = <0x3401>;
				};
			};

			camera_pins_cam1_mclk_8ma {
				phandle = <0x3a>;

				pins_cmd_dat {
					drive-strength = <0x3>;
					pinmux = <0x3401>;
				};
			};

			camera_pins_cam1_mclk_off {
				phandle = <0x36>;

				pins_cmd_dat {
					drive-strength = <0x1>;
					pinmux = <0x3400>;
				};
			};

			camera_pins_cam2_mclk_2ma {
				phandle = <0x3c>;

				pins_cmd_dat {
					drive-strength = <0x0>;
					pinmux = <0x3201>;
				};
			};

			camera_pins_cam2_mclk_4ma {
				phandle = <0x3d>;

				pins_cmd_dat {
					drive-strength = <0x1>;
					pinmux = <0x3201>;
				};
			};

			camera_pins_cam2_mclk_6ma {
				phandle = <0x3e>;

				pins_cmd_dat {
					drive-strength = <0x2>;
					pinmux = <0x3201>;
				};
			};

			camera_pins_cam2_mclk_8ma {
				phandle = <0x3f>;

				pins_cmd_dat {
					drive-strength = <0x3>;
					pinmux = <0x3201>;
				};
			};

			camera_pins_cam2_mclk_off {
				phandle = <0x3b>;

				pins_cmd_dat {
					drive-strength = <0x1>;
					pinmux = <0x3200>;
				};
			};

			camera_pins_cam4_mclk_2ma {
				phandle = <0x41>;

				pins_cmd_dat {
					drive-strength = <0x0>;
					pinmux = <0x3301>;
				};
			};

			camera_pins_cam4_mclk_4ma {
				phandle = <0x42>;

				pins_cmd_dat {
					drive-strength = <0x1>;
					pinmux = <0x3301>;
				};
			};

			camera_pins_cam4_mclk_6ma {
				phandle = <0x43>;

				pins_cmd_dat {
					drive-strength = <0x2>;
					pinmux = <0x3301>;
				};
			};

			camera_pins_cam4_mclk_8ma {
				phandle = <0x44>;

				pins_cmd_dat {
					drive-strength = <0x3>;
					pinmux = <0x3301>;
				};
			};

			camera_pins_cam4_mclk_off {
				phandle = <0x40>;

				pins_cmd_dat {
					drive-strength = <0x1>;
					pinmux = <0x3300>;
				};
			};

			int_active {
				phandle = <0x55>;

				pins_cmd_dat {
					input-enable;
					pinmux = <0x5d00>;
				};
			};

			mipi_sel@0 {
				phandle = <0x46>;

				pins_cmd_dat {
					output-low;
					pinmux = <0x8b00>;
					slew-rate = <0x1>;
				};
			};

			mipi_sel@1 {
				phandle = <0x45>;

				pins_cmd_dat {
					output-high;
					pinmux = <0x8b00>;
					slew-rate = <0x1>;
				};
			};
		};
	};

	fragment@25 {
		target = <0xffffffff>;

		__overlay__ {
			cam0_enable_sensor = "w1hi4821qrearqt_mipi_raw w1hi4821qrearsy_mipi_raw w1ov48b2qrearxl_mipi_raw w1ov64b40reartxd_mipi_raw";
			cam0_vcamio-supply = <0xffffffff>;
			cam1_enable_sensor = "w1hi846frontst_mipi_raw w1gc8034frontdc_mipi_raw w1hi846frontst2_mipi_raw w1c8490fronttxd_mipi_raw";
			cam1_vcamio-supply = <0xffffffff>;
			cam2_enable_sensor = "w1c2515depsj_mipi_mono w1c2515depsj64_mipi_mono w1bf2253deplh_mipi_raw w1bf2253deplh3_mipi_raw w1bf2253deplh64_mipi_raw w1gc02m1bdepcxt_mipi_mono w1gc02m1bdepcxt5_mipi_mono";
			cam2_vcamio-supply = <0xffffffff>;
			cam3_enable_sensor = "w1_cam3_dummy_sensor_mipi_raw";
			cam4_enable_sensor = "w1hi556widexl_mipi_raw w1gc5035cwidecxt_mipi_raw w1sc500cswidely_mipi_raw";
			cam4_vcamio-supply = <0xffffffff>;
			pinctrl-0 = <0x1a>;
			pinctrl-1 = <0x1b>;
			pinctrl-10 = <0x24>;
			pinctrl-11 = <0x25>;
			pinctrl-12 = <0x26>;
			pinctrl-13 = <0x27>;
			pinctrl-14 = <0x28>;
			pinctrl-15 = <0x29>;
			pinctrl-16 = <0x2a>;
			pinctrl-17 = <0x2b>;
			pinctrl-18 = <0x2c>;
			pinctrl-19 = <0x2d>;
			pinctrl-2 = <0x1c>;
			pinctrl-20 = <0x2e>;
			pinctrl-21 = <0x2f>;
			pinctrl-22 = <0x30>;
			pinctrl-23 = <0x31>;
			pinctrl-24 = <0x32>;
			pinctrl-25 = <0x33>;
			pinctrl-26 = <0x34>;
			pinctrl-27 = <0x35>;
			pinctrl-28 = <0x36>;
			pinctrl-29 = <0x37>;
			pinctrl-3 = <0x1d>;
			pinctrl-30 = <0x38>;
			pinctrl-31 = <0x39>;
			pinctrl-32 = <0x3a>;
			pinctrl-33 = <0x3b>;
			pinctrl-34 = <0x3c>;
			pinctrl-35 = <0x3d>;
			pinctrl-36 = <0x3e>;
			pinctrl-37 = <0x3f>;
			pinctrl-38 = <0x40>;
			pinctrl-39 = <0x41>;
			pinctrl-4 = <0x1e>;
			pinctrl-40 = <0x42>;
			pinctrl-41 = <0x43>;
			pinctrl-42 = <0x44>;
			pinctrl-43 = <0x45>;
			pinctrl-44 = <0x46>;
			pinctrl-45 = <0x47>;
			pinctrl-46 = <0x48>;
			pinctrl-47 = <0x49>;
			pinctrl-48 = <0x4a>;
			pinctrl-49 = <0x4b>;
			pinctrl-5 = <0x1f>;
			pinctrl-50 = <0x4c>;
			pinctrl-51 = <0x4d>;
			pinctrl-52 = <0x4e>;
			pinctrl-53 = <0x4f>;
			pinctrl-54 = <0x50>;
			pinctrl-55 = <0x51>;
			pinctrl-56 = <0x52>;
			pinctrl-57 = <0x53>;
			pinctrl-58 = <0x54>;
			pinctrl-59 = <0x55>;
			pinctrl-6 = <0x20>;
			pinctrl-7 = <0x21>;
			pinctrl-8 = <0x22>;
			pinctrl-9 = <0x23>;
			pinctrl-names = "default", "cam0_rst0", "cam0_rst1", "cam1_rst0", "cam1_rst1", "cam2_rst0", "cam2_rst1", "cam4_rst0", "cam4_rst1", "cam0_ldo_vcamd_0", "cam0_ldo_vcamd_1", "cam0_ldo_vcama_0", "cam0_ldo_vcama_1", "cam1_ldo_vcamd_0", "cam1_ldo_vcamd_1", "cam1_ldo_vcama_0", "cam1_ldo_vcama_1", "cam2_ldo_vcama_0", "cam2_ldo_vcama_1", "cam4_ldo_vcamd_0", "cam4_ldo_vcamd_1", "cam4_ldo_vcama_0", "cam4_ldo_vcama_1", "cam0_mclk_off", "cam0_mclk_2mA", "cam0_mclk_4mA", "cam0_mclk_6mA", "cam0_mclk_8mA", "cam1_mclk_off", "cam1_mclk_2mA", "cam1_mclk_4mA", "cam1_mclk_6mA", "cam1_mclk_8mA", "cam2_mclk_off", "cam2_mclk_2mA", "cam2_mclk_4mA", "cam2_mclk_6mA", "cam2_mclk_8mA", "cam4_mclk_off", "cam4_mclk_2mA", "cam4_mclk_4mA", "cam4_mclk_6mA", "cam4_mclk_8mA", "cam_mipi_switch_sel_1", "cam_mipi_switch_sel_0", "cam0_ldo_vcamd_1v1_0", "cam0_ldo_vcamd_1v1_1", "cam0_ldo_vcamd_1v2_0", "cam0_ldo_vcamd_1v2_1", "cam1_ldo_vcamd_1v1_0", "cam1_ldo_vcamd_1v1_1", "cam1_ldo_vcamd_1v2_0", "cam1_ldo_vcamd_1v2_1", "cam4_ldo_vcamd_1v1_0", "cam4_ldo_vcamd_1v1_1", "cam4_ldo_vcamd_1v2_0", "cam4_ldo_vcamd_1v2_1", "cam4_ldo_vcamd2_0", "cam4_ldo_vcamd2_1", "cam0_ldo_vcamd_1v2_in";
			status = "okay";
		};
	};

	fragment@26 {
		target = <0xffffffff>;

		__overlay__ {

			camera_eeprom4@51 {
				compatible = "mediatek,camera_eeprom";
				phandle = <0x70>;
				reg = <0x51>;
				status = "okay";
			};
		};
	};

	fragment@27 {
		target = <0xffffffff>;

		__overlay__ {

			camera_eeprom1@51 {
				compatible = "mediatek,camera_eeprom";
				phandle = <0x71>;
				reg = <0x51>;
				status = "okay";
			};

			camera_eeprom2@50 {
				compatible = "mediatek,camera_eeprom";
				phandle = <0x72>;
				reg = <0x50>;
				status = "okay";
			};
		};
	};

	fragment@28 {
		target = <0xffffffff>;

		__overlay__ {

			camera_eeprom0@50 {
				compatible = "mediatek,camera_eeprom";
				phandle = <0x73>;
				reg = <0x50>;
				status = "okay";
			};
		};
	};

	fragment@29 {
		target = <0xffffffff>;

		__overlay__ {
			status = "okay";
			vldo28-supply = <0xffffffff>;
		};
	};

	fragment@3 {
		target = <0xffffffff>;

		__overlay__ {
			mt6360pd,intr_gpio = <0xffffffff 0x9 0x0>;
			mt6360pd,intr_gpio_num = <0x9>;
		};
	};

	fragment@30 {
		target = <0xffffffff>;

		__overlay__ {

			adc_channel@ {
				compatible = "mediatek,adc_channel";
				mediatek,adc_fdd_rf_params_dynamic_custom_ch = <0x2>;
				mediatek,temperature0 = <0x0>;
				mediatek,temperature1 = <0x1>;
				status = "okay";
			};
		};
	};

	fragment@31 {
		target = <0xffffffff>;

		__overlay__ {
			io-channels = <0xffffffff 0x2>;
		};
	};

	fragment@32 {
		target = <0xffffffff>;

		__overlay__ {
			mediatek,clkbuf-config = <0x2 0x1 0x1 0x2 0x0 0x0 0x1>;
			mediatek,clkbuf-controls-for-desense = <0x0 0x4 0x0 0x4 0x0 0x0 0x0>;
			mediatek,clkbuf-output-impedance = <0x6 0x4 0x4 0x4 0x0 0x0 0x4>;
			mediatek,clkbuf-quantity = <0x7>;
			status = "okay";
		};
	};

	fragment@33 {
		target = <0xffffffff>;

		__overlay__ {
			#address-cells = <0x1>;
			#size-cells = <0x0>;
			clock-frequency = <0x61a80>;
			mediatek,use-open-drain;
		};
	};

	fragment@34 {
		target = <0xffffffff>;

		__overlay__ {
			#address-cells = <0x1>;
			#size-cells = <0x0>;
			clock-frequency = <0x61a80>;
			mediatek,use-open-drain;
		};
	};

	fragment@35 {
		target = <0xffffffff>;

		__overlay__ {
			#address-cells = <0x1>;
			#size-cells = <0x0>;
			clock-frequency = <0x61a80>;
			mediatek,use-open-drain;

			camera_main@1a {
				compatible = "mediatek,camera_main";
				phandle = <0x74>;
				reg = <0x1a>;
				status = "okay";
			};

			camera_main_eeprom@1a {
				compatible = "mediatek,camera_main_eeprom";
				phandle = <0x75>;
				reg = <0x1a>;
				status = "okay";
			};

			camera_main_three_af@0c {
				compatible = "mediatek,camera_main_three_af";
				phandle = <0x76>;
				reg = <0xc>;
				status = "okay";
			};
		};
	};

	fragment@36 {
		target = <0xffffffff>;

		__overlay__ {
			#address-cells = <0x1>;
			#size-cells = <0x0>;
			clock-frequency = <0x61a80>;
			mediatek,use-open-drain;
		};
	};

	fragment@37 {
		target = <0xffffffff>;

		__overlay__ {
			#address-cells = <0x1>;
			#size-cells = <0x0>;
			clock-frequency = <0x61a80>;
			mediatek,use-open-drain;

			camera_main_two_af@0c {
				compatible = "mediatek,camera_main_two_af";
				phandle = <0x79>;
				reg = <0xc>;
				status = "okay";
			};

			camera_sub@1a {
				compatible = "mediatek,camera_sub";
				phandle = <0x77>;
				reg = <0x1a>;
				status = "okay";
			};

			camera_sub_eeprom@a0 {
				compatible = "mediatek,camera_sub_eeprom";
				phandle = <0x78>;
				reg = <0xa0>;
				status = "okay";
			};
		};
	};

	fragment@38 {
		target = <0xffffffff>;

		__overlay__ {
			#address-cells = <0x1>;
			#size-cells = <0x0>;
			clock-frequency = <0x33e140>;
			mediatek,use-push-pull;

			subpmic@34 {
				compatible = "mediatek,subpmic";
				phandle = <0x7a>;
				reg = <0x34>;
				status = "okay";
			};

			subpmic_ldo@64 {
				compatible = "mediatek,subpmic_ldo";
				phandle = <0x7d>;
				reg = <0x64>;
				status = "okay";
			};

			subpmic_pmic@1a {
				compatible = "mediatek,subpmic_pmic";
				phandle = <0x7c>;
				reg = <0x1a>;
				status = "okay";
			};

			usb_type_c@4e {
				compatible = "mediatek,usb_type_c";
				phandle = <0x7b>;
				reg = <0x4e>;
				status = "okay";
			};
		};
	};

	fragment@39 {
		target = <0xffffffff>;

		__overlay__ {
			#address-cells = <0x1>;
			#size-cells = <0x0>;
			clock-frequency = <0x61a80>;
			mediatek,use-open-drain;

			i2c_lcd_bias@73 {
				compatible = "mediatek,i2c_lcd_bias";
				phandle = <0x7e>;
				reg = <0x73>;
				status = "okay";
			};
		};
	};

	fragment@4 {
		target = <0xffffffff>;

		__overlay__ {
			ac_charger_current = <0x1e8480>;
			ac_charger_input_current = <0x1e8480>;
			ta_ac_charger_current = <0x1e8480>;
		};
	};

	fragment@40 {
		target = <0xffffffff>;

		__overlay__ {
			#address-cells = <0x1>;
			#size-cells = <0x0>;
			clock-frequency = <0x61a80>;
			mediatek,use-open-drain;
		};
	};

	fragment@41 {
		target = <0xffffffff>;

		__overlay__ {
			#address-cells = <0x1>;
			#size-cells = <0x0>;
			clock-frequency = <0x61a80>;
			mediatek,use-open-drain;

			camera_main_af@72 {
				compatible = "mediatek,camera_main_af";
				phandle = <0x80>;
				reg = <0x72>;
				status = "okay";
			};

			camera_main_two@10 {
				compatible = "mediatek,camera_main_two";
				phandle = <0x7f>;
				reg = <0x10>;
				status = "okay";
			};
		};
	};

	fragment@42 {
		target = <0xffffffff>;

		__overlay__ {
			#address-cells = <0x1>;
			#size-cells = <0x0>;
			clock-frequency = <0x61a80>;
			mediatek,use-open-drain;

			camera_main_three@10 {
				compatible = "mediatek,camera_main_three";
				phandle = <0x81>;
				reg = <0x10>;
				status = "okay";
			};
		};
	};

	fragment@43 {
		target = <0xffffffff>;

		__overlay__ {
			GPIO_FDD_BAND_SUPPORT_DETECT_1ST_PIN = <0xffffffff 0x2c 0x0>;
			GPIO_FDD_BAND_SUPPORT_DETECT_2ND_PIN = <0xffffffff 0x2d 0x0>;
			GPIO_FDD_BAND_SUPPORT_DETECT_3RD_PIN = <0xffffffff 0x2e 0x0>;
			GPIO_FDD_BAND_SUPPORT_DETECT_4TH_PIN = <0xffffffff 0x2f 0x0>;
			GPIO_FDD_BAND_SUPPORT_DETECT_5TH_PIN = <0xffffffff 0x30 0x0>;
			GPIO_RF_PWREN_RST_PIN = <0xffffffff 0xab 0x0>;
			GPIO_SIM1_HOT_PLUG = <0xffffffff 0x4d 0x0>;
			GPIO_SIM1_SCLK = <0xffffffff 0x7c 0x0>;
			GPIO_SIM1_SIO = <0xffffffff 0x7a 0x0>;
			GPIO_SIM1_SRST = <0xffffffff 0x7b 0x0>;
			GPIO_SIM2_HOT_PLUG = <0xffffffff 0x4e 0x0>;
			GPIO_SIM2_SCLK = <0xffffffff 0x77 0x0>;
			GPIO_SIM2_SIO = <0xffffffff 0x79 0x0>;
			GPIO_SIM2_SRST = <0xffffffff 0x78 0x0>;
		};
	};

	fragment@44 {
		target = <0xffffffff>;

		__overlay__ {
			gpio_init_default = <0x0 0x0 0x0 0x0 0x1 0x0 0x1 0x1 0x0 0x0 0x0 0x1 0x1 0x1 0x2 0x0 0x0 0x0 0x1 0x1 0x1 0x3 0x0 0x0 0x0 0x1 0x0 0x1 0x4 0x0 0x0 0x0 0x1 0x1 0x1 0x5 0x0 0x0 0x0 0x1 0x0 0x1 0x6 0x0 0x1 0x0 0x1 0x0 0x1 0x7 0x0 0x1 0x0 0x1 0x0 0x1 0x8 0x7 0x0 0x0 0x1 0x0 0x1 0x9 0x0 0x0 0x0 0x1 0x1 0x1 0xa 0x0 0x0 0x0 0x1 0x1 0x1 0xb 0x0 0x0 0x0 0x1 0x1 0x1 0xc 0x0 0x0 0x0 0x1 0x1 0x1 0xd 0x2 0x0 0x0 0x1 0x0 0x1 0xe 0x0 0x0 0x0 0x1 0x1 0x1 0xf 0x0 0x1 0x0 0x1 0x0 0x1 0x10 0x7 0x0 0x0 0x1 0x0 0x1 0x11 0x0 0x1 0x0 0x1 0x0 0x1 0x12 0x0 0x0 0x0 0x1 0x0 0x1 0x13 0x7 0x0 0x0 0x0 0x0 0x1 0x14 0x7 0x0 0x0 0x1 0x0 0x1 0x15 0x7 0x0 0x0 0x1 0x0 0x1 0x16 0x7 0x0 0x0 0x1 0x0 0x1 0x17 0x0 0x0 0x0 0x0 0x0 0x1 0x18 0x0 0x0 0x0 0x1 0x1 0x1 0x19 0x0 0x0 0x0 0x0 0x0 0x1 0x1a 0x0 0x0 0x0 0x0 0x0 0x1 0x1b 0x1 0x1 0x0 0x0 0x0 0x1 0x1c 0x1 0x1 0x0 0x0 0x0 0x1 0x1d 0x1 0x1 0x0 0x0 0x0 0x1 0x1e 0x1 0x0 0x0 0x1 0x0 0x1 0x1f 0x2 0x0 0x0 0x0 0x0 0x1 0x20 0x2 0x0 0x0 0x0 0x0 0x1 0x21 0x2 0x0 0x0 0x0 0x0 0x1 0x22 0x2 0x0 0x0 0x1 0x0 0x1 0x23 0x1 0x0 0x0 0x1 0x1 0x1 0x24 0x1 0x0 0x0 0x0 0x0 0x1 0x25 0x1 0x0 0x0 0x0 0x0 0x1 0x26 0x1 0x0 0x0 0x1 0x1 0x1 0x27 0x0 0x0 0x0 0x1 0x1 0x1 0x28 0x1 0x0 0x0 0x0 0x0 0x1 0x29 0x1 0x0 0x0 0x0 0x0 0x1 0x2a 0x1 0x0 0x0 0x1 0x0 0x1 0x2b 0x1 0x0 0x0 0x0 0x0 0x1 0x2c 0x0 0x0 0x0 0x1 0x0 0x1 0x2d 0x0 0x0 0x0 0x1 0x0 0x1 0x2e 0x0 0x0 0x0 0x1 0x0 0x1 0x2f 0x0 0x0 0x0 0x1 0x0 0x1 0x30 0x0 0x0 0x0 0x1 0x0 0x1 0x31 0x0 0x0 0x0 0x0 0x0 0x1 0x32 0x0 0x0 0x0 0x0 0x0 0x1 0x33 0x0 0x0 0x0 0x0 0x0 0x1 0x34 0x0 0x0 0x0 0x0 0x0 0x1 0x35 0x0 0x1 0x0 0x1 0x0 0x1 0x36 0x0 0x1 0x0 0x1 0x0 0x1 0x37 0x0 0x1 0x0 0x1 0x0 0x1 0x38 0x0 0x1 0x0 0x1 0x0 0x1 0x39 0x0 0x1 0x0 0x1 0x0 0x1 0x3a 0x0 0x1 0x0 0x1 0x0 0x1 0x3b 0x0 0x1 0x0 0x1 0x0 0x1 0x3c 0x0 0x1 0x0 0x1 0x0 0x1 0x3d 0x1 0x0 0x0 0x1 0x1 0x1 0x3e 0x1 0x0 0x0 0x0 0x0 0x1 0x3f 0x1 0x0 0x0 0x1 0x1 0x1 0x40 0x1 0x0 0x0 0x0 0x0 0x1 0x4d 0x1 0x0 0x0 0x1 0x1 0x1 0x4e 0x1 0x0 0x0 0x1 0x1 0x1 0x4f 0x1 0x0 0x0 0x1 0x1 0x1 0x50 0x1 0x0 0x0 0x1 0x1 0x1 0x51 0x3 0x0 0x0 0x1 0x0 0x1 0x52 0x0 0x1 0x0 0x1 0x0 0x1 0x53 0x1 0x0 0x0 0x0 0x0 0x1 0x54 0x1 0x0 0x0 0x1 0x0 0x1 0x55 0x1 0x0 0x0 0x0 0x0 0x1 0x56 0x1 0x0 0x0 0x0 0x0 0x1 0x57 0x0 0x0 0x0 0x1 0x0 0x1 0x58 0x0 0x0 0x0 0x1 0x0 0x1 0x59 0x0 0x0 0x0 0x1 0x0 0x1 0x5a 0x1 0x0 0x0 0x0 0x0 0x1 0x5b 0x0 0x0 0x0 0x1 0x0 0x1 0x5c 0x0 0x1 0x0 0x1 0x0 0x1 0x5d 0x0 0x1 0x0 0x1 0x0 0x1 0x5e 0x0 0x1 0x0 0x1 0x0 0x1 0x5f 0x1 0x0 0x0 0x1 0x0 0x1 0x60 0x1 0x0 0x0 0x1 0x0 0x1 0x61 0x1 0x0 0x0 0x1 0x1 0x1 0x62 0x1 0x0 0x0 0x1 0x1 0x1 0x63 0x2 0x0 0x0 0x1 0x1 0x1 0x64 0x2 0x0 0x0 0x1 0x1 0x1 0x65 0x1 0x0 0x0 0x1 0x1 0x1 0x66 0x1 0x0 0x0 0x1 0x1 0x1 0x67 0x1 0x0 0x0 0x1 0x1 0x1 0x68 0x1 0x0 0x0 0x1 0x1 0x1 0x69 0x1 0x0 0x0 0x1 0x1 0x1 0x6a 0x1 0x0 0x0 0x1 0x1 0x1 0x6b 0x1 0x0 0x0 0x1 0x1 0x1 0x6c 0x1 0x0 0x0 0x1 0x1 0x1 0x6d 0x1 0x0 0x0 0x1 0x1 0x1 0x6e 0x1 0x0 0x0 0x1 0x1 0x1 0x6f 0x3 0x0 0x0 0x1 0x0 0x1 0x70 0x0 0x0 0x0 0x0 0x0 0x1 0x71 0x1 0x0 0x0 0x1 0x1 0x1 0x72 0x1 0x0 0x0 0x1 0x1 0x1 0x73 0x1 0x0 0x0 0x1 0x0 0x1 0x74 0x1 0x0 0x0 0x1 0x0 0x1 0x75 0x0 0x0 0x0 0x1 0x0 0x1 0x76 0x0 0x0 0x0 0x1 0x0 0x1 0x77 0x1 0x0 0x0 0x0 0x0 0x1 0x78 0x1 0x0 0x0 0x0 0x0 0x1 0x79 0x1 0x0 0x0 0x1 0x1 0x1 0x7a 0x1 0x0 0x0 0x1 0x1 0x1 0x7b 0x1 0x0 0x0 0x0 0x0 0x1 0x7c 0x1 0x0 0x0 0x0 0x0 0x1 0x7d 0x1 0x0 0x0 0x0 0x0 0x1 0x7e 0x1 0x0 0x0 0x1 0x1 0x1 0x7f 0x1 0x0 0x0 0x1 0x1 0x1 0x80 0x1 0x0 0x0 0x1 0x1 0x1 0x81 0x1 0x0 0x0 0x1 0x1 0x1 0x82 0x1 0x0 0x0 0x1 0x1 0x1 0x83 0x0 0x1 0x0 0x1 0x0 0x1 0x84 0x0 0x1 0x0 0x1 0x0 0x1 0x85 0x0 0x1 0x0 0x1 0x0 0x1 0x86 0x0 0x1 0x0 0x1 0x0 0x1 0x87 0x0 0x1 0x0 0x1 0x0 0x1 0x88 0x0 0x1 0x1 0x1 0x0 0x1 0x89 0x0 0x1 0x0 0x1 0x0 0x1 0x8a 0x0 0x1 0x0 0x1 0x0 0x1 0x8b 0x0 0x1 0x0 0x1 0x0 0x1 0x8c 0x0 0x1 0x0 0x1 0x0 0x1 0x8d 0x1 0x0 0x0 0x1 0x1 0x1 0x8e 0x1 0x0 0x0 0x1 0x1 0x1 0x8f 0x1 0x0 0x0 0x0 0x0 0x1 0x90 0x1 0x0 0x0 0x0 0x0 0x1 0x91 0x1 0x0 0x0 0x0 0x0 0x1 0x92 0x1 0x0 0x0 0x0 0x0 0x1 0x93 0x1 0x0 0x0 0x0 0x0 0x1 0x94 0x1 0x0 0x0 0x0 0x0 0x1 0x95 0x1 0x0 0x0 0x1 0x0 0x1 0x96 0x1 0x0 0x0 0x1 0x0 0x1 0x97 0x1 0x0 0x0 0x1 0x0 0x1 0x98 0x1 0x0 0x0 0x1 0x0 0x1 0x99 0x1 0x0 0x0 0x0 0x0 0x1 0x9a 0x1 0x0 0x0 0x0 0x0 0x1 0x9b 0x1 0x0 0x0 0x0 0x0 0x1 0x9c 0x1 0x0 0x0 0x0 0x0 0x1 0x9d 0x1 0x0 0x0 0x0 0x0 0x1 0x9e 0x1 0x0 0x0 0x0 0x0 0x1 0x9f 0x1 0x0 0x0 0x1 0x0 0x1 0xa0 0x1 0x0 0x0 0x1 0x0 0x1 0xa1 0x1 0x0 0x0 0x1 0x0 0x1 0xa2 0x1 0x0 0x0 0x0 0x0 0x0 0xa3 0x1 0x0 0x0 0x1 0x0 0x0 0xa4 0x1 0x0 0x0 0x1 0x0 0x1 0xa5 0x1 0x0 0x0 0x1 0x0 0x1 0xa6 0x1 0x0 0x0 0x0 0x0 0x1 0xa7 0x1 0x0 0x0 0x0 0x0 0x1 0xa8 0x1 0x0 0x0 0x0 0x0 0x1 0xa9 0x1 0x0 0x0 0x0 0x0 0x1 0xaa 0x1 0x0 0x0 0x0 0x0 0x1 0xab 0x0 0x1 0x1 0x1 0x0 0x1 0xac 0x1 0x0 0x0 0x0 0x0 0x1 0xad 0x1 0x0 0x0 0x0 0x0 0x1 0xae 0x1 0x0 0x0 0x0 0x0 0x1 0xaf 0x1 0x0 0x0 0x0 0x0 0x1 0xb0 0x1 0x0 0x0 0x0 0x0 0x1 0xb1 0x1 0x0 0x0 0x0 0x0 0x1 0xb2 0x1 0x0 0x0 0x0 0x0 0x1 0xb3 0x0 0x0 0x0 0x1 0x0 0x1 0xb4 0x1 0x0 0x0 0x0 0x0 0x1 0xb5 0x1 0x0 0x0 0x0 0x0 0x1 0xb6 0x0 0x1 0x0 0x1 0x0 0x1 0xb7 0x1 0x0 0x0 0x0 0x0 0x1 0xb8 0x1 0x0 0x0 0x0 0x0 0x1 0xb9 0x1 0x0 0x0 0x0 0x0 0x1 0xba 0x1 0x0 0x0 0x0 0x0 0x1 0xbb 0x1 0x0 0x0 0x0 0x0 0x1 0xbc 0x1 0x0 0x0 0x0 0x0 0x0 0xbd 0x1 0x0 0x0 0x1 0x0 0x0 0xbe 0x1 0x0 0x0 0x0 0x0 0x0 0xbf 0x1 0x0 0x0 0x1 0x0 0x0 0xc0 0x0 0x0 0x0 0x1 0x0 0x1 0xc1 0x0 0x0 0x0 0x1 0x0 0x1 0xc2 0x0 0x0 0x0 0x1 0x0 0x1 0xc3 0x0 0x0 0x0 0x1 0x0 0x1 0xc4 0x0 0x0 0x0 0x1 0x0 0x1 0xc5 0x0 0x0 0x0 0x1 0x0 0x1 0xc6 0x0 0x0 0x0 0x1 0x0 0x1 0xc7 0x0 0x0 0x0 0x1 0x0 0x1 0xc8 0x0 0x0 0x0 0x1 0x0 0x1>;
		};
	};

	fragment@45 {
		target = <0xffffffff>;

		__overlay__ {
			deb-gpios = <0xffffffff 0x1 0x0>;
			debounce = <0x7d000>;
			interrupt-parent = <0xffffffff>;
			interrupts = <0x1 0x8>;
			status = "okay";
		};
	};

	fragment@46 {
		target = <0xffffffff>;

		__overlay__ {
			interrupt-parent = <0xffffffff>;
			interrupts = <0x4 0x1>;
			status = "okay";
		};
	};

	fragment@47 {
		target = <0xffffffff>;

		__overlay__ {
			interrupt-parent = <0xffffffff>;
			interrupts = <0xa 0x2>;
			status = "okay";
		};
	};

	fragment@48 {
		target = <0xffffffff>;

		__overlay__ {
			deb-gpios = <0xffffffff 0xb 0x0>;
			debounce = <0x7d000>;
			interrupt-parent = <0xffffffff>;
			interrupts = <0xb 0x8>;
			status = "okay";
		};
	};

	fragment@49 {
		target = <0xffffffff>;

		__overlay__ {
			interrupt-parent = <0xffffffff>;
			interrupts = <0xe 0x8>;
			status = "okay";
		};
	};

	fragment@5 {
		target = <0xffffffff>;

		__overlay__ {
			ACTIVE_TABLE = <0x5>;
			battery0_profile_t0 = <0x0 0xa9d8 0x370 0x202 0xa924 0x36c 0x403 0xa87f 0x359 0x605 0xa7ed 0x360 0x807 0xa764 0x360 0xa08 0xa6e1 0x359 0xc0a 0xa669 0x36e 0xe0b 0xa5f1 0x384 0x100d 0xa571 0x36f 0x120f 0xa4fe 0x36b 0x1410 0xa48a 0x36b 0x1612 0xa416 0x375 0x1814 0xa3a4 0x37d 0x1a15 0xa32d 0x36e 0x1c17 0xa2be 0x384 0x1e19 0xa24f 0x384 0x201a 0xa1df 0x384 0x221c 0xa170 0x384 0x241d 0xa100 0x384 0x261f 0xa08f 0x384 0x2821 0xa021 0x384 0x2a22 0x9fbb 0x384 0x2c24 0x9f54 0x399 0x2e26 0x9eed 0x39d 0x3027 0x9e87 0x38f 0x3229 0x9e31 0x3a3 0x342b 0x9ddc 0x3c1 0x362c 0x9d61 0x39d 0x382e 0x9cd8 0x39d 0x3a2f 0x9c71 0x3b2 0x3c31 0x9c34 0x3c7 0x3e33 0x9bf0 0x3c1 0x4034 0x9b9f 0x3b6 0x4236 0x9b4c 0x3bd 0x4438 0x9aff 0x3cf 0x4639 0x9ab2 0x3cf 0x483b 0x9a65 0x3e4 0x4a3d 0x9a18 0x3f9 0x4c3e 0x99cb 0x401 0x4e40 0x997e 0x415 0x5041 0x9933 0x440 0x5243 0x98ea 0x462 0x5445 0x9883 0x44d 0x5646 0x97fc 0x3f9 0x5848 0x977a 0x3b5 0x5a4a 0x970f 0x382 0x5c4b 0x96bc 0x36b 0x5e4d 0x967a 0x36b 0x604f 0x963e 0x36b 0x6250 0x9603 0x36b 0x6452 0x95cf 0x357 0x6653 0x95a2 0x363 0x6855 0x9577 0x378 0x6a57 0x9548 0x37a 0x6c58 0x951a 0x372 0x6e5a 0x94f6 0x381 0x705c 0x94cb 0x36c 0x725d 0x94a9 0x380 0x745f 0x9487 0x384 0x7661 0x9464 0x384 0x7862 0x9442 0x384 0x7a64 0x9422 0x38a 0x7c65 0x9409 0x3a0 0x7e67 0x93ef 0x3b5 0x8069 0x93d5 0x3b6 0x826a 0x93bc 0x3b6 0x846c 0x93a2 0x3c3 0x866e 0x9388 0x3cf 0x886f 0x936c 0x3cf 0x8a71 0x9345 0x3c7 0x8c73 0x92f8 0x387 0x8e74 0x92ab 0x370 0x9076 0x9279 0x37c 0x9277 0x924e 0x384 0x9479 0x9227 0x384 0x967b 0x9202 0x384 0x987c 0x91d7 0x384 0x9a7e 0x91ad 0x384 0x9c80 0x918a 0x384 0x9e81 0x9168 0x395 0xa083 0x913b 0x39d 0xa285 0x9104 0x39d 0xa486 0x90c8 0x39d 0xa688 0x908b 0x39d 0xa889 0x9047 0x39d 0xaa8b 0x8ff2 0x389 0xac8d 0x8fb7 0x374 0xae8e 0x8fa2 0x378 0xb090 0x8f9e 0x397 0xb292 0x8f93 0x3bc 0xb493 0x8f81 0x3d6 0xb695 0x8f67 0x416 0xb897 0x8efd 0x406 0xba98 0x8db9 0x3e0 0xbc9a 0x8bd5 0x3f6 0xbe9b 0x893d 0x436 0xc09d 0x8560 0x4a5 0xc29f 0x7ebe 0x8d3 0xc4a0 0x729c 0xd16 0xc6a2 0x729c 0xd16>;
			battery0_profile_t0_col = <0x3>;
			battery0_profile_t0_num = <0x64>;
			battery0_profile_t1 = <0x0 0xaa32 0x4b0 0x202 0xa976 0x4b0 0x403 0xa8cf 0x4b0 0x605 0xa837 0x4b0 0x807 0xa7ae 0x4b0 0xa08 0xa731 0x4b0 0xc0a 0xa6b9 0x4b0 0xe0b 0xa641 0x4b0 0x100d 0xa5c9 0x4b0 0x120f 0xa551 0x49e 0x1410 0xa4da 0x497 0x1612 0xa466 0x497 0x1814 0xa3f7 0x497 0x1a15 0xa387 0x49a 0x1c17 0xa318 0x4b0 0x1e19 0xa2a9 0x4b0 0x201a 0xa240 0x4c1 0x221c 0xa1cf 0x4bb 0x241d 0xa15a 0x4ba 0x261f 0xa0e9 0x4c9 0x2821 0xa07b 0x4cc 0x2a22 0xa015 0x4e2 0x2c24 0x9fae 0x4e2 0x2e26 0x9f5c 0x505 0x3027 0x9f26 0x53e 0x3229 0x9eef 0x574 0x342b 0x9e8f 0x57c 0x362c 0x9ded 0x53f 0x382e 0x9d1f 0x515 0x3a2f 0x9c74 0x4ff 0x3c31 0x9bf2 0x4fb 0x3e33 0x9b91 0x509 0x4034 0x9b47 0x51e 0x4236 0x9b11 0x541 0x4438 0x9ae8 0x57e 0x4639 0x9acf 0x5a9 0x483b 0x9a9c 0x5aa 0x4a3d 0x9a54 0x599 0x4c3e 0x9a0c 0x5ac 0x4e40 0x99c4 0x5cd 0x5041 0x9974 0x5d6 0x5243 0x991d 0x5c0 0x5445 0x98bf 0x5ab 0x5646 0x9850 0x56c 0x5848 0x97d4 0x51b 0x5a4a 0x9763 0x4d3 0x5c4b 0x9704 0x49c 0x5e4d 0x96b6 0x47e 0x604f 0x9679 0x47b 0x6250 0x9635 0x466 0x6452 0x9601 0x465 0x6653 0x95d4 0x476 0x6855 0x95a4 0x471 0x6a57 0x9574 0x465 0x6c58 0x9549 0x465 0x6e5a 0x951f 0x468 0x705c 0x94fd 0x47d 0x725d 0x94d3 0x469 0x745f 0x94b5 0x487 0x7661 0x9496 0x497 0x7862 0x9474 0x497 0x7a64 0x9454 0x497 0x7c65 0x943b 0x49a 0x7e67 0x9421 0x4af 0x8069 0x93ff 0x49b 0x826a 0x93ea 0x4a8 0x846c 0x93d4 0x4b0 0x866e 0x93be 0x4ba 0x886f 0x93ab 0x4c3 0x8a71 0x9391 0x4b0 0x8c73 0x9377 0x4b0 0x8e74 0x935e 0x49c 0x9076 0x933d 0x486 0x9277 0x9320 0x47e 0x9479 0x92ff 0x474 0x967b 0x92d4 0x45f 0x987c 0x92aa 0x44e 0x9a7e 0x9288 0x464 0x9c80 0x9266 0x465 0x9e81 0x9244 0x476 0xa083 0x921c 0x47e 0xa285 0x91ee 0x487 0xa486 0x91b6 0x497 0xa688 0x9172 0x497 0xa889 0x9136 0x497 0xaa8b 0x90fa 0x4ab 0xac8d 0x90a4 0x4b0 0xae8e 0x9064 0x4bd 0xb090 0x9045 0x4c9 0xb292 0x9033 0x4cf 0xb493 0x9023 0x4e9 0xb695 0x901a 0x529 0xb897 0x8ffa 0x541 0xba98 0x8fb0 0x588 0xbc9a 0x8eaf 0x59d 0xbe9b 0x8ce8 0x5c0 0xc09d 0x8a6d 0x63c 0xc29f 0x86f1 0x706 0xc4a0 0x810f 0x8dd 0xc6a2 0x73aa 0x10cc>;
			battery0_profile_t1_col = <0x3>;
			battery0_profile_t1_num = <0x64>;
			battery0_profile_t2 = <0x0 0xaa28 0x9b0 0x202 0xa963 0x9ac 0x403 0xa8bb 0x9bd 0x605 0xa823 0x9c4 0x807 0xa79a 0x9b9 0xa08 0xa71d 0x9b2 0xc0a 0xa6a5 0x9c1 0xe0b 0xa62d 0x9ab 0x100d 0xa5be 0x996 0x120f 0xa547 0x992 0x1410 0xa4d5 0x984 0x1612 0xa466 0x979 0x1814 0xa3f7 0x979 0x1a15 0xa389 0x97c 0x1c17 0xa322 0x992 0x1e19 0xa2b3 0x992 0x201a 0xa243 0x992 0x221c 0xa1d4 0x9a0 0x241d 0xa168 0x9b5 0x261f 0xa0fd 0x9bd 0x2821 0xa08e 0x9a8 0x2a22 0xa01f 0x992 0x2c24 0x9fd2 0x9bd 0x2e26 0x9f8c 0xa2e 0x3027 0x9f52 0xaae 0x3229 0x9f0a 0xafa 0x342b 0x9e93 0xae7 0x362c 0x9de1 0xa75 0x382e 0x9d0b 0x9df 0x3a2f 0x9c57 0x99e 0x3c31 0x9bd4 0x992 0x3e33 0x9b6d 0x992 0x4034 0x9b17 0x992 0x4236 0x9ad2 0x9a6 0x4438 0x9a9f 0x9e3 0x4639 0x9a6b 0xa0e 0x483b 0x9a40 0xa39 0x4a3d 0x9a08 0xa30 0x4c3e 0x99c6 0xa1a 0x4e40 0x997a 0x9fb 0x5041 0x991f 0x9c3 0x5243 0x98b8 0x96d 0x5445 0x9851 0x918 0x5646 0x97eb 0x8d7 0x5848 0x9784 0x886 0x5a4a 0x972d 0x859 0x5c4b 0x96e0 0x843 0x5e4d 0x9698 0x834 0x604f 0x965c 0x834 0x6250 0x9621 0x834 0x6452 0x95ed 0x820 0x6653 0x95b9 0x81b 0x6855 0x958b 0x828 0x6a57 0x9560 0x834 0x6c58 0x9535 0x834 0x6e5a 0x950a 0x834 0x705c 0x94df 0x834 0x725d 0x94bd 0x834 0x745f 0x949b 0x834 0x7661 0x947e 0x842 0x7862 0x9460 0x84d 0x7a64 0x943e 0x847 0x7c65 0x941d 0x837 0x7e67 0x9403 0x84c 0x8069 0x93e9 0x84d 0x826a 0x93d6 0x85e 0x846c 0x93c5 0x866 0x866e 0x93b4 0x870 0x886f 0x93a6 0x891 0x8a71 0x939c 0x8cd 0x8c73 0x938b 0x8e2 0x8e74 0x937a 0x920 0x9076 0x9369 0x960 0x9277 0x9352 0x993 0x9479 0x9335 0x9be 0x967b 0x9312 0x9f5 0x987c 0x92f0 0xa4a 0x9a7e 0x92ce 0xaa0 0x9c80 0x92ac 0xaf6 0x9e81 0x9283 0xb4b 0xa083 0x9253 0xba1 0xa285 0x9218 0xbed 0xa486 0x91d6 0xc3f 0xa688 0x919a 0xcbd 0xa889 0x915e 0xd28 0xaa8b 0x9112 0xda7 0xac8d 0x90c5 0xe27 0xae8e 0x908c 0xec1 0xb090 0x9069 0xf80 0xb292 0x904f 0x1053 0xb493 0x9035 0x1124 0xb695 0x901b 0x127b 0xb897 0x8fea 0x13e5 0xba98 0x8f67 0x1540 0xbc9a 0x8e50 0x1656 0xbe9b 0x8c77 0x179f 0xc09d 0x89b5 0x19c9 0xc29f 0x8597 0x1de7 0xc4a0 0x7df4 0x2985 0xc6a2 0x742c 0x122a>;
			battery0_profile_t2_col = <0x3>;
			battery0_profile_t2_num = <0x64>;
			battery0_profile_t3 = <0x0 0xaabe 0x13ec 0x202 0xa9bd 0x13ec 0x403 0xa8f5 0x1410 0x605 0xa844 0x1410 0x807 0xa7a6 0x13fa 0xa08 0xa717 0x13de 0xc0a 0xa691 0x13b7 0xe0b 0xa619 0x13a1 0x100d 0xa5a1 0x138c 0x120f 0xa529 0x1376 0x1410 0xa4b7 0x1361 0x1612 0xa444 0x1341 0x1814 0xa3d1 0x1324 0x1a15 0xa369 0x1321 0x1c17 0xa2fa 0x130b 0x1e19 0xa28b 0x12f6 0x201a 0xa222 0x12f2 0x221c 0xa1b6 0x12e4 0x241d 0xa146 0x12cf 0x261f 0xa0d5 0x12b9 0x2821 0xa06c 0x12b5 0x2a22 0xa01f 0x130a 0x2c24 0x9fda 0x138b 0x2e26 0x9f8e 0x13d6 0x3027 0x9f3c 0x13ec 0x3229 0x9ecd 0x13c2 0x342b 0x9e34 0x1336 0x362c 0x9d76 0x1242 0x382e 0x9cb1 0x1197 0x3a2f 0x9c16 0x1116 0x3c31 0x9b98 0x10ca 0x3e33 0x9b31 0x10b3 0x4034 0x9adb 0x10a9 0x4236 0x9a91 0x109a 0x4438 0x9a4b 0x1097 0x4639 0x99fe 0x1082 0x483b 0x99b9 0x1057 0x4a3d 0x9975 0x102c 0x4c3e 0x992b 0x1002 0x4e40 0x98de 0xfcd 0x5041 0x9891 0xf8d 0x5243 0x9842 0xf4c 0x5445 0x97ed 0xf0c 0x5646 0x9797 0xeb7 0x5848 0x9749 0xe84 0x5a4a 0x9701 0xe59 0x5c4b 0x96bc 0xe42 0x5e4d 0x9678 0xe2f 0x604f 0x9636 0xdf7 0x6250 0x9602 0xdf7 0x6452 0x95cf 0xdf7 0x6653 0x959b 0xde6 0x6855 0x956d 0xdde 0x6a57 0x953e 0xdd4 0x6c58 0x9510 0xdd2 0x6e5a 0x94ec 0xdf4 0x705c 0x94c1 0xddf 0x725d 0x949f 0xdf3 0x745f 0x947d 0xe08 0x7661 0x945a 0xe10 0x7862 0x9438 0xe10 0x7a64 0x941b 0xe23 0x7c65 0x940a 0xe60 0x7e67 0x93f9 0xe8b 0x8069 0x93f0 0xf08 0x826a 0x93e0 0xf89 0x846c 0x93cf 0xffc 0x866e 0x93c2 0x1084 0x886f 0x93b7 0x1129 0x8a71 0x93a6 0x11bc 0x8c73 0x9395 0x123d 0x8e74 0x9384 0x12d1 0x9076 0x9373 0x1389 0x9277 0x935c 0x143c 0x9479 0x9343 0x14e7 0x967b 0x9329 0x159e 0x987c 0x930e 0x1669 0x9a7e 0x92ec 0x16d4 0x9c80 0x92ca 0x17a4 0x9e81 0x92a1 0x1858 0xa083 0x9271 0x1904 0xa285 0x923e 0x19c2 0xa486 0x9208 0x1a8c 0xa688 0x91cb 0x1b3c 0xa889 0x9187 0x1c12 0xaa8b 0x9142 0x1ce8 0xac8d 0x910b 0x1dff 0xae8e 0x90d7 0x1f37 0xb090 0x90a7 0x20a0 0xb292 0x907c 0x2236 0xb493 0x9052 0x23c8 0xb695 0x9030 0x25df 0xb897 0x8fed 0x280a 0xba98 0x8f7a 0x2a9a 0xbc9a 0x8eb1 0x2d2d 0xbe9b 0x8d6e 0x2fb8 0xc09d 0x8b83 0x3278 0xc29f 0x88a9 0x35c2 0xc4a0 0x841b 0x38d8 0xc6a2 0x7918 0x1d7e>;
			battery0_profile_t3_col = <0x3>;
			battery0_profile_t3_num = <0x64>;
			battery0_profile_t4 = <0x0 0xaa64 0x2634 0x202 0xa938 0x2630 0x403 0xa846 0x261d 0x605 0xa781 0x25fa 0x807 0xa6d1 0x258f 0xa08 0xa62e 0x2507 0xc0a 0xa59d 0x24bd 0xe0b 0xa50b 0x243c 0x100d 0xa48b 0x23fb 0x120f 0xa411 0x23de 0x1410 0xa39a 0x23ad 0x1612 0xa326 0x2377 0x1814 0xa2b4 0x2338 0x1a15 0xa23d 0x22cd 0x1c17 0xa1ce 0x2262 0x1e19 0xa15f 0x220c 0x201a 0xa0fd 0x21d9 0x221c 0xa0aa 0x21bc 0x241d 0xa05d 0x21c6 0x261f 0xa009 0x21dc 0x2821 0x9fa9 0x21c0 0x2a22 0x9f43 0x217f 0x2c24 0x9eb2 0x20ab 0x2e26 0x9e0b 0x1fb1 0x3027 0x9d60 0x1ecc 0x3229 0x9cbd 0x1dec 0x342b 0x9c2e 0x1d23 0x362c 0x9bb7 0x1ca2 0x382e 0x9b48 0x1c22 0x3a2f 0x9ae9 0x1bcc 0x3c31 0x9a92 0x1b88 0x3e33 0x9a48 0x1b47 0x4034 0x99ff 0x1b1c 0x4236 0x99b2 0x1af9 0x4438 0x9965 0x1abc 0x4639 0x9918 0x1a91 0x483b 0x98cb 0x1a66 0x4a3d 0x9885 0x1a3b 0x4c3e 0x983b 0x1a03 0x4e40 0x97ee 0x19cd 0x5041 0x97a1 0x19af 0x5243 0x9755 0x19a6 0x5445 0x9710 0x1966 0x5646 0x96cc 0x1964 0x5848 0x968e 0x1964 0x5a4a 0x9652 0x1964 0x5c4b 0x9616 0x1964 0x5e4d 0x95da 0x1957 0x604f 0x95a1 0x1937 0x6250 0x9576 0x1962 0x6452 0x9543 0x1964 0x6653 0x950f 0x1964 0x6855 0x94e1 0x1971 0x6a57 0x94ba 0x1991 0x6c58 0x949a 0x19c9 0x6e5a 0x9481 0x1a22 0x705c 0x9467 0x1a8d 0x725d 0x9455 0x1b0c 0x745f 0x9444 0x1b9e 0x7661 0x9433 0x1c4f 0x7862 0x9426 0x1d0f 0x7a64 0x941b 0x1dca 0x7c65 0x940a 0x1e75 0x7e67 0x93f9 0x1f20 0x8069 0x93f0 0x2009 0x826a 0x93e0 0x20e3 0x846c 0x93cf 0x21b9 0x866e 0x93be 0x228f 0x886f 0x93ad 0x2365 0x8a71 0x939c 0x243e 0x8c73 0x938b 0x2529 0x8e74 0x9372 0x2615 0x9076 0x935f 0x2711 0x9277 0x9348 0x27f7 0x9479 0x932f 0x28cd 0x967b 0x9315 0x29a3 0x987c 0x92fa 0x2a79 0x9a7e 0x92d8 0x2b50 0x9c80 0x92b6 0x2c3a 0x9e81 0x928d 0x2d15 0xa083 0x925d 0x2dde 0xa285 0x922a 0x2ea8 0xa486 0x91f6 0x2f78 0xa688 0x91c2 0x303d 0xa889 0x9186 0x3128 0xaa8b 0x914a 0x3200 0xac8d 0x910e 0x32f6 0xae8e 0x90d7 0x3404 0xb090 0x90ab 0x3526 0xb292 0x9088 0x3661 0xb493 0x9066 0x37bc 0xb695 0x9044 0x393d 0xb897 0x9009 0x3ad3 0xba98 0x8fa6 0x3c9b 0xbc9a 0x8eba 0x3e3e 0xbe9b 0x8d08 0x401d 0xc09d 0x8a76 0x4241 0xc29f 0x869d 0x3f19 0xc4a0 0x7f57 0x2d49 0xc6a2 0x7bc0 0x249f>;
			battery0_profile_t4_col = <0x3>;
			battery0_profile_t4_num = <0x64>;
			battery1_profile_t0 = <0x0 0xaa32 0x370 0x206 0xa9b0 0x36c 0x40c 0xa936 0x36b 0x613 0xa8bd 0x37a 0x819 0xa844 0x384 0xa1f 0xa7cb 0x384 0xc25 0xa750 0x384 0xe2b 0xa6d7 0x384 0x1031 0xa65e 0x384 0x1238 0xa5e5 0x384 0x143e 0xa56d 0x384 0x1644 0xa4f4 0x384 0x184a 0xa47b 0x384 0x1a50 0xa404 0x38a 0x1c57 0xa393 0x39d 0x1e5d 0xa31a 0x39d 0x2063 0xa29f 0x388 0x2269 0xa22d 0x396 0x246f 0xa1bd 0x39d 0x2675 0xa14c 0x39d 0x287c 0xa0dc 0x39d 0x2a82 0xa06c 0x39d 0x2c88 0x9ffc 0x39d 0x2e8e 0x9f94 0x39d 0x3094 0x9f2d 0x3b0 0x329b 0x9ec5 0x3b6 0x34a1 0x9e5c 0x3aa 0x36a7 0x9df8 0x3a6 0x38ad 0x9d99 0x3bc 0x3ab3 0x9d3a 0x3cf 0x3cb9 0x9cdb 0x3cf 0x3ec0 0x9c7c 0x3cf 0x40c6 0x9c23 0x3e0 0x42cc 0x9bcd 0x3e8 0x44d2 0x9b77 0x3f2 0x46d8 0x9b20 0x401 0x48df 0x9acb 0x408 0x4ae5 0x9a7d 0x433 0x4ceb 0x9a1d 0x449 0x4ef1 0x99af 0x44c 0x50f7 0x9926 0x40f 0x52fd 0x989d 0x3c4 0x5504 0x9829 0x39d 0x570a 0x97ce 0x39d 0x5910 0x9781 0x39d 0x5b16 0x973c 0x39d 0x5d1c 0x96fe 0x39d 0x5f23 0x96c2 0x38d 0x6129 0x9685 0x384 0x632f 0x964c 0x384 0x6535 0x9618 0x384 0x673b 0x95e6 0x384 0x6941 0x95ba 0x384 0x6b48 0x9587 0x384 0x6d4e 0x955a 0x384 0x6f54 0x952f 0x384 0x715a 0x9508 0x38f 0x7360 0x94e6 0x39d 0x7567 0x94c3 0x39d 0x776d 0x94a0 0x39e 0x7973 0x947d 0x3b4 0x7b79 0x945b 0x3b6 0x7d7f 0x9438 0x3b6 0x7f85 0x941b 0x3c3 0x818c 0x9401 0x3d8 0x8392 0x93e5 0x3e8 0x8598 0x93c0 0x3e6 0x879e 0x938c 0x3d0 0x89a4 0x9340 0x391 0x8bab 0x92f8 0x396 0x8db1 0x92be 0x39d 0x8fb7 0x928e 0x39d 0x91bd 0x9263 0x3a4 0x93c3 0x9236 0x3ae 0x95c9 0x9203 0x384 0x97d0 0x91d8 0x384 0x99d6 0x91bb 0x3aa 0x9bdc 0x9195 0x3b6 0x9de2 0x916a 0x3b6 0x9fe8 0x9138 0x3b6 0xa1ef 0x90f8 0x3b0 0xa3f5 0x90b5 0x39f 0xa5fb 0x9081 0x3b5 0xa801 0x903d 0x3b6 0xaa07 0x8ff1 0x394 0xac0d 0x8fc4 0x384 0xae14 0x8fb2 0x38e 0xb01a 0x8fa9 0x3aa 0xb220 0x8f9f 0x3d9 0xb426 0x8f8e 0x41a 0xb62c 0x8f6b 0x45c 0xb833 0x8eca 0x41b 0xba39 0x8d72 0x401 0xbc3f 0x8b7f 0x418 0xbe45 0x88e1 0x454 0xc04b 0x851e 0x4f4 0xc251 0x7f2e 0x900 0xc458 0x730a 0xef1 0xc65e 0x730a 0xef1 0xc864 0x730a 0xef1>;
			battery1_profile_t0_col = <0x3>;
			battery1_profile_t0_num = <0x64>;
			battery1_profile_t1 = <0x0 0xaa6e 0x4ce 0x206 0xa9f5 0x4ca 0x40c 0xa983 0x4db 0x613 0xa90d 0x4e2 0x819 0xa894 0x4d7 0xa1f 0xa81b 0x4c9 0xc25 0xa7a0 0x4c9 0xe2b 0xa727 0x4c9 0x1031 0xa6ae 0x4c9 0x1238 0xa635 0x4c9 0x143e 0xa5bd 0x4c9 0x1644 0xa544 0x4bc 0x184a 0xa4cb 0x4b0 0x1a50 0xa452 0x4b0 0x1c57 0xa3da 0x4b3 0x1e5d 0xa36a 0x4c8 0x2063 0xa2f8 0x4c9 0x2269 0xa280 0x4c9 0x246f 0xa20d 0x4c9 0x2675 0xa19c 0x4c9 0x287c 0xa12c 0x4c9 0x2a82 0xa0bc 0x4c9 0x2c88 0xa04c 0x4ca 0x2e8e 0x9fe4 0x4df 0x3094 0x9f7d 0x4e2 0x329b 0x9f15 0x4e2 0x34a1 0x9eac 0x4e2 0x36a7 0x9e48 0x4f4 0x38ad 0x9de6 0x514 0x3ab3 0x9d7f 0x514 0x3cb9 0x9d17 0x514 0x3ec0 0x9cc0 0x53d 0x40c6 0x9c63 0x546 0x42cc 0x9c09 0x546 0x44d2 0x9bb7 0x565 0x46d8 0x9b66 0x591 0x48df 0x9b10 0x598 0x4ae5 0x9ab9 0x5c3 0x4ceb 0x9a59 0x5c3 0x4ef1 0x99e3 0x5b0 0x50f7 0x995e 0x55d 0x52fd 0x98d4 0x4fd 0x5504 0x9857 0x4b8 0x570a 0x97f4 0x492 0x5910 0x979f 0x47e 0x5b16 0x975a 0x47e 0x5d1c 0x971c 0x492 0x5f23 0x96d9 0x487 0x6129 0x969e 0x47e 0x632f 0x966a 0x47e 0x6535 0x9636 0x47e 0x673b 0x9602 0x47e 0x6941 0x95ce 0x47e 0x6b48 0x95a3 0x47e 0x6d4e 0x9578 0x47e 0x6f54 0x9553 0x48d 0x715a 0x952c 0x497 0x7360 0x9504 0x497 0x7567 0x94e1 0x49b 0x776d 0x94be 0x4b0 0x7973 0x949b 0x4b0 0x7b79 0x9481 0x4c4 0x7d7f 0x9460 0x4c9 0x7f85 0x9443 0x4d6 0x818c 0x9429 0x4eb 0x8392 0x940d 0x4f5 0x8598 0x93eb 0x4e5 0x879e 0x93d1 0x4fa 0x89a4 0x93af 0x4e6 0x8bab 0x9385 0x4d1 0x8db1 0x9360 0x4bb 0x8fb7 0x9339 0x4a5 0x91bd 0x9310 0x49e 0x93c3 0x92ec 0x4b0 0x95c9 0x92c1 0x4b0 0x97d0 0x9296 0x4b0 0x99d6 0x9272 0x4b0 0x9bdc 0x924f 0x4b0 0x9de2 0x9228 0x4bc 0x9fe8 0x91f9 0x4c9 0xa1ef 0x91c1 0x4c9 0xa3f5 0x917e 0x4cb 0xa5fb 0x9149 0x4e1 0xa801 0x910d 0x4f6 0xaa07 0x90bc 0x4fb 0xac0d 0x9076 0x509 0xae14 0x904e 0x51e 0xb01a 0x903f 0x53a 0xb220 0x9035 0x566 0xb426 0x9024 0x591 0xb62c 0x900a 0x5bc 0xb833 0x8fdb 0x60b 0xba39 0x8f1d 0x627 0xbc3f 0x8da7 0x656 0xbe45 0x8b83 0x6bd 0xc04b 0x8899 0x761 0xc251 0x844a 0x9e2 0xc458 0x7b85 0x1f8f 0xc65e 0x7738 0x194b 0xc864 0x7738 0x194b>;
			battery1_profile_t1_col = <0x3>;
			battery1_profile_t1_num = <0x64>;
			battery1_profile_t2 = <0x0 0xaaf0 0xa14 0x206 0xaaab 0xa10 0x40c 0xaa33 0xa6a 0x613 0xa9b7 0xa8c 0x819 0xa943 0xa75 0xa1f 0xa8cf 0xa4a 0xc25 0xa854 0xa23 0xe2b 0xa7db 0xa0c 0x1031 0xa762 0x9e1 0x1238 0xa6e9 0x9b6 0x143e 0xa671 0x97a 0x1644 0xa5f8 0x953 0x184a 0xa57f 0x934 0x1a50 0xa506 0x90f 0x1c57 0xa48e 0x8f9 0x1e5d 0xa41e 0x8e4 0x2063 0xa3a3 0x8b9 0x2269 0xa331 0x89f 0x246f 0xa2bb 0x88a 0x2675 0xa246 0x87f 0x287c 0xa1d6 0x87f 0x2a82 0xa166 0x87f 0x2c88 0xa0f6 0x880 0x2e8e 0xa08e 0x895 0x3094 0xa01f 0x898 0x329b 0x9fb5 0x898 0x34a1 0x9f4c 0x898 0x36a7 0x9ee8 0x8a1 0x38ad 0x9e86 0x8b1 0x3ab3 0x9e1e 0x8af 0x3cb9 0x9dad 0x899 0x3ec0 0x9d3d 0x898 0x40c6 0x9ccd 0x887 0x42cc 0x9c6d 0x88d 0x44d2 0x9c17 0x898 0x46d8 0x9bc0 0x898 0x48df 0x9b6a 0x89c 0x4ae5 0x9b13 0x8b1 0x4ceb 0x9ab3 0x89b 0x4ef1 0x9a4c 0x873 0x50f7 0x99de 0x847 0x52fd 0x9969 0x810 0x5504 0x98f4 0x7d0 0x570a 0x9886 0x794 0x5910 0x981f 0x769 0x5b16 0x97c0 0x73d 0x5d1c 0x9771 0x73a 0x5f23 0x9729 0x72a 0x6129 0x96e9 0x721 0x632f 0x96ac 0x721 0x6535 0x966f 0x721 0x673b 0x9634 0x721 0x6941 0x9600 0x721 0x6b48 0x95d5 0x736 0x6d4e 0x95a3 0x73a 0x6f54 0x9575 0x749 0x715a 0x954a 0x753 0x7360 0x9522 0x75b 0x7567 0x94fd 0x76c 0x776d 0x94d2 0x76c 0x7973 0x94af 0x76c 0x7b79 0x948d 0x780 0x7d7f 0x946a 0x795 0x7f85 0x944d 0x79e 0x818c 0x9433 0x7a7 0x8392 0x9417 0x7b7 0x8598 0x93f5 0x7b7 0x879e 0x93db 0x7b7 0x89a4 0x93c9 0x7e0 0x8bab 0x93b1 0x7d7 0x8db1 0x939d 0x7de 0x8fb7 0x938b 0x7f4 0x91bd 0x9377 0x809 0x93c3 0x935d 0x81f 0x95c9 0x9343 0x834 0x97d0 0x9318 0x834 0x99d6 0x92ec 0x847 0x9bdc 0x92c7 0x86c 0x9de2 0x92a5 0x8a3 0x9fe8 0x927f 0x8db 0xa1ef 0x9251 0x90d 0xa3f5 0x921b 0x94b 0xa5fb 0x91d6 0x977 0xa801 0x9199 0x9cb 0xaa07 0x915c 0xa32 0xac0d 0x9115 0xa90 0xae14 0x90c3 0xaf1 0xb01a 0x9078 0xb63 0xb220 0x9049 0xbf2 0xb426 0x9038 0xcca 0xb62c 0x901e 0xda6 0xb833 0x9004 0xedb 0xba39 0x8fe4 0x105b 0xbc3f 0x8f97 0x123c 0xbe45 0x8eca 0x1479 0xc04b 0x8d35 0x1748 0xc251 0x8ae1 0x1b8f 0xc458 0x87a4 0x22fb 0xc65e 0x827e 0x30b7 0xc864 0x779c 0x1aa9>;
			battery1_profile_t2_col = <0x3>;
			battery1_profile_t2_num = <0x64>;
			battery1_profile_t3 = <0x0 0xaa96 0x546 0x206 0xaa26 0x546 0x40c 0xa9d3 0x58f 0x613 0xa94a 0xe9c 0x819 0xa8af 0x14cd 0xa1f 0xa821 0x14a5 0xc25 0xa79c 0x1446 0xe2b 0xa713 0x1419 0x1031 0xa691 0x13d9 0x1238 0xa617 0x1398 0x143e 0xa598 0x1347 0x1644 0xa51c 0x12fd 0x184a 0xa4a3 0x12bc 0x1a50 0xa42a 0x1288 0x1c57 0xa3b2 0x126d 0x1e5d 0xa342 0x122c 0x2063 0xa2c7 0x11ea 0x2269 0xa255 0x11bb 0x246f 0xa1e5 0x1190 0x2675 0xa174 0x1144 0x287c 0xa107 0x1106 0x2a82 0xa09e 0x110f 0x2c88 0xa02e 0x10e3 0x2e8e 0x9fc6 0x10a2 0x3094 0x9f66 0x1087 0x329b 0x9f07 0x1081 0x34a1 0x9ea2 0x1075 0x36a7 0x9e32 0x1056 0x38ad 0x9db7 0x1025 0x3ab3 0x9d37 0xfe6 0x3cb9 0x9cbe 0xfbb 0x3ec0 0x9c4d 0xf7b 0x40c6 0x9beb 0xf5d 0x42cc 0x9b91 0xf55 0x44d2 0x9b3b 0xf40 0x46d8 0x9ae2 0xf0e 0x48df 0x9a81 0xed1 0x4ae5 0x9a19 0xea6 0x4ceb 0x99b0 0xe64 0x4ef1 0x9941 0xe10 0x50f7 0x98d7 0xdd8 0x52fd 0x9874 0xda1 0x5504 0x9815 0xd69 0x570a 0x97ba 0xd48 0x5910 0x976d 0xd48 0x5b16 0x9728 0xd48 0x5d1c 0x96db 0xd20 0x5f23 0x969a 0xd26 0x6129 0x9662 0xd3c 0x632f 0x962a 0xd3e 0x6535 0x95f0 0xd36 0x673b 0x95be 0xd4e 0x6941 0x9592 0xd7a 0x6b48 0x955f 0xd7a 0x6d4e 0x9532 0xd9e 0x6f54 0x9507 0xdbb 0x715a 0x94e0 0xddb 0x7360 0x94be 0xe07 0x7567 0x9499 0xe29 0x776d 0x946e 0xe2d 0x7973 0x9454 0xe6e 0x7b79 0x9433 0xe88 0x7d7f 0x9417 0xead 0x7f85 0x9402 0xee5 0x818c 0x93f1 0xf26 0x8392 0x93df 0xf67 0x8598 0x93ce 0xfad 0x879e 0x93bd 0x1018 0x89a4 0x93ab 0x1084 0x8bab 0x93a1 0x1103 0x8db1 0x938d 0x1177 0x8fb7 0x9373 0x1204 0x91bd 0x9359 0x12a9 0x93c3 0x933e 0x1340 0x95c9 0x931b 0x13d8 0x97d0 0x92f0 0x1485 0x99d6 0x92c4 0x1557 0x9bdc 0x9299 0x162f 0x9de2 0x926e 0x1743 0x9fe8 0x923c 0x1889 0xa1ef 0x91fc 0x19d1 0xa3f5 0x91b7 0x1b19 0xa5fb 0x9172 0x1c88 0xa801 0x912d 0x1e35 0xaa07 0x90e1 0x2006 0xac0d 0x908e 0x2218 0xae14 0x9048 0x2486 0xb01a 0x901c 0x2775 0xb220 0x9002 0x2b0c 0xb426 0x8fe8 0x2f59 0xb62c 0x8fc5 0x3426 0xb833 0x8f94 0x38e2 0xba39 0x8f29 0x3cb9 0xbc3f 0x8e20 0x3fe8 0xbe45 0x8c51 0x43fe 0xc04b 0x89d6 0x4702 0xc251 0x8635 0x3e2a 0xc458 0x8014 0x2f0d 0xc65e 0x7ff8 0x2ee0 0xc864 0x7ff8 0x2ee0>;
			battery1_profile_t3_col = <0x3>;
			battery1_profile_t3_num = <0x64>;
			battery1_profile_t4 = <0x0 0xaac8 0x2742 0x206 0xaa1b 0x2742 0x40c 0xa976 0x27c1 0x613 0xa8d8 0x27e2 0x819 0xa841 0x27c1 0xa1f 0xa7ad 0x2796 0xc25 0xa71a 0x2760 0xe2b 0xa690 0x2705 0x1031 0xa606 0x266e 0x1238 0xa57c 0x25d7 0x143e 0xa4ff 0x251f 0x1644 0xa481 0x2450 0x184a 0xa407 0x238b 0x1a50 0xa394 0x22de 0x1c57 0xa31c 0x223a 0x1e5d 0xa2ac 0x21ce 0x2063 0xa23a 0x218a 0x2269 0xa1c9 0x2137 0x246f 0xa159 0x20e1 0x2675 0xa0e8 0x2096 0x287c 0xa07b 0x205d 0x2a82 0xa015 0x2042 0x2c88 0x9fb6 0x206a 0x2e8e 0x9f4e 0x203f 0x3094 0x9ed8 0x2027 0x329b 0x9e58 0x1ff2 0x34a1 0x9dd6 0x1fbd 0x36a7 0x9d53 0x1f88 0x38ad 0x9cd1 0x1f48 0x3ab3 0x9c52 0x1f0c 0x3cb9 0x9be1 0x1ef6 0x3ec0 0x9b82 0x1ee0 0x40c6 0x9b23 0x1ecb 0x42cc 0x9ac4 0x1eb5 0x44d2 0x9a65 0x1e95 0x46d8 0x9a06 0x1e71 0x48df 0x99a7 0x1e54 0x4ae5 0x9947 0x1e14 0x4ceb 0x98de 0x1dbc 0x4ef1 0x9885 0x1d8b 0x50f7 0x9829 0x1d41 0x52fd 0x97d3 0x1cf6 0x5504 0x9785 0x1cbe 0x570a 0x9738 0x1ca7 0x5910 0x96eb 0x1cd4 0x5b16 0x96a6 0x1d15 0x5d1c 0x9668 0x1d7d 0x5f23 0x962c 0x1dc8 0x6129 0x95ef 0x1e17 0x632f 0x95b6 0x1e78 0x6535 0x9582 0x1ede 0x673b 0x9550 0x1f37 0x6941 0x9524 0x1fa3 0x6b48 0x94f9 0x1ffa 0x6d4e 0x94d5 0x2062 0x6f54 0x94b3 0x20bf 0x715a 0x9495 0x2121 0x7360 0x947b 0x218d 0x7567 0x9462 0x2206 0x776d 0x9451 0x22b3 0x7973 0x9440 0x2335 0x7b79 0x9427 0x23dd 0x7d7f 0x9413 0x249a 0x7f85 0x9402 0x255d 0x818c 0x93f1 0x263b 0x8392 0x93df 0x273e 0x8598 0x93cd 0x2844 0x879e 0x93b3 0x295c 0x89a4 0x93a1 0x2a9e 0x8bab 0x9389 0x2be6 0x8db1 0x936f 0x2d3a 0x8fb7 0x9355 0x2eaa 0x91bd 0x933b 0x302e 0x93c3 0x9320 0x31af 0x95c9 0x92fd 0x331d 0x97d0 0x92da 0x3461 0x99d6 0x92b0 0x35a4 0x9bdc 0x9285 0x36c9 0x9de2 0x9255 0x37d6 0x9fe8 0x9221 0x38c1 0xa1ef 0x91ea 0x3985 0xa3f5 0x91ae 0x3a46 0xa5fb 0x9171 0x3af2 0xa801 0x912d 0x3b8b 0xaa07 0x90e1 0x3c44 0xac0d 0x9099 0x3d14 0xae14 0x9060 0x3e14 0xb01a 0x903a 0x3f6b 0xb220 0x9020 0x4135 0xb426 0x9006 0x4392 0xb62c 0x8fec 0x4741 0xb833 0x8fc3 0x4c8e 0xba39 0x8f58 0x52d4 0xbc3f 0x8e51 0x527b 0xbe45 0x8c5d 0x4db5 0xc04b 0x8993 0x4722 0xc251 0x8912 0x453d 0xc458 0x8912 0x453d 0xc65e 0x8912 0x453d 0xc864 0x8912 0x453d>;
			battery1_profile_t4_col = <0x3>;
			battery1_profile_t4_num = <0x64>;
			g_FG_PSEUDO100_cv4290 = <0x5c 0x5a 0x64 0x64 0x5c 0x5a 0x64 0x64 0x5c 0x5a 0x64 0x64 0x54 0x52 0x64 0x64 0x55 0x53 0x64 0x64 0x64 0x64 0x64 0x64 0x64 0x64 0x64 0x64 0x64 0x64 0x64 0x64 0x64 0x64 0x64 0x64 0x64 0x64 0x64 0x64>;
			g_FG_PSEUDO100_cv4340 = <0x60 0x5f 0x64 0x64 0x60 0x5f 0x64 0x64 0x60 0x5e 0x64 0x64 0x57 0x56 0x64 0x64 0x57 0x56 0x64 0x64 0x64 0x64 0x64 0x64 0x64 0x64 0x64 0x64 0x64 0x64 0x64 0x64 0x64 0x64 0x64 0x64 0x64 0x64 0x64 0x64>;
			g_FG_PSEUDO100_cv4360 = <0x61 0x60 0x64 0x64 0x61 0x60 0x64 0x64 0x61 0x60 0x64 0x64 0x58 0x56 0x64 0x64 0x58 0x57 0x64 0x64 0x64 0x64 0x64 0x64 0x64 0x64 0x64 0x64 0x64 0x64 0x64 0x64 0x64 0x64 0x64 0x64 0x64 0x64 0x64 0x64>;
			g_FG_PSEUDO100_cv4380 = <0x62 0x62 0x64 0x64 0x63 0x62 0x64 0x64 0x63 0x62 0x64 0x64 0x59 0x58 0x64 0x64 0x59 0x59 0x64 0x64 0x64 0x64 0x64 0x64 0x64 0x64 0x64 0x64 0x64 0x64 0x64 0x64 0x64 0x64 0x64 0x64 0x64 0x64 0x64 0x64>;
			g_FG_PSEUDO100_cv4400 = <0x64 0x64 0x64 0x64 0x64 0x64 0x64 0x64 0x64 0x64 0x64 0x64 0x5a 0x5a 0x64 0x64 0x5a 0x5a 0x64 0x64 0x64 0x64 0x64 0x64 0x64 0x64 0x64 0x64 0x64 0x64 0x64 0x64 0x64 0x64 0x64 0x64 0x64 0x64 0x64 0x64>;
			io-channel-names = "batteryID-channel";
			io-channels = <0xffffffff 0x5>;
			wt,batt-cycle-ranges = <0x0 0x12b 0x432380 0x12c 0x18f 0x42d560 0x190 0x2bb 0x428740 0x2bc 0x3e7 0x423920 0x3e8 0xf423f 0x4175d0>;
		};
	};

	fragment@50 {
		target = <0xffffffff>;

		__overlay__ {
			deb-gpios = <0xffffffff 0x17 0x0>;
			debounce = <0x7d000>;
			interrupt-parent = <0xffffffff>;
			interrupts = <0x17 0x4>;
			status = "okay";
		};
	};

	fragment@51 {
		target = <0xffffffff>;

		__overlay__ {
			deb-gpios = <0xffffffff 0x18 0x0>;
			debounce = <0x7d000>;
			interrupt-parent = <0xffffffff>;
			interrupts = <0x18 0x8>;
			status = "okay";
		};
	};

	fragment@52 {
		target = <0xffffffff>;

		__overlay__ {
			deb-gpios = <0xffffffff 0x19 0x0>;
			debounce = <0x7d000>;
			interrupt-parent = <0xffffffff>;
			interrupts = <0x19 0x4>;
			status = "okay";
		};
	};

	fragment@53 {
		target = <0xffffffff>;

		__overlay__ {
			deb-gpios = <0xffffffff 0x1a 0x0>;
			debounce = <0x7d000>;
			interrupt-parent = <0xffffffff>;
			interrupts = <0x1a 0x4>;
			status = "okay";
		};
	};

	fragment@54 {
		target = <0xffffffff>;

		__overlay__ {
			interrupt-parent = <0xffffffff>;
			interrupts = <0x54 0x1>;
			status = "okay";
		};
	};

	fragment@55 {
		target = <0xffffffff>;

		__overlay__ {
			compatible = "mediatek,md1_sim1_hot_plug_eint-eint";
			debounce = <0x0 0xc350>;
			dedicated = <0x0 0x0>;
			interrupts = <0x0 0x8>;
			sockettype = <0x0 0x0>;
			src_pin = <0x0 0x1>;
			status = "okay";
		};
	};

	fragment@56 {
		target = <0xffffffff>;

		__overlay__ {
			regulator-default-on = <0x1>;
			regulator-name = "vcamio";
			status = "okay";
		};
	};

	fragment@57 {
		target = <0xffffffff>;

		__overlay__ {
			regulator-default-on = <0x1>;
			regulator-name = "vtp";
			status = "okay";
		};
	};

	fragment@58 {
		target = <0xffffffff>;

		__overlay__ {
			status = "okay";
			vcamaf-supply = <0xffffffff>;
			vcamio_main2-supply = <0xffffffff>;
			vcamio_main3-supply = <0xffffffff>;
		};
	};

	fragment@59 {
		target = <0xffffffff>;

		__overlay__ {
			status = "okay";
		};
	};

	fragment@6 {
		target = <0xffffffff>;

		__overlay__ {

			chg {
				cv = <0x432380>;
				ieoc = <0x3d090>;
			};
		};
	};

	fragment@60 {
		target = <0xffffffff>;

		__overlay__ {
			mediatek,kpd-hw-dl-key0 = <0x1>;
			mediatek,kpd-hw-dl-key1 = <0x11>;
			mediatek,kpd-hw-dl-key2 = <0x8>;
			mediatek,kpd-hw-factory-key = <0x11>;
			mediatek,kpd-hw-init-map = <0x0 0x73 0x0 0x0 0x0 0x0 0x0 0x0 0x0 0x0 0x0 0x0 0x0 0x0 0x0 0x0 0x0 0x0 0x0 0x0 0x0 0x0 0x0 0x0 0x0 0x0 0x0 0x0 0x0 0x0 0x0 0x0 0x0 0x0 0x0 0x0 0x0 0x0 0x0 0x0 0x0 0x0 0x0 0x0 0x0 0x0 0x0 0x0 0x0 0x0 0x0 0x0 0x0 0x0 0x0 0x0 0x0 0x0 0x0 0x0 0x0 0x0 0x0 0x0 0x0 0x0 0x0 0x0 0x0 0x0 0x0 0x0>;
			mediatek,kpd-hw-map-num = <0x48>;
			mediatek,kpd-hw-pwrkey = <0x8>;
			mediatek,kpd-hw-recovery-key = <0x1>;
			mediatek,kpd-hw-rstkey = <0x11>;
			mediatek,kpd-key-debounce = <0x400>;
			mediatek,kpd-pwkey-gpio-din = <0x0>;
			mediatek,kpd-pwrkey-eint-gpio = <0x0>;
			mediatek,kpd-sw-pwrkey = <0x74>;
			mediatek,kpd-sw-rstkey = <0x72>;
			mediatek,kpd-use-extend-type = <0x0>;
			status = "okay";
		};
	};

	fragment@61 {
		target = <0xffffffff>;

		__overlay__ {

			sec-nfc@27 {
				compatible = "sec-nfc";
				reg = <0x27>;
				sec-nfc,clk_req-gpio = <0xffffffff 0x51 0x0>;
				sec-nfc,clk_req-gpio_num = <0x51>;
				sec-nfc,firm-gpio = <0xffffffff 0x6 0x0>;
				sec-nfc,firm-gpio_num = <0x6>;
				sec-nfc,irq-gpio = <0xffffffff 0x5 0x0>;
				sec-nfc,irq-gpio_num = <0x5>;
				sec-nfc,ven-gpio = <0xffffffff 0x7 0x0>;
				sec-nfc,ven-gpio_num = <0x7>;
				status = "okay";
			};
		};
	};

	fragment@62 {
		target = <0xffffffff>;

		__overlay__ {

			btp-irq {
				phandle = <0x57>;

				pins_cmd_dat {
					bias-disable;
					drive-strength = <0x1>;
					pinmux = <0x1200>;
				};
			};

			btp-irq-sleep {
				phandle = <0x60>;

				pins_cmd_dat {
					bias-pull-down;
					drive-strength = <0x1>;
					input-enable;
					pinmux = <0x1200>;
				};
			};

			btp_sleep_enable {
				phandle = <0x56>;

				pins_cmd_dat {
					bias-pull-down;
					drive-strength = <0x1>;
					pinmux = <0x1100>;
				};
			};

			clr_clk {
				phandle = <0x5f>;

				pins_cmd_dat {
					bias-pull-down;
					drive-strength = <0x1>;
					output-low;
					pinmux = <0x2300>;
					slew-rate = <0x0>;
				};
			};

			clr_cs {
				phandle = <0x5d>;

				pins_cmd_dat {
					bias-pull-down;
					drive-strength = <0x1>;
					output-low;
					pinmux = <0x2400>;
					slew-rate = <0x0>;
				};
			};

			clr_miso {
				phandle = <0x5c>;

				pins_cmd_dat {
					bias-pull-down;
					drive-strength = <0x1>;
					input-enable;
					pinmux = <0x2600>;
					slew-rate = <0x0>;
				};
			};

			clr_mosi {
				phandle = <0x5e>;

				pins_cmd_dat {
					bias-pull-down;
					drive-strength = <0x1>;
					output-low;
					pinmux = <0x2500>;
					slew-rate = <0x0>;
				};
			};

			set_clk {
				phandle = <0x5b>;

				pins_cmd_dat {
					drive-strength = <0x4>;
					pinmux = <0x2301>;
				};
			};

			set_cs {
				phandle = <0x59>;

				pins_cmd_dat {
					drive-strength = <0x4>;
					pinmux = <0x2401>;
				};
			};

			set_miso {
				phandle = <0x58>;

				pins_cmd_dat {
					drive-strength = <0x4>;
					pinmux = <0x2601>;
				};
			};

			set_mosi {
				phandle = <0x5a>;

				pins_cmd_dat {
					drive-strength = <0x4>;
					pinmux = <0x2501>;
				};
			};
		};
	};

	fragment@63 {
		target = <0xffffffff>;

		__overlay__ {
			regulator-max-microvolt = <0x325aa0>;
			regulator-min-microvolt = <0x325aa0>;
			regulator-name = "VDD_BTP_3P3";
		};
	};

	fragment@64 {
		target = <0xffffffff>;

		__overlay__ {
			#address-cells = <0x1>;
			#size-cells = <0x0>;
			status = "okay";

			etspi-spi@1 {
				#gpio-cells = <0x2>;
				compatible = "etspi,et5xx";
				etspi-chipid = "ET528";
				etspi-drdyPin = <0xffffffff 0x12 0x0>;
				etspi-orient = <0x2>;
				etspi-regulator = "VDD_BTP_3P3";
				etspi-sleepPin = <0xffffffff 0x11 0x0>;
				gpio-controller;
				pinctrl-0 = <0x56 0x57>;
				pinctrl-1 = <0x58 0x59 0x5a 0x5b>;
				pinctrl-2 = <0x56 0x5c 0x5d 0x5e 0x5f>;
				pinctrl-3 = <0x57>;
				pinctrl-4 = <0x60>;
				pinctrl-names = "default", "pins_poweron", "pins_poweroff", "pins_poweron_tz", "pins_poweroff_tz";
				reg = <0x1>;
				spi-max-frequency = <0xbebc20>;

				controller-data {
					mediatek,tckdly = <0x1>;
				};
			};
		};
	};

	fragment@7 {
		target = <0xffffffff>;

		__overlay__ {
			ac_charger_current = <0x1e8480>;
			ac_charger_input_current = <0x1e8480>;
			afc_charger_current = <0x2dc6c0>;
			afc_charger_input_current = <0x197b70>;
			afc_data_gpio = <0xffffffff 0xd 0x0>;
			afc_data_gpio_num = <0xd>;
			afc_ichg_level_threshold = <0xf4240>;
			afc_max_charger_voltage = <0x895440>;
			afc_min_charger_voltage = <0x401640>;
			afc_pre_input_curret = <0x7a120>;
			afc_start_battery_soc = <0x0>;
			afc_stop_battery_soc = <0x55>;
			afc_switch_gpio = <0xffffffff 0x8c 0x0>;
			afc_switch_gpio_num = <0x8c>;
			battery_cv = <0x432380>;
			enable_afc;
			enable_min_charge_temp;
			enable_pe_2;
			enable_sw_jeita;
			jeita_temp_above_t4_cc = <0x0>;
			jeita_temp_above_t4_cv = <0x3e8fa0>;
			jeita_temp_below_t0_cc = <0x0>;
			jeita_temp_below_t0_cv = <0x432380>;
			jeita_temp_t0_to_t1_cc = <0x61a80>;
			jeita_temp_t0_to_t1_cv = <0x432380>;
			jeita_temp_t1_to_t2_cc = <0x124f80>;
			jeita_temp_t1_to_t2_cv = <0x432380>;
			jeita_temp_t2_to_t3_cc = <0x1e8480>;
			jeita_temp_t2_to_t3_cv = <0x432380>;
			jeita_temp_t3_to_t4_cc = <0x155cc0>;
			jeita_temp_t3_to_t4_cv = <0x3e8fa0>;
			max_charge_temp = <0x3c>;
			max_charge_temp_minus_x_degree = <0x3c>;
			max_charger_voltage = <0x989680>;
			min_charge_temp = <0x0>;
			min_charge_temp_plus_x_degree = <0x0>;
			min_charger_voltage = <0x401640>;
			pd_vbus_upper_bound = <0x895440>;
			pinctrl-0 = <0x1>;
			pinctrl-1 = <0x2>;
			pinctrl-names = "active", "sleep";
			status = "okay";
			ta_ac_charger_current = <0x2dc6c0>;
			temp_neg_10_thres = <0x0>;
			temp_t0_thres = <0x1>;
			temp_t0_thres_plus_x_degree = <0x1>;
			temp_t1_thres = <0x5>;
			temp_t1_thres_plus_x_degree = <0x6>;
			temp_t2_thres = <0xa>;
			temp_t2_thres_plus_x_degree = <0xb>;
			temp_t3_thres = <0x2d>;
			temp_t3_thres_minus_x_degree = <0x2c>;
			temp_t4_thres = <0x37>;
			temp_t4_thres_minus_x_degree = <0x36>;
		};
	};

	fragment@8 {
		target = <0xffffffff>;

		__overlay__ {

			active {
				phandle = <0x1>;

				pins_cmd0_dat {
					bias-pull-up;
					drive-strength = <0x6>;
					pinmux = <0xd00>;
				};
			};

			sleep {
				phandle = <0x2>;

				pins_cmd0_dat {
					bias-disable;
					drive-strength = <0x6>;
					input-enable;
					pinmux = <0xd00>;
				};
			};
		};
	};

	fragment@9 {
		target = <0xffffffff>;

		__overlay__ {

			lcd_bias_enn0_gpio {
				phandle = <0x6>;

				pins_cmd_dat {
					output-low;
					pinmux = <0x8a00>;
					slew-rate = <0x1>;
				};
			};

			lcd_bias_enn1_gpio {
				phandle = <0x5>;

				pins_cmd_dat {
					output-high;
					pinmux = <0x8a00>;
					slew-rate = <0x1>;
				};
			};

			lcd_bias_enp0_gpio {
				phandle = <0x4>;

				pins_cmd_dat {
					output-low;
					pinmux = <0x8900>;
					slew-rate = <0x1>;
				};
			};

			lcd_bias_enp1_gpio {
				phandle = <0x3>;

				pins_cmd_dat {
					output-high;
					pinmux = <0x8900>;
					slew-rate = <0x1>;
				};
			};

			lcm_dsi_te {
				phandle = <0x9>;

				pins_cmd_dat {
					pinmux = <0x5401>;
				};
			};

			lcm_rst_out0_gpio {
				phandle = <0x8>;

				pins_cmd_dat {
					output-low;
					pinmux = <0x5600>;
					slew-rate = <0x1>;
				};
			};

			lcm_rst_out1_gpio {
				phandle = <0x7>;

				pins_cmd_dat {
					output-high;
					pinmux = <0x5600>;
					slew-rate = <0x1>;
				};
			};
		};
	};

	fragment@model {
		target-path = [2f 00];

		__overlay__ {

			sec-mst {
				compatible = "sec-mst";
				sec-mst,mst-data-gpio = <0xffffffff 0x38 0x0>;
				sec-mst,mst-en-gpio = <0xffffffff 0x3a 0x0>;
				sec-mst,mst-pwr-gpio = <0xffffffff 0x37 0x0 0x0>;
				sec-mst,mst-vcc-gpio = <0xffffffff 0x39 0x0>;
			};

			usb_notifier {
				compatible = "samsung,usb-notifier";
			};
		};
	};
};
